## test/testcase/utility/Config.in
```kconfig
menu "Utility Testcase Configuration"

source "test/testcase/utility/cjson/Config.in"

endmenu
```

## test/testcase/utility/cjson_test/Config.in
```kconfig
config AOS_COMP_CJSON_TEST
    bool "CJSON Testcase"
    select AOS_COMP_CJSON
    default n
    help
```

## test/testcase/utility/digest_algorithm_test/Config.in
```kconfig
menuconfig AOS_COMP_DIGEST_ALGORITHM_TEST
    bool "digest_algorithm_test"
    default n
    select AOS_COMP_DIGEST_ALGORITHM
    help

if AOS_COMP_DIGEST_ALGORITHM_TEST
# Configurations for comp digest_algorithm_test
endif
```

## test/testcase/utility/hashtable_test/Config.in
```kconfig
menuconfig AOS_COMP_HASHTABLE_TEST
    bool "hashtable_test"
    default n
    select AOS_COMP_HASHTABLE
    help

if AOS_COMP_HASHTABLE_TEST
# Configurations for comp hashtable_test
endif
```

## utility/Config.in
```kconfig
menu "Utility     Configuration"

source "utility/activation/Config.in"
source "utility/activation/chip_code/Config.in"
source "utility/cjson/Config.in"
source "utility/libc/Config.in"
source "utility/mbedtls/Config.in"
source "utility/zlib/Config.in"

endmenu
```

## utility/activation/Config.in
```kconfig
config AOS_COMP_ACTIVATION
    bool "activation"
    help
      Help message for component activation

comment "for device activation"
```

## utility/activation/chip_code/Config.in
```kconfig
config AOS_COMP_CHIP_CODE
    bool "Chip_code"
    default n
    help
      return the code of specified chip
```

## utility/libc/Config.in
```kconfig
config AOS_COMP_NEWLIB_STUB
    bool "Newlib(C-library) adaptation layer"
    default n
    select AOS_COMP_VFS
    help
        AliOS Things libc adaptation layer.
```

## utility/mbedtls/Config.in
```kconfig
config AOS_COMP_MBEDTLS
    bool "mbedtls"
    default n
    help
        AliOS Things Mbed TLS layer

if AOS_COMP_MBEDTLS
# Configurations for component mbedtls
endif
```

## utility/zlib/Config.in
```kconfig
config AOS_COMP_ZLIB
    bool "zlib 1.2.4"
    default n
    help
        zlib is a general purpose data compression library.
```

## vendor/Config.in
```kconfig
menu "BSP         Configuration"
choice
    prompt "Board Selection"
    config AOS_BOARD_NULL
        bool "NULL"

if AOS_BOARD_NULL
    config AOS_BUILD_BOARD
        default "board_comp_make"
endif


source "vendor/haas/board/haas100-mk/Config.in"
if AOS_BOARD_HAAS100_MK
    config AOS_BUILD_BOARD
        default "haas100-mk"

    source "vendor/haas/mcu/Config.in"
    source "kernel/arch/arm/armv8m/Config.in"
endif

endchoice

endmenu
```

## vendor/haas/board/haas100-mk/Config.in
```kconfig
config AOS_BOARD_HAAS100_MK
    bool "haas100-mk"
    select AOS_MCU_HAAS1000 if AOS_KERNEL_MODE
    select AOS_COMP_KERNEL_INIT if AOS_KERNEL_MODE
    select RHINO_CONFIG_URES
    select RHINO_CONFIG_UCLI
    select RHINO_CONFIG_UFS if AOS_KERNEL_MODE
    select RHINO_CONFIG_UTCPIP if AOS_KERNEL_MODE
    select RHINO_CONFIG_UCALLBACK
    select RHINO_CONFIG_UIPC if AOS_KERNEL_MODE
    select AOS_COMP_IRQ
    select RHINO_CONFIG_VFS_SYSCALL
    select RHINO_CONFIG_USER_SPACE
    help
        **haas100** is hardware board base on [AliOS-Things](https://github.com/alibaba/AliOS-Things), with a variety of peripherals. The chip's mcu is HAAS1000. The HAAS1000 is a AIoT chip specifically designed for smart home & audio application, such as smart speakers.

if AOS_BOARD_HAAS100_MK
# Configurations for board haas100
config LITTLE_FS_VER
    string  "little fs image version"
    default "fs_v1.0.0"

config CONFIG_WORK_WITH_WIFI
    bool
    select CONFIG_AOS_TCPIP if CONFIG_WORK_WITH_WIFI

config CONFIG_WORK_WITH_ETH
    bool
    select AOS_COMP_SAL if CONFIG_WORK_WITH_ETH
    select CONFIG_NO_TCPIP if CONFIG_WORK_WITH_ETH

config CONFIG_WORK_WITH_LTE
    bool
    select AOS_COMP_SAL if CONFIG_WORK_WITH_LTE
    select CONFIG_NO_TCPIP if CONFIG_WORK_WITH_LTE

config CONFIG_IRQ_SYSCALL
    bool
        default y

config CONFIG_IOMAP_SYSCALL	
    bool
    default y	

choice
    prompt "physical network selection"
    help
        Select WiFi or ethernet

    config CONFIG_WORK_WITH_WIFI
        bool "ENABLE Soc WiFi"

    config CONFIG_WORK_WITH_ETH
        bool "ENABLE Ethernet"
    
    config CONFIG_WORK_WITH_LTE
        bool "Enable LTE Module(default EC20)"

endchoice

source "vendor/haas/board/haas100-mk/board_test/Config.in"
source "vendor/haas/board/haas100-mk/config/partition/Config.in"

endif
```

## vendor/haas/board/haas100-mk/board_test/Config.in
```kconfig
config AOS_APP_BOARD_TEST
    bool "board_test"
    select AOS_COMP_OSAL_AOS if !AOS_CREATE_PROJECT
    select AOS_COMP_NETMGR if !AOS_CREATE_PROJECT
    select AOS_NET_WITH_WIFI if !AOS_CREATE_PROJECT
    help
        HAAS100 board test

if AOS_APP_BOARD_TEST
# Configurations for haas100 board test
endif
```

## vendor/haas/board/haas100-mk/config/partition/Config.in
```kconfig
config AOS_BOARD_V_PARTITION_DRV
    bool "partition_conf"
    help
        partition config.
```

## vendor/haas/mcu/Config.in
```kconfig
config AOS_MCU_HAAS1000
    bool
    select AOS_ARCH_ARMV8M_MK
    select AOS_COMP_RHINO
    select AOS_COMP_NETMGR  if !AOS_KERNEL_MODE
    select AOS_COMP_LWIP
    select CONFIG_MODERN_NETMGR if AOS_COMP_NETMGR
    select PING_ENABLED if AOS_COMP_LWIP
    select DNSCLI_ENABLED if AOS_COMP_LWIP
    select ARPCLI_ENABLED if AOS_COMP_LWIP
    select SENDFILE_ENABLED if AOS_COMP_LWIP
    select LSFDCLI_ENABLED if AOS_COMP_LWIP
    select ULOG_CONFIG_ASYNC if AOS_COMP_ULOG
    select ULOG_CONFIG_SYSLOG_TIME_FORMAT if AOS_COMP_ULOG
    select AOS_COMP_CPLUSPLUS
    select AOS_COMP_DEVICEVFS
    help
      driver & sdk for platform/mcu haas1000

if AOS_MCU_HAAS1000
# Configurations for mcu haas1000
endif

source vendor/haas/mcu/aos/aos_vendor_cli_cmd/Config.in
source vendor/haas/mcu/hal/pwm/Config.in
source vendor/haas/mcu/hal/gpio/Config.in
source vendor/haas/mcu/hal/uart/Config.in
source vendor/haas/mcu/hal/spi/Config.in
source vendor/haas/mcu/hal/i2c/Config.in
source vendor/haas/mcu/hal/flash/Config.in
source vendor/haas/mcu/hal/adc/Config.in
source vendor/haas/mcu/hal/sd/Config.in
source vendor/haas/mcu/hal/wifi/Config.in
source vendor/haas/mcu/hal/regs/Config.in
source vendor/haas/mcu/drivers/Config.in
source vendor/haas/mcu/hal/ubase/Config.in
source vendor/haas/mcu/ota/Config.in
```

## vendor/haas/mcu/aos/aos_vendor_cli_cmd/Config.in
```kconfig
config AOS_MCU_AOS_VENDOR_CLI
    bool
    select AOS_COMP_CLI
    help
      vendor shell command
```

## vendor/haas/mcu/drivers/Config.in
```kconfig
config AOS_MCU_V_COMMON_DRV
    bool "aos_mcu_v_common_drv"
    help
        common driver for haas1000.
```

## vendor/haas/mcu/hal/flash/Config.in
```kconfig
config AOS_MCU_V_FLASH_DRV
    select AOS_MCU_V_COMMON_DRV
    select AOS_MCU_V_REG_DRV
    select AOS_BOARD_V_PARTITION_DRV
    select AOS_MCU_OTA_ADAPT
    bool "aos_mcu_v_flash_drv"
    help
        flash haas1000.
```

## vendor/haas/mcu/hal/gpio/Config.in
```kconfig
config AOS_MCU_V_GPIO_DRV
    select AOS_MCU_V_COMMON_DRV
    select AOS_MCU_V_REG_DRV
    select AOS_BOARD_V_PARTITION_DRV
    bool "aos_mcu_v_gpio_drv"
    help
        gpio haas1000.
```
