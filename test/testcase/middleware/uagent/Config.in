## test/testcase/middleware/uagent/Config.in
```kconfig
menu "uagent Testcase Configuration"

source "test/testcase/middleware/uagent/uagent/Config.in"

endmenu
```

## test/testcase/middleware/uagent/uagent/Config.in
```kconfig
config AOS_COMP_UAGENT_TEST
    bool "UAGENT Testcase"
    select AOS_COMP_UAGENT
    select AOS_COMP_NETMGR
    select AOS_COMP_CLI
    select AOS_COMP_CJSON
    select AOS_COMP_SDK_MQTT
    default n
    help
```

## test/testcase/middleware/ulocation_test/Config.in
```kconfig
config AOS_COMP_ULOCATION_TEST
    bool "ULOCATION Testcase"
    select AOS_COMP_ULOCATION
    select AOS_COMP_NETMGR
    select AOS_COMP_CLI
    select AOS_COMP_CJSON 
    default n
    help
```

## test/testcase/network/Config.in
```kconfig
menu "Network Testcase Configuration"

source "test/testcase/network/lwip/Config.in"
source "test/testcase/network/ble/host/Config.in"
source "test/testcase/network/ble/mesh/Config.in"
source "test/testcase/network/websoc/Config.in"

endmenu
```

## test/testcase/network/ble/Config.in
```kconfig
config AOS_COMP_BLE_TEST
    bool "BLE YTS Testcase"
    select AOS_COMP_BT_PROFILE
    select AOS_COMP_BT_HOST
    select AOS_COMP_CLI
    select AOS_COMP_YLOOP
    default n
    help
```

## test/testcase/network/ble/host/Config.in
```kconfig
config AOS_COMP_BLE_TEST
    bool "BLE host YTS Testcase"
    select AOS_COMP_BT_PROFILE
    select AOS_COMP_BT_HOST
    select AOS_COMP_CLI
    select AOS_COMP_YLOOP
    default n
    help

if AOS_COMP_BT_HOST
config BLE
    int #"BLE func switch"
    range 0 1
    default 1
endif
```

## test/testcase/network/ble/mesh/Config.in
```kconfig
config AOS_COMP_BLE_MESH_TEST
    bool "BLE mesh YTS Testcase"
    select AOS_COMP_BT_MESH
    select AOS_COMP_CLI
    select AOS_COMP_YLOOP
    select BLE
    help

if AOS_COMP_BT_MESH

config EN_BT_SMP
    int #"BLE smp switch"
    range 0 1
    default 1

config en_mesh_shell
    bool #"mesh shell support"
    default y

endif
```

## test/testcase/network/coap/Config.in
```kconfig
config AOS_COMP_COAP_YTS_TEST
    bool "COAP YTS Testcase"
    select AOS_COMP_COAP
    default n
```

## test/testcase/network/http/Config.in
```kconfig
config AOS_COMP_HTTP_YTS_TEST
    bool "Http YTS Testcase"
    select AOS_COMP_NETMGR
    select AOS_COMP_YLOOP
    select AOS_COMP_HTTP
    select AOS_COMP_LWIP
    select AOS_COMP_CLI
    help
        HTTP YTS TEST

if AOS_COMP_HTTP_YTS_TEST
config CONFIG_HTTP_SECURE
    bool "Support HTTP Secure"
    default n
    select AOS_COMP_MBEDTLS
endif
```

## test/testcase/network/libsrtp/Config.in
```kconfig
config AOS_COMP_SRTP_YTS_TEST
    bool "Srtp YTS Testcase"
    select AOS_COMP_NETMGR
    select AOS_COMP_YLOOP
    select AOS_COMP_SRTP
    select AOS_COMP_CLI
    select CONFIG_AOS_TCPIP
    help
        SRTP YTS TEST
```

## test/testcase/network/lwip/Config.in
```kconfig
config AOS_COMP_LWIP_TEST
    bool "LwIP YTS Testcase"
    select CONFIG_AOS_TCPIP
    default n
    help
```

## test/testcase/network/lwm2m/Config.in
```kconfig
config AOS_COMP_LWM2M_YTS_TEST
    bool "LWM2M YTS Testcase"
    select AOS_COMP_LWM2M
    default n
    help
```

## test/testcase/network/netmgr/Config.in
```kconfig
config AOS_COMP_NETMGR_YTS_TEST
    bool "netmgr YTS Testcase"
    select AOS_COMP_NETMGR
    default n
    help
```

## test/testcase/network/rtp/Config.in
```kconfig
config AOS_COMP_RTP_YTS_TEST
    bool "Rtp YTS Test"
    select AOS_COMP_NETMGR
    select AOS_COMP_CLI
    select AOS_COMP_YLOOP
    select AOS_COMP_RTP
    select AOS_COMP_OSAL_POSIX
    help
        RTP YTS TEST
```

## test/testcase/network/websoc/Config.in
```kconfig
config AOS_COMP_WEBSOC_YTS_TEST
    bool "Websocket YTS Testcase"
    select AOS_COMP_WEBSOC
    default n
    help
```

## test/testcase/network/yloop/Config.in
```kconfig
config AOS_COMP_YLOOP_YTS_TEST
    bool "Yloop YTS Testcase"
    select AOS_COMP_YLOOP
    default n
    help
```

## test/testcase/osal/Config.in
```kconfig
menu "OSAL Testcase Configuration"

## --- Generated Automatically ---
source "test/testcase/osal/aos/Config.in"
source "test/testcase/osal/posix/Config.in"
source "test/testcase/osal/cmsis/Config.in"
## --- End ---

endmenu
```

## test/testcase/osal/aos/Config.in
```kconfig
config AOS_COMP_OSAL_AOS_TEST
    bool "OSAL AOS Testcase"
    select AOS_COMP_RHINO
    select AOS_COMP_OSAL_AOS
    default n
    help
```

## test/testcase/osal/cmsis/Config.in
```kconfig
config AOS_COMP_OSAL_CMSIS_TEST
    bool "OSAL CMSIS Testcase"
    select AOS_COMP_OSAL_CMSIS
    default n
    help
```

## test/testcase/osal/posix/Config.in
```kconfig
menuconfig AOS_COMP_POSIX_TEST
    bool "posix_test"
    default n
    select AOS_COMP_OSAL_POSIX
    help

if AOS_COMP_POSIX_TEST
# Configurations for comp posix_test
endif
```

## test/testcase/osal_test/Config.in
```kconfig
menuconfig AOS_COMP_OSAL_TEST
    bool "osal_test"
    default n
    select AOS_COMP_OSAL
    help

if AOS_COMP_OSAL_TEST
# Configurations for comp osal_test
endif
```

## test/testcase/osal_test/aos/Config.in
```kconfig
menuconfig AOS_COMP_OSAL_AOS_TEST
    bool "osal_aos_test"
    default n
    select AOS_COMP_OSAL_AOS_TEST
    help

if AOS_COMP_OSAL_AOS_TEST
# Configurations for comp osal_aos_test
endif
```

## test/testcase/osal_test/posix/Config.in
```kconfig
menuconfig AOS_COMP_OSAL_POSIX_TEST
    bool "osal_posix_test"
    default n
    select AOS_COMP_OSAL_POSIX_TEST
    help

if AOS_COMP_OSAL_POSIX_TEST
# Configurations for comp osal_posix_test
endif
```

## test/testcase/security/id2_test/Config.in
```kconfig
menuconfig AOS_COMP_ID2_TEST
    bool "id2_test"
    default n
    select AOS_COMP_IROT
    select AOS_COMP_ID2
    help

if AOS_COMP_ID2_TEST
# Configurations for comp id2_test
endif
```

## test/testcase/security/tls_test/Config.in
```kconfig
menuconfig AOS_COMP_TLS_TEST
    bool "tls_test"
    default n
    select AOS_COMP_MBEDTLS
    help

if AOS_COMP_TLS_TEST
# Configurations for comp tls_test
endif
```
