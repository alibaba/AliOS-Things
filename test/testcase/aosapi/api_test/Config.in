## test/testcase/aosapi/api_test/Config.in
```kconfig
menuconfig AOS_COMP_API_TEST
    bool "api_test"
    default n
    select AOS_COMP_RHINO
    help

if AOS_COMP_API_TEST
# Configurations for comp api_test
endif
```

## test/testcase/certificate/Config.in
```kconfig
menu "Certificate Testcase Configuration"

source "test/testcase/certificate/certificate_test/Config.in"

endmenu
```

## test/testcase/certificate/certificate_test/Config.in
```kconfig
config AOS_COMP_CERTIFICATE_TEST
    bool "Certificate_Test Testcase"
    default n
    help
```

## test/testcase/certificate_test/Config.in
```kconfig
menuconfig AOS_COMP_CERTIFICATE_TEST
    bool "certificate_test"
    default n
    select AOS_COMP_KV
    select AOS_COMP_YLOOP
    select AOS_COMP_RHINO
    help

if AOS_COMP_CERTIFICATE_TEST
# Configurations for comp certificate_test
endif
```

## test/testcase/framework/alink_test/Config.in
```kconfig
menuconfig AOS_COMP_ALINK_TEST
    bool "alink_test"
    default n
    select AOS_COMP_PROTOCOL
    select AOS_COMP_YWSS
    help

if AOS_COMP_ALINK_TEST
# Configurations for comp alink_test
endif
```

## test/testcase/framework/coap_test/Config.in
```kconfig
menuconfig AOS_COMP_COAP_TEST
    bool "coap_test"
    default n
    help

if AOS_COMP_COAP_TEST
# Configurations for comp coap_test
endif
```

## test/testcase/framework/fota_test/Config.in
```kconfig
menuconfig AOS_COMP_FOTA_TEST
    bool "fota_test"
    default n
    select AOS_COMP_OTA
    help

if AOS_COMP_FOTA_TEST
# Configurations for comp fota_test
endif
```

## test/testcase/framework/netmgr_test/Config.in
```kconfig
menuconfig AOS_COMP_NETMGR_TEST
    bool "netmgr_test"
    default n
    help

if AOS_COMP_NETMGR_TEST
# Configurations for comp netmgr_test
endif
```

## test/testcase/framework/uData_test/Config.in
```kconfig
menuconfig AOS_COMP_UDATA_TEST
    bool "uData_test"
    default n
    select AOS_COMP_COMMON
    select AOS_COMP_UDATA
    help

if AOS_COMP_UDATA_TEST
# Configurations for comp uData_test
endif
```

## test/testcase/framework/udata_test/Config.in
```kconfig
menuconfig AOS_COMP_UDATA_TEST
    bool "udata_test"
    default n
    select AOS_COMP_COMMON
    select AOS_COMP_UDATA
    help

if AOS_COMP_UDATA_TEST
# Configurations for comp udata_test
endif
```

## test/testcase/framework/wifi_hal_test/Config.in
```kconfig
menuconfig AOS_COMP_WIFI_HAL_TEST
    bool "wifi_hal_test"
    default n
    help

if AOS_COMP_WIFI_HAL_TEST
# Configurations for comp wifi_hal_test
endif
```

## test/testcase/kernel/Config.in
```kconfig
menu "Kernel Testcase Configuration"

## --- Generated Automatically ---
source "test/testcase/kernel/rhino/Config.in"
source "test/testcase/kernel/realtime/Config.in"
source "test/testcase/kernel/fs/kv/Config.in"
source "test/testcase/kernel/fs/fatfs/Config.in"
source "test/testcase/kernel/vfs/Config.in"
## --- End ---

endmenu
```

## test/testcase/kernel/cmsis_test/Config.in
```kconfig
menuconfig AOS_COMP_CMSIS_TEST
    bool "cmsis_test"
    default n
    select AOS_COMP_CMSIS_TEST
    help

if AOS_COMP_CMSIS_TEST
# Configurations for comp cmsis_test
endif
```

## test/testcase/kernel/deviceIO/Config.in
```kconfig
menuconfig AOS_COMP_DEVICEIO_TEST
    bool "deviceIO_test"
    default n
    help

if AOS_COMP_DEVICEIO_TEST
# Configurations for comp deviceIO_test
endif
```

## test/testcase/kernel/fs/fatfs_test/Config.in
```kconfig
menuconfig AOS_COMP_FATFS_TEST
    bool "fatfs_test"
    default n
    select AOS_COMP_FATFS
    help

if AOS_COMP_FATFS_TEST
# Configurations for comp fatfs_test
endif
```

## test/testcase/kernel/fs/kv/Config.in
```kconfig
config AOS_COMP_KV_TEST
    bool "KV Testcase"
    select AOS_COMP_KV
    default n
    help
```

## test/testcase/kernel/fs/ramfs/Config.in
```kconfig
config AOS_COMP_RAMFS_TEST
    bool "RAMFS Testcase"
    select AOS_COMP_RAMFS
    default n
    help
```

## test/testcase/kernel/lib/rbtree/Config.in
```kconfig
config AOS_COMP_RBTREE_TEST
    bool "RBTREE Testcase"
    select AOS_COMP_LIB_RBTREE
    default n
    help
```

## test/testcase/kernel/modules/kv_test/Config.in
```kconfig
menuconfig AOS_COMP_KV_TEST
    bool "kv_test"
    default n
    select AOS_COMP_KV
    help

if AOS_COMP_KV_TEST
# Configurations for comp kv_test
endif
```

## test/testcase/kernel/realtime/Config.in
```kconfig
config AOS_COMP_REALTIME_TEST
    bool "Realtime Testcase"
    select AOS_COMP_RHINO
    default n
    help
```

## test/testcase/kernel/rhino/Config.in
```kconfig
config AOS_COMP_RHINO_TEST
    bool "Rhino Testcase"
    select AOS_COMP_RHINO
    default n
    help
```

## test/testcase/kernel/vfs/Config.in
```kconfig
config AOS_COMP_VFS_TEST
    bool "VFS Testcase"
    select AOS_COMP_VFS
    default n
    help
```

## test/testcase/kernel/vfs_test/Config.in
```kconfig
menuconfig AOS_COMP_VFS_TEST
    bool "vfs_test"
    default n
    select AOS_COMP_VFS
    help

if AOS_COMP_VFS_TEST
# Configurations for comp vfs_test
endif
```

## test/testcase/kernel/yloop_test/Config.in
```kconfig
menuconfig AOS_COMP_YLOOP_TEST
    bool "yloop_test"
    default n
    select AOS_COMP_YLOOP
    help

if AOS_COMP_YLOOP_TEST
# Configurations for comp yloop_test
endif
```
