## components/utilities/Config.in
```kconfig
menu "utilities Configurations"

source "./components/utilities/cjson/Config.in"
source "./components/utilities/sntp/Config.in"
source "./components/utilities/md5sum/Config.in"
source "./components/utilities/iobox/Config.in"

endmenu
```

## components/utilities/cjson/Config.in
```kconfig
config AOS_COMP_GENIE_CJSON
    bool "cjson"
    default n
    help
        genie component cjson
```

## components/utilities/cmake_comp/Config.in
```kconfig
#
# The configs required by AliOS Things
#
config AOS_COMP_CMAKE_COMP
    bool "cmake comp enable"
    default n

menu "cmake_comp configuration"
# Add component configs here ...


# optional dependency component selection sample
#config CMAKE_COMP_CONDITIION1
#   bool "Enable optional_comp_name"
#   default n
#   help

endmenu
```

## components/utilities/iobox/Config.in
```kconfig
menuconfig AOS_COMP_IOBOX
    bool "iobox"
    default n
    help

if AOS_COMP_IOBOX
# Configurations for component iobox
endif
```

## components/utilities/md5sum/Config.in
```kconfig
menuconfig AOS_COMP_MD5SUM
    bool "md5sum"
    default n
    help

if AOS_COMP_MD5SUM
# Configurations for component md5sum
endif
```

## components/utilities/parttools/Config.in
```kconfig
menuconfig AOS_COMP_PARTTOOLS
    bool "parttools"
    default n
    help

if AOS_COMP_PARTTOOLS
# Configurations for component parttools
endif
```

## components/utilities/sntp/Config.in
```kconfig
config AOS_COMP_SNTP
    bool "sntp"
    default n
    select AOS_COMP_LWIP
    help
        AliOS Things sntp
```

## components/utility/SDL2/Config.in
```kconfig
config AOS_COMP_SDL2
    bool "SDL2"
    default n
    help
      enable SDL2 lib

if AOS_COMP_SDL2
# Configurations for SDL2
endif
```

## components/utility/at/Config.in
```kconfig
if AOS_CREATE_PROJECT
config AOS_COMP_AT
    bool
    default y
endif

# Backward compatibility
if !AOS_CREATE_PROJECT
config AOS_COMP_AT
    bool "at"
    default n
    help
       AT component
endif

###################################################################
# Component configuration items
menu "AT Configuration"
depends on AOS_COMP_AT

config AOS_ATCMD
    bool "AOS ATCMD"
    default y
    help
       AOS ATCMD

config ATPSR_DEV_MAX_NUM
    int "max dev num"
    default 1
    help
       max dev num

config AT_TASK_DEFAULT_WAIT_TIME_MS
    int "AT send task wait timeout ms"
    default 5000
    help
       AT send task wait timeout ms

config AT_SEND_RECV_DEFAULT_TIMEOUT_MS
    int "AT recv timeout ms"
    default 1000
    help
       AT recv timeout ms

config AT_SEND_DEFAULT_PROMPT_TIMEOUT_MS
    int "AT send wait prompt timeout ms"
    default 200
    help
       AT send wait prompt timeout ms

endmenu
```

## components/utility/cjson/Config.in
```kconfig
config AOS_COMP_CJSON
    bool "cJSON library"
    default n
    help
        cJSON aims to be the dumbest possible parser that you can get your job done with.
```

## components/utility/jpeg/Config.in
```kconfig
if AOS_CREATE_PROJECT
config AOS_COMP_JPEG
    bool
    default y
endif

if !AOS_CREATE_PROJECT
config AOS_COMP_JPEG
    bool "JPEG Support"
    default n
    help
        jpeg decoder and encoder library support
endif
```

## components/utility/rbtree/Config.in
```kconfig
if AOS_CREATE_PROJECT
config AOS_COMP_LIB_RBTREE
    bool
    default y
endif

if !AOS_CREATE_PROJECT
config AOS_COMP_LIB_RBTREE
    bool "rbtree code"
    default y
    help
        red-black tree
endif

if AOS_COMP_LIB_RBTREE

endif
```

## components/utility/yloop/Config.in
```kconfig
if AOS_CREATE_PROJECT
config AOS_COMP_YLOOP
    bool
    select AOS_COMP_VFS
    default y
endif

# Backward compatibility
if !AOS_CREATE_PROJECT
config AOS_COMP_YLOOP
    bool "http"
    default n
    select AOS_COMP_VFS
    help
        AliOS things event notifications
endif

###################################################################
# Component configuration items
```

## components/uvoice/Config.in
```kconfig
config AOS_COMP_UVOICE
    bool "uVoice Support"
    default n
    select AOS_COMP_OSAL_AOS
    select AOS_COMP_KV
    select AOS_COMP_FATFS
    help
      Audio component
```

## components/wireless/bluetooth/ble/breeze/Config.in
```kconfig
menuconfig AOS_COMP_BREEZE
    bool "Breeze SDK"
    default n
    help
      AliOS things Breeze SDK

if AOS_COMP_BREEZE
# Configurations for comp breeze

    config CONFIG_AIS_SECURE_ADV
        bool "Enable secure and sequential advertising."
        default n

    config CONFIG_MODEL_SECURITY
        bool "Enable auth per product, otherwise auth for per device."
        default n

    config EN_COMBO_NET
        bool "Enable AWSS, providing secured ble link for wifi provision."
        default n

    config EN_AUTH
        bool "Enable authentication."
        default y

    if EN_AUTH
        config EN_AUTH_OFFLINE
            bool "Authentication offline, otherwise online"
            default n
    
        config BZ_AUTH_TIMEOUT
            int "Authentation Timeout, ms"
            default 10000

    endif
   
    config BZ_TRANSPORT_TIMEOUT
        int "Transportion Timeout, ms"
        default 10000

    config BZ_VERSION
        string #"Auto Version", invisiable
        default "2.0.6" if CONFIG_COMP_BZ_EN_AUTH_OFFLINE
        default "2.0.5"

    config EN_LONG_MTU
        bool "Extend MTU from default 20 bytes to long MTU."
        default n

    #MTU configurations
    config GATT_MTU_SIZE_DEFAULT
        int
        default 23
    config BZ_MTU_SIZE_DEFAULT
        int
        default 20
    config ENCRYPT_DATA_SIZE
        int
        default 16
    config BZ_MTU_SIZE_LIMIT
        int
        default 128
    config GATT_MTU_SIZE_LIMIT
        int
        default 135
    config BZ_MAX_PAYLOAD_SIZE
        int
        default 2048 if EN_LONG_MTU
        default 256

    config BZ_TRANSPORT_VER
        int #"Autoset version", invisiable
        default 1 if EN_LONG_MTU
        default 0

    config BZ_BLUETOOTH_VER
        int #bt version, 0-4.0;1-4.2;2-5.0
        range 0 2
        default 1

    config BZ_MAX_SUPPORTED_MTU
        int #support MTU
        default 247

    config CONFIG_COMP_BZ_BUILTIN_HAL
        bool "Enable default built-in HALs:blestack, AliOS Things and crypto."
        default y


endif
```

## components/wireless/bluetooth/ble/breeze/ref-impl/Config.in
```kconfig
config AOS_COMP_BREEZE_HAL
    bool
    default n
    help

if AOS_COMP_BREEZE_HAL
# Configurations for comp bt_breeze_hal

     config CONFIG_COMP_BZ_HAL_BLESTACK
 	bool #"Enable built-in BLE stack"
 	default y

     config CONFIG_COMP_BZ_HAL_CRYPTO_MEBDTLS
        bool #"Enable built-in crypto"
        default n

endif
```

## components/wireless/bluetooth/ble/host/Config.in
```kconfig
if AOS_CREATE_PROJECT
config AOS_COMP_BT_HOST
    bool
    default y
    help

endif

if !AOS_CREATE_PROJECT
config AOS_COMP_BT_HOST
    bool #"BLE Host stack"
    default n
    help

endif

menu "BLE host configuration"
depends on AOS_COMP_BT_HOST

config CONFIG_BT_SMP
    bool "Enable BLE SMP"
    default n
    help
        Enable Security Manager Protocal(SMP) module for BLE pairing.

endmenu
```

## components/wireless/bluetooth/ble/host/bt_common/Config.in
```kconfig
config AOS_COMP_BT_COMMON
    bool 
    default n
    help
      AliOS Things NETWORK - Bluetooth common utilities (queue, timer, fifo, etc.)

if AOS_COMP_BT_COMMON
# Configurations for comp bt_common
endif
```

## components/wireless/bluetooth/blemesh/Config.in
```kconfig
if AOS_CREATE_PROJECT
config AOS_COMP_BT_MESH
    bool "Bluetooth Mesh Stack"
    default y
	help
	  AliOS Things NETWORK - Bluetooth Mesh component
endif

if !AOS_CREATE_PROJECT
config AOS_COMP_BT_MESH
    bool "BLE Mesh Stack"
    default n
	help
	  AliOS Things NETWORK - Bluetooth Mesh component
endif

menu "BLE mesh configuration"
depends on AOS_COMP_BT_MESH

# Configurations for comp bt_mesh
config CONFIG_BT_MESH
    bool
    default y
    help
        Enable this option for bt mesh components

config CONFIG_BT_MESH_PB_GATT
	bool "Enable Provisioning over GATT (PB_GATT)"
	select CONFIG_BT_MESH_PROXY
	select CONFIG_BT_MESH_PROV
	default n
	help
	  Enable this option to allow the device to be provisioned over
	  GATT.
config CONFIG_BT_MESH_PROXY
    bool
    default n
    default y if CONFIG_BT_MESH_PB_GATT

config CONFIG_BT_MESH_GATT_PROXY
	bool "Enable GATT Proxy Service (GATT_PROXY)"
	select CONFIG_BT_MESH_PROXY
	default n
	help
	  This option enables support for the Mesh GATT Proxy Service,
	  i.e. the ability to act as a proxy between a Mesh GATT Client
	  and a Mesh network.
config CONFIG_BT_MESH_PROXY
    bool
    default n
    default y if CONFIG_BT_MESH_GATT_PROXY

config CONFIG_BT_MESH_LOW_POWER
	bool "Enable Low Power Node features (LOW_POWER)"
	default n
	help
	  Enable this option to be able to act as a Low Power Node.

config CONFIG_BT_MESH_FRIEND
	bool "Enable Friend Node features (FRIEND)"
	default n
	help
	  Enable this option to be able to act as a Friend Node.

config CONFIG_BT_MESH_CFG_CLI
	bool "Enable Configuration Client Model (CFG_CLI)"
	default n
	help
	  Enable support for the configuration client model.

config CONFIG_BT_MESH_HEALTH_CLI
	bool "Enable Health Client Model (HEALTH_CLI)"
	default n
	help
	  Enable support for the health client model.
config bt_mesh_standalone_deploy
    bool "standalone deploy"
    default n

if bt_mesh_standalone_deploy
config CONFIG_MESH_STACK_ALONE
    bool
    default y
endif

config en_mesh_shell
    bool "enable shell configuration component"
    default n
    select CONFIG_BT_MESH_HEALTH_CLI
    select CONFIG_BT_MESH_CFG_CLI

if en_mesh_shell
    config  CONFIG_BT_MESH_SHELL
        bool
        default y
endif

config CONFIG_BT_MESH_PROV
    bool
    default y
config CONFIG_BT_MESH_RELAY
    bool
    default y

endmenu
```

## components/wireless/bluetooth/bt_stack/host/Config.in
```kconfig
if AOS_CREATE_PROJECT
config AOS_COMP_BTHOST
    bool "Bluedroid Host stack"
    default n
    help

endif

if !AOS_CREATE_PROJECT
config AOS_COMP_BTHOST
    bool "Bluedroid Host stack"
    default n
    help

endif
```

## components/wireless/lorawan/Config.in
```kconfig
if AOS_CREATE_PROJECT
config AOS_COMP_LORAWAN_STACK
    bool 
    default y 
endif

if !AOS_CREATE_PROJECT
config AOS_COMP_LORAWAN_STACK
    bool "LoRaWAN Stack"
    default n 
    help

endif

menu "LoRaWAN Stack Configuration"
choice
    prompt "Enable LoRaWAN Version"
    depends on AOS_COMP_LORAWAN_STACK
    default LORAWAN_STACK_CONFIG_4_4_2

config LORAWAN_STACK_CONFIG_4_4_0
        bool "v4.4.0"
        # Backward compatibility, to be removed soon 
        select AOS_COMP_LORAWAN_4_4_0

config LORAWAN_STACK_CONFIG_4_4_2
        bool "v4.4.2"
        # Backward compatibility, to be removed soon 
        select AOS_COMP_LORAWAN_4_4_2

endchoice
endmenu
```

## components/wireless/lorawan/lorawan_4_4_0/Config.in
```kconfig
if AOS_CREATE_PROJECT
config AOS_COMP_LORAWAN_4_4_0
    bool 
    default y 
endif

if !AOS_CREATE_PROJECT
config AOS_COMP_LORAWAN_4_4_0
    bool "LoRaWAN Stack v4.4.0"
    default n 
    help

endif

if AOS_COMP_LORAWAN_4_4_0
# Configurations for comp lorawan
config CONFIG_LINKWAN_AT
    bool "Support LoRaWAN ICA AT Command Process"
    default n

config CONFIG_LINKWAN
    bool "Support LinkWAN"
    default y

config CONFIG_DEBUG_LINKWAN
    bool "Debug Log ForLinkWAN"
    default y

config REGION_CN470A
    bool "Region For CN470"
    default y

config LOW_POWER_DISABLE
    bool "Disable Low Power"
    default y

endif
```

## components/wireless/lorawan/lorawan_4_4_2/Config.in
```kconfig
config AOS_COMP_LORAWAN_4_4_2
    bool "v4.4.2"
    select AOS_COMP_OSAL_AOS
    help

if AOS_COMP_LORAWAN_4_4_2
# Configurations for comp lorawan_4_4_2
config AOS_CONFIG_ENABLE_CLASS_B
    bool "Enable Class B"
    default n

endif
```

## core/Config.in
```kconfig
source "core/rhino/Config.in"
source "core/mk/kspace/Config.in"
source "core/init/Config.in"
source "core/pwrmgmt/Config.in"
source "core/mbins/Config.in"
source "core/cplusplus/Config.in"
source "core/libc/Config.in"
source "core/cli/Config.in"
source "core/debug/Config.in"
source "core/kv/Config.in"
source "core/vfs/Config.in"
```

## core/cli/Config.in
```kconfig
menuconfig AOS_COMP_CLI
    bool "Command-Line Interface"
    default n
    help
      command-line interface

if AOS_COMP_CLI

config CLI_CONFIG_MINIMUM_MODE
    bool "Minimum Working Mode Support"
    default n
    help
        This option enables the cli minimum working mode support.
        saying "y" here is enabled the feature.
        saying "n" here is disabled.
        the default is "n"

config CLI_CONFIG_INBUF_SIZE
    int "Input buffer size (bytes)"
    default 256
    help
        This option sets the input buffer size.
        the value could be 32, 64, 128, 256, 512, 1024 ...
        the default is 256.

config CLI_CONFIG_OUTBUF_SIZE
    int "Output buffer size (bytes)"
    default 512
    help
        This option sets the output buffer size.
        the value could be 128, 256, 512, 1024, 2048 ...
        the default is 512.

config CLI_CONFIG_MAX_COMMANDS
    int "The maximum number of commands"
    default 64
    help
        This option sets the maximum number of CLI commands.
        the value could be 16, 32, ... 64, 88 ...
        the default is 64.

config CLI_CONFIG_MAX_ARG_NUM
    int "The maximum number of command arguments"
    default 16
    help
        This option sets the maximum number of command arguments.
        the value could be 4, 6, 8, 16, 20 ...
        the default is 16.

config CLI_CONFIG_MAX_ONCECMD_NUM
    int "The maximum number of commands in one line"
    default 4
    help
        This option sets the maximum number of commands in one line.
        the value could be 1, 2, 3, 4, 5 ...
        the default is 4.

config CLI_CONFIG_TASK_PRIORITY
    int "The CLI task priority"
    range 0 256
    default 60
    help
        This option sets the CLI task priority.
        the higher of the value, the lowest of the priority.
        the default is 60.

config CLI_CONFIG_TELNET_SUPPORT
    bool "Telnet Support"
    default n
    help
        This option enable the telnel support for Command-Line Interface module.
        saying "y" here enables the feature.
        saying "n" is disabled.
        the default is "n"

endif
```
