## components/ota/Config.in
```kconfig
menuconfig AOS_COMP_OTA
    bool "OTA Features"
    select MBEDTLS_CONFIG_CRYPTO_MD5 if AOS_COMP_MBEDTLS
    select AOS_COMP_CJSON
    select AOS_COMP_OTA_AGENT
    select OTA_CONFIG_BLE if AOS_COMP_BREEZE
    select CONFIG_COMP_BZ_HAL_CRYPTO_MEBDTLS if AOS_COMP_BREEZE
    select AOS_COMP_SDK_MQTT if !OTA_CONFIG_BLE && !OTA_CONFIG_SLAVE
    select AOS_COMP_HTTP    if !OTA_CONFIG_BLE && !OTA_CONFIG_SLAVE
    default n
    help


if AOS_COMP_OTA
config OTA_CONFIG_RSA
    bool "RSA Verify Support"
    default n
    help
    select Y to support RSA Verify.

if OTA_CONFIG_RSA
choice
    prompt "Select signature"
    default OTA_CONFIG_LOCAL_RSA
    help
        choose where to sign

    config OTA_CONFIG_CLOUD_RSA
        bool "cloud sign"
        help
            signature in the cloud.

    config OTA_CONFIG_LOCAL_RSA
        bool "local sign"
        help
            signature in the alios studio.
endchoice
endif

config CONFIG_AOS_OTA_AGENT
     bool "OTA agent fuction enable"
     source "components/dm/ota/ota_agent/Config.in"

config OTA_FLASH_WRITE_CACHE_SIZE
     int "write flash cache size(bytes)"
     default 1024
     help
        This option sets the ota write flash cache size for 8-byte alignment.
        This option is limited by the board memory size.
        This value could be 512 1024 2048 4096 ...
        The default value is 1024

endif
```

## components/peripherals/Config.in
```kconfig
menu "Drivers     Configuration"

source "components/peripherals/sensor/Config.in"

if AOS_COMP_SAL
choice
    prompt "SAL Drivers Configuration"
    default AOS_SAL_WIFI if BSP_EXTERNAL_WIFI_MODULE != ""

    source "components/peripherals/sal/gprs/Config.in"
    source "components/peripherals/sal/wifi/Config.in"
endchoice
endif

endmenu
```

## components/peripherals/i2c/Config.in
```kconfig
###################################################################
# Component enable/disable selection
# in the updated build system, default is y and can not be disabled
if AOS_CREATE_PROJECT
config AOS_COMP_I2C
    bool
    default y
endif

# Backward compatibility
if !AOS_CREATE_PROJECT
config AOS_COMP_I2C
    bool "I2C Device Drivers Configuration"
    default n
    help
        AliOS Things I2C
endif


###################################################################
# Component configuration items
menu "I2C Device Configuration"
depends on AOS_COMP_I2C

config SENSOR_CONFIG_I2C_MUX_ENABLE
    bool "Enable I2C MUX Enable"
    default y
    help
        Press <Y> here to add support for the muxer.



endmenu
```

## components/peripherals/i2c_muxer/Config.in
```kconfig
###################################################################
# Component enable/disable selection
# in the updated build system, default is y and can not be disabled
if AOS_CREATE_PROJECT
config AOS_COMP_I2C_MUXER_MUXER
    bool
    default y
endif

# Backward compatibility
if !AOS_CREATE_PROJECT
config AOS_COMP_I2C_MUXER
    bool "I2C Muxer Drivers Configuration"
    default n
    help
        AliOS Things I2C
endif


###################################################################
# Component configuration items
menu "I2C Muxer Configuration"
depends on AOS_COMP_I2C_MUXER

config SENSOR_CONFIG_I2C_MUX_ENABLE
    bool "Enable I2C MUX Enable"
    default y
    help
        Press <Y> here to add support for the muxer.


endmenu
```
