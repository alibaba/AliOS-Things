## components/network/libsrtp/Config.in
```kconfig
config AOS_COMP_SRTP
    bool "srtp"
    select AOS_COMP_MBEDTLS
    select MBEDTLS_CONFIG_CRYPTO_MODE_GCM if AOS_COMP_MBEDTLS
    default n
    help
        AliOS Things srtp module
```

## components/network/link_sdk/Config.in
```kconfig
config AOS_COMP_LINK_SDK
    bool "link sdk core"
    default n
    help
        Core module of Link SDK4.0

if AOS_COMP_LINK_SDK
menu "Link SDK Configurations"

config LINK_SDK_BOOTSTRAP
    bool "bootstrap"
    default n
    help
        Enable boot strap

config LINK_SDK_DATA_MODEL
    bool "data model"
    default n
    help
        Enable data model

config LINK_SDK_DEVINFO
    bool "device info"
    default n
    help
        Enable device info update

config LINK_SDK_DIAG
    bool "diag"
    default n
    help
        Enable diag

config LINK_SDK_LOGPOST
    bool "logpost"
    default n
    help
        Enable log post

config LINK_SDK_NTP
    bool "ntp"
    default n
    help
        Enable ntp

config LINK_SDK_OTA
    bool "ota"
    default n
    help
        Enable ota

config LINK_SDK_SHADOW
    bool "shadow"
    default n
    help
        Enable device shadow

config LINK_SDK_SUBDEV
    bool "sub device"
    select AOS_COMP_GENIE_CJSON
    default n
    help
        Enable sub divice

config LINK_SDK_TLS
    bool "tls"
    default y
    select AOS_COMP_MBEDTLS
    help
        Enable tls

config LINK_SDK_DYNREG_HTTP
    bool "dynamic register with http"
    default n
    help
        Enable dynamic register with http

config LINK_SDK_DYNREG_MQTT
    bool "dynamic register with mqtt"
    default n
    help
        Enable dynamic register with mqtt

endmenu
endif
```

## components/network/lorawan/Config.in
```kconfig
menuconfig AOS_COMP_LORAWAN_STACK
    bool "LoRaWAN Stack"
    default n
    help

if AOS_COMP_LORAWAN_STACK
choice
    prompt "Enable LoRaWAN Version"

source "components/network/lorawan/lorawan_4_4_0/Config.in"
source "components/network/lorawan/lorawan_4_4_2/Config.in"
endchoice
endif
```

## components/network/lwftpd/Config.in
```kconfig
config AOS_COMP_LWFTPD
    bool "lwftpd"
    default n
    select AOS_COMP_OSAL_AOS
    help
        AliOS Things FTP server
```

## components/network/lwip/Config.in
```kconfig
menuconfig AOS_COMP_LWIP
    bool "Lightweight TCP/IP Stack(LwIP)"
    default n
    help
      Support LWIP protocol stack.

      Switch to "y" leads to support LWIP protocol stack.
      Switch to "n" leads to not support LWIP protocol stacks.

if AOS_COMP_LWIP
# Configurations for comp lwip

config AF_PACKET_ENABLED
    bool "AF_PACKET Support"
    default n
    help
      support AF_PACKET socket.

      Switching to "y" leads to support AF_PACKET socket.
      Switching to "n" leads to not support AF_PACKET socket.

menu "LwIP App Configurations"
if 0
    config SNMP_ENABLED
        bool "SNMP Support"
        default n
        help
          Support SNMP module

          Switching to "y" leads to support SNMP module
          Switching to "n" leads to not support SNMP module

    config HTTPD_ENABLED
        bool "HTTPD Support"
        default n
        help
          Support HTTPD module

          Switching to "y" leads to support HTTPD module
          Switching to "n" leads to not support HTTPD module
endif

    config IPERF_ENABLED
        bool "IPERF Support"
        default n
        help
          Support IPERF module.

          Switching to "y" leads to support LWIPERF module
          Switching to "n" leads to not support LWIPERF module
if 0
    config SNTP_ENABLED
        bool "SNTP Support"
        default n
        help
          Support SNTP module

          Switching to "y" leads to support SNTP module
          Switching to "n" leads to not support SNTP module

    config MDNS_ENABLED
        bool "MDNS Support"
        default n
        help
          Support MDNS module

          Switching to "y" leads to use MDNS module.
          Switching to "n" leads to not use MDNS module.

    config NETBIOSNS
        bool "NETBIOSNS Support"
        default n
        help
          Support NETBIOSNS module

          Switching to "y" leads to support NETBIOSNS module
          Switching to "n" leads to not support NETBIOSNS module
endif
     config TFTP_ENABLED
        bool "TFTP Support"
        default n
        help
          Support TFTP module

          Switching to "y" leads to support TFTP module
          Switching to "n" leads to not support TFTP module

if TFTP_ENABLED
      config TFTP_FS
        bool "TFTP_FS Support"
        default n
        help
          Support TFTP from File System

          Switching to "y" leads to support TFTP mount to File System
          Switching to "n" leads to not support TFTP mount to File System
endif

     config TELNETD_ENABLED
        bool "TELNETD Support"
        default n
        help
          Support TELNETD module

          Switching to "y" leads to support TELNETD module
          Switching to "n" leads to not support TELNETD module

     config DHCPD_ENABLED
        bool "DHCPD Support"
        default n
        help
          Support DHCPD module

          Switching to "y" leads to support DHCPD module
          Switching to "n" leads to not support DHCPD module

     config PING_ENABLED
        bool "PING Support"
        default n
        help
          Support PING module

          Switching to "y" leads to support PING module
          Switching to "n" leads to not support PING module


     config ARPCLI_ENABLED
        bool "ARP Command Support"
        default n
        help
          Support ARP command module

          Switching to "y" leads to support ARPCLI module
          Switching to "n" leads to not support ARPCLI module
endmenu
endif
```

## components/network/lwip/rpc/client/Config.in
```kconfig
if AOS_CREATE_PROJECT
config AOS_COMP_SOCKET_RPC_CLIENT
    bool "socket rpc client"
    default n
    help
        socket rpc client implementation
endif

# Backward compatibility
if !AOS_CREATE_PROJECT
config AOS_COMP_SOCKET_RPC_CLIENT
    bool "socket rpc client"
    default n
    help
        socket rpc client implementation
endif

###################################################################
# Component configuration items
```

## components/network/lwm2m/Config.in
```kconfig
if AOS_CREATE_PROJECT
config AOS_COMP_LWM2M
    bool 
    default y
endif

# Backward compatibility
if !AOS_CREATE_PROJECT
config AOS_COMP_LWM2M
    bool "LwM2M"
    default n
    help
        AliOS Things LwM2M client
endif

###################################################################
# Component configuration items
menu "LwM2M Configuration"
depends on AOS_COMP_LWM2M

config LWM2M_BOOTSTRAP_CLIENT_SUPPORT
    bool "LwM2M Bootstrap Client"
    default n
    help
        LwM2M Bootstrap Client

if LWM2M_BOOTSTRAP_CLIENT_SUPPORT
config LWM2M_BOOTSTRAP
    bool "LwM2M bootstrap"
    default y
    help
       LwM2M bootstrap
endif

config LWM2M_LIBCOAP_ENABLED
    bool "LwM2M LibCOAP Enabled"
    default y
    # Backward compatibility, to delete soon
    select AOS_COMP_LIBCOAP
    help
       LwM2M LIBCOAP Enabled

config LWM2M_LITTLE_ENDIAN
    bool "LwM2M little endian"
    default y
    help
       LwM2M little endian

config LWM2M_CLIENT_MODE
    bool "LwM2M client mode"
    default y
    help
       LwM2M client mode

endmenu
```

## components/network/mal/Config.in
```kconfig
if AOS_CREATE_PROJECT
config AOS_COMP_MAL
    bool "mal"
    default y
endif

# Backward compatibility
if !AOS_CREATE_PROJECT
config AOS_COMP_MAL
    bool "mal"
    default n
    help
        AliOS Things mqtt adapter layer
endif


###################################################################
# Component configuration items
menu "COAP Configuration"
depends on AOS_COMP_MAL

config MAL_CONFIG_MAX_TOPIC_LEN
        int "Max topic length"
        default 128
        help
            MAX TOPIC LEN

config MAL_CONFIG_MAX_MSG_LEN
        int "Max incoming message length"
        default 256
        help
            MAX MSG LEN

if !AOS_COMP_SDK_WRAPPERS
config MAL_AOS_HAL_IMPL
        bool "MAL AOS HAL impl"
        default y
        help
           MAL AOS HAL impl
endif

config WITH_MAL
        bool "WITH MAL"
        default y
        help
           WITH MAL

config WITH_NOTCP_IP
        bool "WITH NO TCPIP"
        select CONFIG_NO_TCPIP
        default y
        help
           WITH MAL

endmenu
```

## components/network/nal/athost/Config.in
```kconfig
config AOS_COMP_ATHOST
    bool
    default n
    select AOS_COMP_LINKKIT_SDK_C if ATHOST_CONFIG_MQTT || ATHOST_CONFIG_COAP
    select AOS_COMP_SDK_MQTT if ATHOST_CONFIG_MQTT
    select COAP_COMM_ENABLED if ATHOST_CONFIG_COAP
    help
      athost for communicaiton module

if AOS_COMP_ATHOST
# Configurations for comp athost
config ATHOST_CONFIG_WIFI_MGMT
    bool "Support WIFI connect AT"
    default y

config ATHOST_CONFIG_CIP
    bool "Support TCP AT"
    default y

config ATHOST_CONFIG_MQTT
    bool "Support ICA MQTT AT"
    default y

config ATHOST_CONFIG_COAP
    bool "Support ICA COAP AT"
    depends on !ATHOST_CONFIG_MQTT
    default n

endif
```

## components/network/nal/sal/Config.in
```kconfig
config AOS_NETWORK_SAL
    bool
    default y if BSP_SUPPORT_EXTERNAL_MODULE

config AOS_COMP_SAL
    bool
    depends on AOS_NETWORK_SAL
    default y
```

## components/network/netmgr/Config.in
```kconfig
###################################################################
# Component enable/disable selection
# in the updated build system, default is y and can not be disabled
if AOS_CREATE_PROJECT
config AOS_COMP_NETMGR
    bool
    default y
# do NOT select depend component in this file
# use $(NAME)_COMPONENTS in aos.mk
endif

# Backward compatibility
if !AOS_CREATE_PROJECT
config AOS_COMP_NETMGR
    bool "netmgr"
    default n
    select AOS_COMP_KV
    select AOS_COMP_OSAL_AOS
    select AOS_COMP_YLOOP
    help
        AliOS things NETMGR -- smart config support component
endif

###################################################################
# Component configuration items
menu "NETMGR Configuration"
depends on AOS_COMP_NETMGR

if pvtest
config PREVALIDATE_TEST
    bool "Enable prevalidate test"
    default y
    help
        Enable prevalidate test
endif
endmenu

if AOS_COMP_NETMGR
# Configurations for comp netmgr
menu "Config Network Interface Types:"
    config AOS_NET_WITH_CELLULAR
        bool "Enable Netmgr with Cellular"
        default n
        help
            support net with Cellular.

    config AOS_NET_WITH_WIFI
        bool "Enable Netmgr with Wi-Fi"
        default y
        help
            support net with Wi-Fi.
endmenu

endif
```

## components/network/netmgr/netmgr_rpc/Config.in
```kconfig
config AOS_COMP_NETMGR_RPC
    bool "netmgr api for user"
    default n
    help
```

## components/network/rtp/Config.in
```kconfig
###################################################################
# Component enable/disable selection
# in the updated build system, default is y and can not be disabled
if AOS_CREATE_PROJECT
config AOS_COMP_RTP
    bool
    select AOS_COMP_MBEDTLS
    select MBEDTLS_CONFIG_CRYPTO_MODE_GCM if AOS_COMP_MBEDTLS
    default y
endif

# Backward compatibility
if !AOS_CREATE_PROJECT
config AOS_COMP_RTP
    bool "RTP"
    select AOS_COMP_MBEDTLS
    select MBEDTLS_CONFIG_CRYPTO_MODE_GCM if AOS_COMP_MBEDTLS
    default n
    help
        AliOS Things rtp module
endif

###################################################################
# Component configuration items
menu "RTP Configuration"
depends on AOS_COMP_RTP

config HAVE_SELECT
    bool "Enable select"
    default y
    help
        Enable config

config HAVE_SYS_TIME_H
    bool "Enable sys time"
    default y
    help
        Enable config

endmenu
```

## components/network/sal/Config.in
```kconfig
if AOS_CREATE_PROJECT
config AOS_COMP_SAL
    bool
    default y
endif

# Backward compatibility
if !AOS_CREATE_PROJECT
config AOS_COMP_SAL
    bool "SAL"
    default n
    help
        SAL component
endif


###################################################################
# Component configuration items
menu "SAL Configuration"
depends on AOS_COMP_SAL

config WITH_SAL
    bool "WITH SAL"
    default y
    help
       WITH SAL macro

config SAL_USE_AOS_HAL
    bool "Use AOS HAL"
    default y
    help
       Use AOS HAL

config SAL_USE_DEBUG
    bool "SAL Debug"
    default n
    help
        SAL debug mode

config SAL_DEFAULT_INPUTMBOX_SIZE
    int "SAL input box size"
    default 32
    help
        SAL DEFAULT input box size

endmenu
```

## components/network/umesh2/Config.in
```kconfig
if AOS_CREATE_PROJECT
config AOS_COMP_UMESH2
    bool "uMesh2"
    default y
    help
        AliOS Things uMesh network protocol
endif
if !AOS_CREATE_PROJECT
config AOS_COMP_UMESH2
    bool "uMesh2"
    default n
    help
        AliOS Things uMesh network protocol
endif

if AOS_COMP_UMESH2
config UMESH_WITH_DEFAULT_CORE
    bool
    default y

config UMESH_WITH_LOCAL_COMM
    bool
    default y

config UMESH_WITH_MDNS
    bool
    default y
endif
```

## components/network/umesh2/local_comm/Config.in
```kconfig
if AOS_CREATE_PROJECT
config AOS_COMP_LOCAL_COMM
    bool "local communication framework"
    default y
    help
endif
if !AOS_CREATE_PROJECT
config AOS_COMP_LOCAL_COMM
    bool "local communication framework"
    default n
    help
endif

if AOS_COMP_LOCAL_COMM
config UMESH_WITH_DEFAULT_MDNS
    bool 
    default y
endif
```

## components/network/umesh2/mdns/Config.in
```kconfig
if AOS_CREATE_PROJECT
config AOS_COMP_MDNS
    bool "mdns"
    default y
    help
        Component  mdns for local communication
endif

if !AOS_CREATE_PROJECT
config AOS_COMP_MDNS
    bool "mdns"
    default n
    help
        Component mdns for local communication
endif

if AOS_COMP_MDNS

    config MDNS_USE_YLOOP
    bool
    default y 
    help
        Use yloop to poll data
endif
```

## components/network/umesh2/umesh2_core/Config.in
```kconfig
config AOS_COMP_UMESH2_CORE
    bool "uMesh2 core"
    default n
    help
        AliOS Things uMesh network protocol

choice
prompt "umesh timer implementation selection"
default UMESH_USE_YLOOP
config UMESH_USE_YLOOP
    bool "umesh timer over yloop"
config UMESH_USE_TIMER
    bool "umesh timer over os timer"
endchoice
```

## components/network/websocket/Config.in
```kconfig
if AOS_CREATE_PROJECT
config AOS_COMP_WEBSOC
    bool
    default y
endif

# Backward compatibility
if !AOS_CREATE_PROJECT

config AOS_COMP_WEBSOC
    bool "websocket"
    default n
    help
        websocket function
endif

###################################################################
# Component configuration items
menu "websocket Configuration"
depends on AOS_COMP_WEBSOC

config WEBSOC_WITH_TLS
    bool "websocket WITH TLS"
    # Backward compatibility, to be removed soon
    select AOS_COMP_MBEDTLS
    default y
    help
       websocket WITH TLS

if WEBSOC_WITH_TLS
config WEBSOCKET_SSL_ENABLE
    bool "SSL enable"
    default y
    help
       SSL enable
endif

endmenu
```
