## components/linkkit/wifi_provision/Config.in
```kconfig
if AOS_CREATE_PROJECT
config AOS_COMP_SDK_AWSS
    bool
    select INFRA_AES
    select AWSS_DISABLE_ENROLLEE if !AWSS_SUPPORT_ZEROCONFIG
    select AWSS_DISABLE_REGISTRAR if !AWSS_SUPPORT_ZEROCONFIG
    select AWSS_SUPPORT_APLIST
    select INFRA_CJSON
    select INFRA_COMPAT

    default y
    help
        Enable providing Wifi SSID/PASSWD configration in SDK

endif

if !AOS_CREATE_PROJECT
config AOS_COMP_SDK_AWSS
    bool "FEATURE_WIFI_PROVISION_ENABLED"
    select AOS_COMP_SDK_WRAPPERS
    select INFRA_AES
    select AWSS_DISABLE_ENROLLEE if !AWSS_SUPPORT_ZEROCONFIG
    select AWSS_DISABLE_REGISTRAR if !AWSS_SUPPORT_ZEROCONFIG
    select AWSS_SUPPORT_APLIST
    select INFRA_CJSON
    select INFRA_COMPAT
    select COAP_SERVER
    select AOS_COMP_BREEZE if AWSS_SUPPORT_BLE_PROVISION

    default n
    help
        Enable providing Wifi SSID/PASSWD configration in SDK

endif

config AWSS_SUPPORT_APLIST
    bool 
    default n

config AWSS_DISABLE_ENROLLEE
    bool
    default n

config AWSS_DISABLE_REGISTRAR
    bool
    default n

config AWSS_SUPPORT_SMARTCONFIG_WPS
    bool
    default n

config AWSS_SUPPORT_DISCOVER
    bool
    default n

menu "Wifi Provision Configurations"
    depends on AOS_COMP_SDK_AWSS

    config AWSS_SUPPORT_BLE_PROVISION
        bool "FEATURE_AWSS_SUPPORT_BLE_PROVISION"
        default n
        help
            Switching on a wifi provision method based on ble breeze SDK method

    config AWSS_SUPPORT_SMARTCONFIG
        bool "FEATURE_AWSS_SUPPORT_SMARTCONFIG"
        select AWSS_SUPPORT_SMARTCONFIG_WPS
        select AWSS_SUPPORT_DISCOVER
        default y
        help
            Switching on a wifi provision method based on length-encoding

    config AWSS_SUPPORT_SMARTCONFIG_MCAST
        bool "FEATURE_AWSS_SUPPORT_SMARTCONFIG_MCAST"
        depends on AWSS_SUPPORT_SMARTCONFIG
        default y

    config AWSS_SUPPORT_ZEROCONFIG
        bool "FEATURE_AWSS_SUPPORT_ZEROCONFIG"
        select MQTT_COMM_ENABLED
        select AWSS_SUPPORT_BEACON_ANNOUNCE
        default y
        help
            Switching on a wifi provision method based on zero-config, which shares ssid/passwd between devices

    config AWSS_SUPPORT_AHA
        bool "FEATURE_AWSS_SUPPORT_AHA"
        select AWSS_SUPPORT_BEACON_ANNOUNCE
        default n
        help
            Switching on a wifi provision method based on phone-ap, which tells the ssid/passwd to the devices connected to it

    config AWSS_SUPPORT_DEV_AP
        bool "FEATURE_AWSS_SUPPORT_DEV_AP"
        default n
        help
            Switching on a wifi provision method based on device-ap, which receives the ssid/passwd from the phones connected to it

    config WIFI_PROVISION_ENABLED
        bool
        default y

    config DEV_BIND_ENABLED
        bool
        default y

    config CONFIG_YWSS
        bool
        default y

    config AWSS_SUPPORT_ADHA
        bool
        default y if AWSS_SUPPORT_ROUTER

    config ESP8266_CONFIG
        bool
        select AWSS_DISABLE_REGISTRAR
        default y if AOS_BOARD_ESP8266

     config AWSS_SUPPORT_STATIS
        bool
        default y if AOS_BOARD_DH5021A_EVB

    config MK3165_CONFIG
        bool
        select AWSS_DISABLE_REGISTRAR
        default y if AOS_BOARD_MK3165

endmenu
```

## components/little_ui/example/demo/Kconfig.txt
```kconfig
# Kconfig for lv_demos v7.4.0

menu "lv_demos configuration"

    config LV_EX_PRINTF
        bool "Enable printf-ing data in demos and examples."
    
    choice LV_EX_CHOICE
        prompt "Select the demo you want to run."
        default LV_USE_DEMO_WIDGETS

        config LV_USE_DEMO_WIDGETS
            bool "Show demo widgets."

        config LV_USE_DEMO_KEYPAD_AND_ENCODER
            bool "Demonstrate the usage of encoder and keyboard."

        config LV_USE_DEMO_BENCHMARK
            bool "Benchmark your system."

        config LV_USE_DEMO_STRESS
            bool "Stress test for LVGL."
    endchoice
    
    config LV_DEMO_WIDGETS_SLIDESHOW
        bool "Slide demo widgets automatically."
        depends on LV_USE_DEMO_WIDGETS
        default y
endmenu
```

## components/netmgr/activation/Config.in
```kconfig
config AOS_COMP_ACTIVATION
    bool
    help
      Help message for component activation
```

## components/network/Config.in
```kconfig
config AOS_COMP_NETWORK
    bool
    default y

if AOS_COMP_NETWORK
config CONFIG_AOS_TCPIP
    bool
    default n
    #Backward compatibility, will remove soon
    select AOS_COMP_LWIP if !AOS_CREATE_PROJECT

config CONFIG_VENDOR_TCPIP
    bool
    default n

config CONFIG_LINUX_TCPIP
    bool
    default n

config CONFIG_NO_TCPIP
    bool
    default n

choice
    prompt "TCP/IP Selection"
    default CONFIG_AOS_LWIP if CONFIG_AOS_TCPIP
    default CONFIG_VENDOR_LWIP if CONFIG_VENDOR_TCPIP
    default CONFIG_LINUX_IPSTACK if CONFIG_LINUX_TCPIP
    default CONFIG_NO_LWIP if CONFIG_NO_TCPIP
    help
        Select aos/vendor/linux/no tcpip

    config CONFIG_AOS_LWIP
        bool "ENABLE AOS TCP/IP"

    config CONFIG_VENDOR_LWIP
        bool "ENABLE VENDOR TCP/IP"

    config CONFIG_LINUX_IPSTACK
        bool "ENABLE LINUX TCP/IP"

    config CONFIG_NO_LWIP
        bool "DISABLE TCP/IP"
endchoice

endif
```

## components/network/bluetooth/mesh/Config.in
```kconfig
menuconfig AOS_COMP_BT_MESH
	bool "Bluetooth Mesh Stack"
	default n
	#select AOS_COMP_BT_COMMON
	#select AOS_COMP_BT_PORT
	help
	  AliOS Things NETWORK - Bluetooth Mesh component

if AOS_COMP_BT_MESH
# Configurations for comp bt_mesh
config CONFIG_BT_MESH
    bool# "Enable BT MESH"
    default y
    help
        Enable this option for bt mesh components

config CONFIG_BT_MESH_PB_GATT
	bool "Enable Provisioning over GATT (PB_GATT)"
	select CONFIG_BT_MESH_PROXY
	select CONFIG_BT_MESH_PROV
	default n
	help
	  Enable this option to allow the device to be provisioned over
	  GATT.

config CONFIG_BT_MESH_GATT_PROXY
	bool "Enable GATT Proxy Service (GATT_PROXY)"
	select CONFIG_BT_MESH_PROXY
	default n
	help
	  This option enables support for the Mesh GATT Proxy Service,
	  i.e. the ability to act as a proxy between a Mesh GATT Client
	  and a Mesh network.

config CONFIG_BT_MESH_LOW_POWER
	bool "Enable Low Power Node features (LOW_POWER)"
	default n
	help
	  Enable this option to be able to act as a Low Power Node.

config CONFIG_BT_MESH_FRIEND
	bool "Enable Friend Node features (FRIEND)"
	default n
	help
	  Enable this option to be able to act as a Friend Node.

config CONFIG_BT_MESH_CFG_CLI
	bool "Enable Configuration Client Model (CFG_CLI)"
	default n
	help
	  Enable support for the configuration client model.

config CONFIG_BT_MESH_HEALTH_CLI
	bool "Enable Health Client Model (HEALTH_CLI)"
	default n
	help
	  Enable support for the health client model.

endif
```

## components/network/coap/Config.in
```kconfig
if AOS_CREATE_PROJECT
config AOS_COMP_LIBCOAP
    bool
    select INFRA_REPORT
    select INFRA_AES if !USE_MBEDTLS
    default y
endif

# Backward compatibility
if !AOS_CREATE_PROJECT
config AOS_COMP_LIBCOAP
    bool "Coap"
    select INFRA_REPORT
    select INFRA_AES if !USE_MBEDTLS
    default n
    help
        AliOS Things coap client
endif

###################################################################
# Component configuration items
menu "COAP Configuration"
depends on AOS_COMP_LIBCOAP

config COAP_WITH_DTLS
    bool "COAP WITH DTLS"
    default y
    # Backward compatibility, to be removed soon
    select AOS_COMP_MBEDTLS
    select MBEDTLS_CONFIG_CRYPTO_MD5
    help
        COAP WITH DTLS

config COAP_WITH_ALI_AUTH
    bool "COAP WITH ALI AUTH"
    default y
    help
        COAP WITH ALI AUTHENTICATION

config WITH_LIBCOAP_DEBUG
     bool "LIBCOAP DEBUG OUTPUT"
     default y
     help
        LIBCOAP DEBUG OUTPUT

if COAP_WITH_ALI_AUTH
config BUILD_AOS
     bool "Build AOS"
     default y
     help
        Build AOS

endif

if !COAP_WITH_ALI_AUTH
config NDEBUG
     bool "No Debug Output"
     default y
     help
        No Debug

config COAP_WITH_NOAUTH
     bool "Coap without Auth"
     default y
     help
        Coap without Auth

endif

endmenu
```

## components/network/http/Config.in
```kconfig
config AOS_COMP_HTTP
    bool "http"
    default n
    help
        AliOS Things http client
```

## components/network/httpclient/Config.in
```kconfig
config AOS_COMP_HTTPC
    bool "httpc"
    default n
    select AOS_COMP_LWIP
    select AOS_COMP_MBEDTLS
    help
        AliOS Things libev
```

## components/network/httpdns/Config.in
```kconfig
config AOS_COMP_HTTPDNS
    bool "httpdns"
    default n
    select AOS_COMP_HTTP
    select AOS_COMP_CJSON
    help
        HTTP DNS function
```
