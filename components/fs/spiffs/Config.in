## components/fs/spiffs/Config.in
```kconfig
menuconfig AOS_COMP_SPIFFS
    bool "spiffs"
    default n
    help

if AOS_COMP_SPIFFS
# Configurations for component spiffs
endif
```

## components/fs/uffs/Config.in
```kconfig
if AOS_CREATE_PROJECT
config AOS_COMP_UFFS
    bool
    default y
endif

if !AOS_CREATE_PROJECT
config AOS_COMP_UFFS
    bool "uffs"
    default n
endif

menu "uffs configuration"
    depends on AOS_COMP_UFFS
# Configurations for component uffs
endmenu
```

## components/fs/yaffs2/Config.in
```kconfig
if AOS_CREATE_PROJECT
config AOS_COMP_YAFFS2
    bool
    default y
endif

if !AOS_CREATE_PROJECT
config AOS_COMP_YAFFS2
    bool "yaffs2"
    default n
endif

menu "yaffs2 configuration"
    depends on AOS_COMP_YAFFS2
# Configurations for component yaffs2
endmenu
```

## components/language/jsengine/Config.in
```kconfig
###################################################################
# Component enable/disable selection
# in the updated build system, default is y and can not be disabled
if AOS_CREATE_PROJECT
config AOS_COMP_JSENGINE
    select AOS_COMP_SDK_MQTT
    select AOS_COMP_MBEDTLS
    select MBEDTLS_CONFIG_CRYPTO_MD5
    bool 
    default y
# do NOT select depend component in this file
# use $(NAME)_COMPONENTS in aos.mk
endif

# Backward compatibility
if !AOS_CREATE_PROJECT
config AOS_COMP_JSENGINE
    select AOS_COMP_SDK_MQTT
    select AOS_COMP_MBEDTLS
    select MBEDTLS_CONFIG_CRYPTO_MD5
    bool "JSEngine"
    default n
    help
        AliOS Things JS Engine
endif


###################################################################
# Component configuration items
menu "JSEngine Configuration"
depends on AOS_COMP_JSENGINE

choice
    prompt "Choose Engine Type: "
    default JSE_ENGINE_LITE
    help
      Choose Engine Type. (Default: LiteJSE).

    config JSE_ENGINE_LITE
        bool "LiteJSE"
        help
            LiteEngine is independent develop by Alibaba.

    config JSE_ENGINE_DUKTAPE
        bool "DuktapeJSE"
        help
            Duktape is an OpenSource embeddable Javascript engine, with a focus on portability
            and compact footprint. (check https://github.com/svaarala/duktape).
endchoice

# addons configuration
source "components/language/jsengine/src/engine/Config.in"
source "components/language/jsengine/src/services/Config.in"

endmenu
```

## components/language/jsengine/src/engine/Config.in
```kconfig
menu "JSEngine Addon Modules"

menu "Core Addon Modules"

config JSE_CORE_ADDON_BUILDIN
    bool "BuildIn Module"
    default y
    help
        JSEngine js core addon of BuildIn module support

config JSE_CORE_ADDON_TIMER
    bool "TIMER"
    default y
    help
        JSEngine js core addon of timer support

config JSE_CORE_ADDON_PROCESS
    bool "PROCESS"
    default y
    help
        JSEngine js core addon of process support

config JSE_CORE_ADDON_FS
    bool "FileSystem"
    default n
    help
        JSEngine js addon of FileSystem,File.open,File.write

if JSE_ENGINE_LITE && AOS_BOARD_DEVELOPERKIT
config JSE_CORE_ADDON_GUI
    bool "GUI"
    default n
    help
        JSEngine GUI, base on LittlevGL

if JSE_CORE_ADDON_GUI
    config JSE_CORE_ADDON_GUI_LED
        bool "GUI.led"
        default y
        help
            enable led ui-component

    config JSE_CORE_ADDON_GUI_BAR
        bool "GUI.bar"
        default y
        help
            enable bar ui-component

    config JSE_CORE_ADDON_GUI_LABEL
        bool "GUI.label"
        default y
        help
            enable label ui-component

    config JSE_CORE_ADDON_GUI_CANVAS
        bool "GUI.canvas"
        default y
        help
            enable canvas ui-component
endif
endif

endmenu  #endmenu of JSE Core Addon Modules

menu "Protocol & Network & System Addon Modules"

config JSE_NET_ADDON_MQTT
    bool "MQTT"
    default y
    help
        JSEngine js addon of mqtt

config JSE_NET_ADDON_NET
    bool "NET"
    default n
    help
        JSEngine js addon of TCP

config JSE_NET_ADDON_UDP
    bool "UDP"
    default n
    help
        JSEngine js hardware addon of UDP

config JSE_NET_ADDON_HTTP
    bool "HTTP"
    default n
    help
        JSEngine js addon of HTTP

config JSE_NET_ADDON_MIIO
    bool "Miio Device"
    default n
    help
        JSEngine js device addon of miio protocol

endmenu # endmenu of JSE Protocol and Network Addon Modules

menu "Hardware Addon Modules"

config JSE_HW_ADDON_GPIO
    bool "GPIO"
    default n
    help
        JSEngine js hardware addon of GPIO control


config JSE_HW_ADDON_UART
    bool "UART"
    default n
    help
        JSEngine js hardware addon of uart

config JSE_HW_ADDON_ADC
    bool "ADC"
    default n
    help
        JSEngine js hardware addon of ADC

config JSE_HW_ADDON_DAC
    bool "DAC"
    default n
    help
        JSEngine js hardware addon of DAC


config JSE_HW_ADDON_I2C
    bool "I2C"
    default n
    help
        JSEngine js hardware addon of I2c

# config JSE_HW_ADDON_IR
#    bool "IR"
#    default n
#    help
#        JSEngine js hardware addon of IR

 config JSE_HW_ADDON_LCD
    bool "LCD"
    default n
    help
        JSEngine js hardware addon of LCD

config JSE_HW_ADDON_PWM
    bool "PWM"
    default n
    help
        JSEngine js hardware addon of PWM

config JSE_HW_ADDON_WIFI
    bool "WIFI"
    default y
    help
        JSEngine js hardware addon of WIFI

config JSE_HW_ADDON_RTC
    bool "RTC"
    default n
    help
        JSEngine js hardware addon of rtc

config JSE_HW_ADDON_WDG
    bool "WatchDog"
    default n
    help
        JSEngine js hardware addon of watchdog

endmenu
endmenu  # JS Addon Modules
```

## components/language/micropython/Config.in
```kconfig
if AOS_CREATE_PROJECT
config AOS_COMP_MICROPYTHON
    bool
    default y
endif

if !AOS_CREATE_PROJECT
config AOS_COMP_MICROPYTHON
    bool "micropython"
    default n
    help
      micropython support
endif

if AOS_COMP_MICROPYTHON
# Configurations for component micropython
endif
```

## components/linkkit/certs/Config.in
```kconfig
if AOS_CREATE_PROJECT
config AOS_COMP_SDK_CERT
    bool
    default y

endif

if !AOS_CREATE_PROJECT
config AOS_COMP_SDK_CERT
    bool
    default n

endif
```

## components/linkkit/dev_reset/Config.in
```kconfig
config AOS_COMP_SDK_RESET
    bool "FEATURE_DEVICE_RESET"
    default n
    select AOS_COMP_SDK_MQTT
    select HAL_KV
```

## components/linkkit/dev_sign/Config.in
```kconfig
if AOS_CREATE_PROJECT
config AOS_COMP_SDK_SIGN
    bool 
    default y
    select INFRA_SHA256
endif

if !AOS_CREATE_PROJECT
config AOS_COMP_SDK_SIGN
    bool 
    default n
    select INFRA_SHA256
    select AOS_COMP_SDK_WRAPPERS
endif
```

## components/linkkit/dynamic_register/Config.in
```kconfig
if AOS_CREATE_PROJECT
config DYNAMIC_REGISTER
    bool
    default y
    select INFRA_STRING
    select INFRA_HTTPC
    select INFRA_SHA256
    select SUPPORT_TLS
endif

if !AOS_CREATE_PROJECT
config DYNAMIC_REGISTER
    bool "FEATURE_DYNAMIC_REGISTER"
    default n
    select INFRA_STRING
    select INFRA_HTTPC
    select INFRA_SHA256
    select SUPPORT_TLS
    select AOS_COMP_SDK_WRAPPERS

endif
```

## components/linkkit/external/nghttp2/Config.in
```kconfig
config AOS_COMP_SDK_NGHTTP2
    bool "FEATURE_HTTP_COMM_ENABLED"
    default n
    help
       
```

## components/linkkit/http2/Config.in
```kconfig
config AOS_COMP_SDK_HTTP2
    bool "FEATURE_HTTP2_COMM_ENABLED"
    default n
    select INFRA_HTTPC
    select INFRA_SHA1
    select INFRA_TIMER
    select SUPPORT_TLS
    select ON_DAILY
    select AOS_COMP_SDK_NGHTTP2
    select FS_ENABLED
    select AOS_COMP_SDK_WRAPPERS

    help
        Establish persistent connection with AliCloud via HTTP2-stream protocol


if AOS_COMP_SDK_HTTP2
    config HTTP2_COMM_ENABLED
    bool 
    default y
endif

config FS_ENABLED
    bool
    default n
    help
        USE HAL fs api to enable file upload feature
```

## components/linkkit/iot_coap/Config.in
```kconfig
if AOS_CREATE_PROJECT
config COAP_COMM_ENABLED
    bool
    default y
    select INFRA_CJSON
    select INFRA_JSON_PARSER
    select INFRA_SHA256
    select INFRA_MD5
    select INFRA_REPORT
    select INFRA_STRING
    select COAP_PACKET
    select INFRA_AES

    help
        Establish non-persistent connection with AliCloud via CoAP-based protocol

        Switching to "y" leads to building CoAP related implementation into SDK and COAP_COMM_ENABLED included into CFLAGS
        Switching to "n" leads to keeping CoAP-based cloud connection implementations out of SDK

config COAP_SERVER
    bool
    default y
    select INFRA_MD5
    select INFRA_STRING
    select INFRA_JSON_PARSER
    select INFRA_SHA1
    select HAL_KV
    select COAP_PACKET
    select INFRA_AES

endif

if !AOS_CREATE_PROJECT
config COAP_COMM_ENABLED
    bool "FEATURE_COAP_COMM_ENABLED"
    default n
    select INFRA_CJSON
    select INFRA_JSON_PARSER
    select INFRA_SHA256
    select INFRA_MD5
    select INFRA_REPORT
    select INFRA_STRING
    select COAP_PACKET
    select INFRA_AES
    select AOS_COMP_SDK_WRAPPERS

    help
        Establish non-persistent connection with AliCloud via CoAP-based protocol

        Switching to "y" leads to building CoAP related implementation into SDK and COAP_COMM_ENABLED included into CFLAGS
        Switching to "n" leads to keeping CoAP-based cloud connection implementations out of SDK

config COAP_SERVER
    bool
    default n
    select INFRA_MD5
    select INFRA_STRING
    select INFRA_JSON_PARSER
    select INFRA_SHA1
    select HAL_KV
    select COAP_PACKET
    select INFRA_AES
    select AOS_COMP_SDK_WRAPPERS
endif
```

## components/linkkit/mqtt/Config.in
```kconfig
if AOS_CREATE_PROJECT
config AOS_COMP_SDK_MQTT
    bool
    default y
    select MQTT_PRE_AUTH if !MQTT_DIRECT
    select INFRA_SHA256
    select INFRA_LIST
    select INFRA_TIMER
    select INFRA_REPORT
    select INFRA_COMPAT
    select INFRA_REPORT

    help
        Establish persistent connection with AliCloud via MQTT-based protocol

        Switching to "y" leads to building MQTT related implementation into SDK and AOS_COMP_SDK_MQTT included into CFLAGS
        Switching to "n" seldom happens unless you're connecting to AliCloud via CoAP/HTTP channel
endif

if !AOS_CREATE_PROJECT
config AOS_COMP_SDK_MQTT
    bool "FEATURE_MQTT_COMM_ENABLED"
    default n
    select MQTT_PRE_AUTH if !MQTT_DIRECT
    select INFRA_SHA256
    select INFRA_LIST
    select INFRA_TIMER
    select INFRA_REPORT
    select INFRA_COMPAT
    select INFRA_REPORT
    select AOS_COMP_SDK_WRAPPERS

    help
        Establish persistent connection with AliCloud via MQTT-based protocol

        Switching to "y" leads to building MQTT related implementation into SDK and AOS_COMP_SDK_MQTT included into CFLAGS
        Switching to "n" seldom happens unless you're connecting to AliCloud via CoAP/HTTP channel
endif

menu "MQTT Configurations"
    depends on AOS_COMP_SDK_MQTT

    config MQTT_DEFAULT_IMPL
        bool "FEATURE_MQTT_DEFAULT_IMPL"
        default y
        select INFRA_NET

        help
            Use SDK default MQTT implementation

            Switching to "y" leads to building MQTT related implementation into SDK and MQTT_DEFAULT_IMPL included into CFLAGS
            Switching to "n" seldom happens unless you're using other MQTT implementations

    config MQTT_PRE_AUTH
        bool
        default n
        select SUPPORT_TLS
        select INFRA_HTTPC
        select INFRA_PREAUTH

    config MQTT_DIRECT
        bool "FEATURE_MQTT_DIRECT"
        default y

        help
            Directly connect MQTT server without perform HTTP authenticate to another HTTP server ahead

            Switching to "y" leads to connect MQTT server directly and MQTT_DIRECT included into CFLAGS
            Switching to "n" leads to legacy authenticate mode: connnect HTTP server first, then connect MQTT server afterwards

    config MQTT_AUTO_SUBSCRIBE
        bool
        default y

    config ASYNC_PROTOCOL_STACK
        bool "FEATURE_ASYNC_PROTOCOL_STACK"
        default n

        help
            Use async protocol stack for SDK default MQTT implementation

            Switching to "y" leads to building MQTT async protocol stack related implementation into SDK and ASYNC_PROTOCOL_STACK included into CFLAGS
            Switching to "n" seldom happens unless you're not using async protocol stack
 
    config MQTT_DYNAMIC_REGISTER
        bool "FEATURE_MQTT_DYNAMIC_REGISTER"
        default n
        depends on DYNAMIC_REGISTER
        select SUPPORT_TLS

    config MQTT_COMM_ENABLED
        bool
        default y

endmenu
```

## components/linkkit/ota/Config.in
```kconfig
if AOS_CREATE_PROJECT
config AOS_COMP_SDK_OTA
    bool 
    default y
    select INFRA_STRING
    select INFRA_JSON_PARSER
    select INFRA_HTTPC
    select INFRA_MD5
    select INFRA_SHA256
    help
        Establish persistent connection with AliCloud via HTTP-based protocol
endif

if !AOS_CREATE_PROJECT
config AOS_COMP_SDK_OTA
    bool 
    default n
    select INFRA_STRING
    select INFRA_JSON_PARSER
    select INFRA_HTTPC
    select INFRA_MD5
    select INFRA_SHA256
    help
        Establish persistent connection with AliCloud via HTTP-based protocol
endif
```
