## components/drivers/ramdrv/Config.in
```kconfig
menuconfig AOS_COMP_U_RAMDRV
    select AOS_COMP_DEVICEVFS
    bool "ram driver module"
    default n
    help
        AliOS ram test module core layer
```

## components/drivers/spi/Config.in
```kconfig
menuconfig AOS_COMP_U_SPI
    select AOS_COMP_DEVICEVFS
    bool "spi core module"
    default n
    help
        AliOS spi module core layer
```

## components/drivers/test/Config.in
```kconfig
menuconfig AOS_COMP_U_DRIVERS_UT
    bool "drivers unit test module"
    default n
    help
        AliOS druvers unit test module

source "components/drivers/test/adc/Config.in"
source "components/drivers/test/gpio/Config.in"
source "components/drivers/test/i2c/Config.in"
source "components/drivers/test/pwm/Config.in"
source "components/drivers/test/flash/Config.in"
source "components/drivers/test/qspi/Config.in"
source "components/drivers/test/spi/Config.in"
source "components/drivers/test/timer/Config.in"
source "components/drivers/test/uart/Config.in"
source "components/drivers/test/ram/Config.in"
source "components/drivers/test/wdg/Config.in"
```

## components/drivers/test/adc/Config.in
```kconfig
menuconfig AOS_COMP_U_ADC_TEST
    bool "adc core module"
    default n
    help
        AliOS adc test module
```

## components/drivers/test/dac/Config.in
```kconfig
menuconfig AOS_COMP_U_DAC_TEST
    select AOS_COMP_DEVICEVFS
    bool "dac core module"
    default n
    help
        AliOS dac test module
```

## components/drivers/test/flash/Config.in
```kconfig
menuconfig AOS_COMP_U_FLASH_TEST
    bool "flash test module"
    default n
    help
        AliOS flash test module
```

## components/drivers/test/gpio/Config.in
```kconfig
menuconfig AOS_COMP_U_GPIO_TEST
    bool "gpio core module"
    default n
    help
        AliOS gpio test module
```

## components/drivers/test/i2c/Config.in
```kconfig
menuconfig AOS_COMP_U_I2C_TEST
    bool "i2c core module"
    default n
    help
        AliOS i2c module core layer
```

## components/drivers/test/pwm/Config.in
```kconfig
menuconfig AOS_COMP_U_PWM_TEST
    bool "pwm test driver"
    default n
    help
        AliOS pwm test module
```

## components/drivers/test/qspi/Config.in
```kconfig
menuconfig AOS_COMP_U_QSPI_TEST
    bool "qspi test driver"
    default n
    help
        AliOS qspi test module
```

## components/drivers/test/ram/Config.in
```kconfig
menuconfig AOS_COMP_U_RAM_TEST
    bool "ram driver test module"
    default n
    help
        AliOS ramdriver test module
```

## components/drivers/test/spi/Config.in
```kconfig
menuconfig AOS_COMP_U_SPI_TEST
    bool "spi test driver"
    default n
    help
        AliOS spi test module
```

## components/drivers/test/timer/Config.in
```kconfig
menuconfig AOS_COMP_U_TIMER_TEST
    bool "timer test module"
    default n
    help
        AliOS timer test module
```

## components/drivers/test/uart/Config.in
```kconfig
menuconfig AOS_COMP_U_UART_TEST
    bool "uart test driver"
    default n
    help
        AliOS uart test module
```

## components/drivers/test/wdg/Config.in
```kconfig
menuconfig AOS_COMP_U_WDG
    select AOS_COMP_DEVICEVFS
    bool "watch dog core module"
    default n
    help
        AliOS watch dog module core layer
```

## components/drivers/timer/Config.in
```kconfig
menuconfig AOS_COMP_U_TIMER
    select AOS_COMP_DEVICEVFS
    bool "timer core module"
    default n
    help
        AliOS timer module core layer
```

## components/drivers/uart/Config.in
```kconfig
menuconfig AOS_COMP_U_UART
    select AOS_COMP_DEVICEVFS
    bool "uart core module"
    default n
    help
        AliOS uart module core layer
```

## components/drivers/wifi/Config.in
```kconfig
#
# The configs required by AliOS Things
#
config AOS_COMP_WIFIDEV
    bool "wifidev Enable"
    default n

menu "wifidev configuration"
# Add component configs here ...



endmenu
```

## components/fs/Config.in
```kconfig
menu "FS Configurations"

source "./components/fs/littlefs/Config.in"
source "./components/fs/romfs/Config.in"
endmenu
```

## components/fs/cramfs/Config.in
```kconfig
if AOS_CREATE_PROJECT
config AOS_COMP_CRAMFS
    bool
    default y
endif

if !AOS_CREATE_PROJECT
config AOS_COMP_CRAMFS
    bool "cramfs"
    select AOS_COMP_ZLIB
    default n
    help
endif

if AOS_COMP_CRAMFS
# Configurations for component cramfs
endif
```

## components/fs/fatfs/Config.in
```kconfig
if AOS_CREATE_PROJECT
config AOS_COMP_FATFS
    bool
    default y
endif

if !AOS_CREATE_PROJECT
config AOS_COMP_FATFS
    bool "fatfs"
    default n
endif

menu "fatfs configuration"
    depends on AOS_COMP_FATFS
# Configurations for component fatfs
endmenu
```

## components/fs/jffs2/Config.in
```kconfig
if AOS_CREATE_PROJECT
config AOS_COMP_JFFS2
    bool
    default y
endif

if !AOS_CREATE_PROJECT
config AOS_COMP_JFFS2
    bool "jffs2"
    default n
    help
endif

menu "jffs2 configuration"
    depends on AOS_COMP_JFFS2
# Configurations for component jffs2
endmenu
```

## components/fs/littlefs/Config.in
```kconfig
menuconfig AOS_COMP_LITTLEFS
    bool "littlefs"
    default n
    help

if AOS_COMP_LITTLEFS
# Configurations for component littlefs

    config CONFIG_FLASH_PAGE_SIZE
        int "The flash page size (in bytes)"
        default 4096
endif

if AOS_BOARD_HAAS100_MK
# Configurations for littlefs
    config CONFIG_LFS_BOARD_HAAS100
        bool "The LFS Runs on HaaS100 Platform"
        default y
        help
            "select LFS runs on HaaS100 platform"
endif
```

## components/fs/ramfs/Config.in
```kconfig
if AOS_CREATE_PROJECT
config AOS_COMP_RAMFS
    bool
    default y
endif

if !AOS_CREATE_PROJECT
config AOS_COMP_RAMFS
    bool "RAM File System"
    default n
    help
        a RAM file system
endif

menu "ramfs configuration"
    depends on AOS_COMP_RAMFS
# Configurations for component ramfs
endmenu
```

## components/fs/romfs/Config.in
```kconfig
menuconfig AOS_COMP_ROMFS
    bool "romfs"
    default n
    select AOS_COMP_VFS
    select VFS_CONFIG_ROOTFS
    help

if AOS_COMP_ROMFS
# Configurations for component romfs
endif
```
