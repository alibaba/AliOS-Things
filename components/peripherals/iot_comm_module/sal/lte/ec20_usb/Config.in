## components/peripherals/lcd/Config.in
```kconfig
###################################################################
# Component enable/disable selection
# in the updated build system, default is y and can not be disabled
if AOS_CREATE_PROJECT
config AOS_COMP_LCD
    bool "lcd"
    default y
# do NOT select depend component in this file
# use $(NAME)_COMPONENTS in aos.mk
endif

# Backward compatibility
if !AOS_CREATE_PROJECT
config AOS_COMP_LCD
    bool "SDL Configuration"
    default n
    help
	    AliOS Things oss
endif
```

## components/peripherals/mal/Config.in
```kconfig
config AOS_DEVICE_MAL
    bool "Enable MAL device"
    default n if BSP_SUPPORT_EXTERNAL_MODULE
    help
        Choose to support external MAL device or not

if AOS_DEVICE_MAL

choice
    prompt "MAL device selection"
    default AOS_COMP_DEVICE_MAL_SIM800
    help
        Choose which device to use as the external module.

    config AOS_MAL_NULL
        bool "Null"
    source "components/peripherals/mal/gprs/Config.in"
endchoice

endif
```

## components/peripherals/mal/gprs/sim800/Config.in
```kconfig
config AOS_COMP_DEVICE_MAL_SIM800
    bool "mal.gprs.SIM800"
    select AOS_COMP_AT
```

## components/peripherals/module/Config.in
```kconfig
if AOS_CREATE_PROJECT
config AOS_COMP_EXTERNAL_MODULE
    bool 
    default y 
endif

if !AOS_CREATE_PROJECT
config AOS_COMP_EXTERNAL_MODULE
    bool "External module enable"
    default y if BSP_SUPPORT_EXTERNAL_MODULE
    default n 
endif


choice
    prompt "External module Configurations"
    depends on AOS_COMP_EXTERNAL_MODULE
    default AOS_SAL_DEVICE

config AOS_SAL_DEVICE
        bool "SAL DEVICE"

config AOS_MAL_DEVICE
        bool "MAL MODULE"

endchoice
```

## components/peripherals/module/mal/Config.in
```kconfig
if AOS_CREATE_PROJECT
config AOS_COMP_MAL_DEVICE
    bool
    default y
    depends on AOS_MAL_DEVICE
endif

if !AOS_CREATE_PROJECT
config AOS_COMP_MAL_DEVICE
    bool
    default y
    depends on AOS_MAL_DEVICE
    select AOS_COMP_MAL
endif

choice
    prompt "MAL device selection"
    depends on AOS_COMP_MAL_DEVICE
    default AOS_MAL_GPRS_SIM800
    help
        Choose which device to use as the external module.

    config AOS_MAL_NULL
        bool "Null"
   
    config AOS_MAL_GPRS_SIM800
        bool "gprs.SIM800"

endchoice
```

## components/peripherals/module/sal/Config.in
```kconfig
if AOS_CREATE_PROJECT
config AOS_COMP_SAL_DEVICE
    bool
    default y
    depends on AOS_SAL_DEVICE
endif

if !AOS_CREATE_PROJECT
config AOS_COMP_SAL_DEVICE
    bool
    default y
    depends on AOS_SAL_DEVICE
    select AOS_COMP_SAL
endif

choice
    prompt "SAL device selection"
    depends on AOS_COMP_SAL_DEVICE
    default AOS_SAL_WIFI_BK7231
    help
        Choose which device to use as the external module.

    config AOS_SAL_NULL
        bool "Null"

    config AOS_SAL_GPRS_SIM800
        bool "gprs.SIM800"

    config AOS_SAL_LTE_M02H
        bool "lte.m02h"

    config AOS_SAL_NBIOT_M5310A
        bool "nbiot.M5310A"

    config AOS_SAL_WIFI_BK7231
        bool "wifi.bk7231"
        select AOS_COMP_NETMGR

    config AOS_SAL_WIFI_MK3060
        bool "wifi.mk3060"
        select AOS_COMP_NETMGR

endchoice
```

## components/peripherals/oled/Config.in
```kconfig
###################################################################
# Component enable/disable selection
# in the updated build system, default is y and can not be disabled
if AOS_CREATE_PROJECT
config AOS_COMP_OLED
    bool
    default y
# do NOT select depend component in this file
# use $(NAME)_COMPONENTS in aos.mk
endif

# Backward compatibility
if !AOS_CREATE_PROJECT
config AOS_COMP_OLED
    bool "OLED Configuration"
    default n
    help
	    AliOS Things OLED
endif
```

## components/peripherals/rtc/Config.in
```kconfig
###################################################################
# Component enable/disable selection
# in the updated build system, default is y and can not be disabled
if AOS_CREATE_PROJECT
config AOS_COMP_RTC
    bool
    default y
endif

# Backward compatibility
if !AOS_CREATE_PROJECT
config AOS_COMP_RTC
    bool "RTC Drivers Configuration"
    default n
    help
        AliOS Things RTC
endif


###################################################################
# Component configuration items
menu "RTC Configuration"
depends on AOS_COMP_RTC

config RTC_CONFIG_RX8310CE_ENABLE
    bool "Enable RX8310CE Enable"
    default y
    help
        Press <Y> here to add support for rtc.


endmenu
```

## components/peripherals/sal/Config.in
```kconfig
config AOS_DEVICE_SAL
    bool "Enable SAL device"
    default y if BSP_SUPPORT_EXTERNAL_MODULE
    help
        Choose to support external SAL device or not

if AOS_DEVICE_SAL

choice
    prompt "SAL device selection"
    default AOS_COMP_DEVICE_SAL_BK7231
    help
        Choose which device to use as the external module.

    config AOS_SAL_NULL
        bool "Null"
    source "components/peripherals/sal/wifi/Config.in"
    source "components/peripherals/sal/gprs/Config.in"
    source "components/peripherals/sal/lte/Config.in"
    source "components/peripherals/sal/nbiot/Config.in"
endchoice

endif
```

## components/peripherals/sal/gprs/sim800/Config.in
```kconfig
config AOS_COMP_DEVICE_SAL_SIM800
    bool "gprs.SIM800"
    select AOS_COMP_AT
    select AOS_COMP_YLOOP
```

## components/peripherals/sal/lte/m02h/Config.in
```kconfig
config AOS_COMP_DEVICE_SAL_M02H
    bool "lte.m02h"
    select AOS_COMP_ATPARSER
```

## components/peripherals/sal/nbiot/m5310a/Config.in
```kconfig
config AOS_COMP_DEVICE_SAL_M5310A
    bool "nbiot.M5310A"
    select AOS_COMP_ATPARSER
```

## components/peripherals/sal/wifi/Config.in
```kconfig
source "components/peripherals/sal/wifi/bk7231/Config.in"
#source "components/peripherals/sal/wifi/esp8266/Config.in"
#source "components/peripherals/sal/wifi/gt202/Config.in"
source "components/peripherals/sal/wifi/mk3060/Config.in"
```

## components/peripherals/sal/wifi/gt202/Config.in
```kconfig
config AOS_COMP_DEVICE_SAL_GT202
    bool "wifi.GT202"
    select AOS_COMP_ATPARSER
```
