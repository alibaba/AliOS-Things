## components/service/ucloud/oss/Config.in
```kconfig
if AOS_CREATE_PROJECT
config AOS_COMP_OSS
    bool "oss"
    select AOS_COMP_MBEDTLS
    select MBEDTLS_CONFIG_CRYPTO
    select MBEDTLS_CONFIG_CRYPTO_MD5
    default y
# do NOT select depend component in this file
# use $(NAME)_COMPONENTS in aos.mk
endif

# Backward compatibility
if !AOS_CREATE_PROJECT
config AOS_COMP_OSS
    bool "OSS Configuration"
    select AOS_COMP_MBEDTLS
    select MBEDTLS_CONFIG_CRYPTO
    select MBEDTLS_CONFIG_CRYPTO_MD5
    default n
    help
	    AliOS Things oss
endif
```

## components/service/udata/Config.in
```kconfig
config AOS_COMP_UDATA
    bool "uData Configuration"
    default n
    depends on AOS_COMP_SENSOR
    select AOS_COMP_OSAL_AOS
    select AOS_COMP_CJSON if UDATA_CONFIG_CJSON_FORMAT
    help

if AOS_COMP_UDATA
# Configurations for comp udata

config UDATA_CONFIG_CJSON_FORMAT
    bool "uData Services cJSON Configuration"
    default n
    help
        Press <Y> here to add support for uData Services cJSON Configuration.
        This depend on cJSON component.

endif
```

## components/service/ulocation/Config.in
```kconfig
###################################################################
# Component enable/disable selection
# in the updated build system, default is y and can not be disabled
if AOS_CREATE_PROJECT
config AOS_COMP_ULOCATION
    bool
    default y
# do NOT select depend component in this file
# use $(NAME)_COMPONENTS in aos.mk
endif

# Backward compatibility
if !AOS_CREATE_PROJECT
config AOS_COMP_ULOCATION
    bool "ulocation"
    default n
    help
        AliOS Things ulocation
endif

###################################################################
# Component configuration items
menu "uLocation Configuration"
depends on AOS_COMP_ULOCATION

config CONFIG_ULOCATION_GPS
    bool "use GPS sersor get location infomation"
    default y
    help
        Enable GPS module information to get location.

if CONFIG_ULOCATION_GPS
    menu "QXSI support"
        config CONFIG_QXWZ_ENABLED
            bool "QXSI"
            default n
            help
                Press <Y> here to add support for the QXSI high accuracy service.
    endmenu
endif

config CONFIG_ULOCATION_AGPS
    bool "use AGPS to assit fast location"
    default n
    help
        Enable AGPS module information to get location.

if CONFIG_ULOCATION_AGPS
menu "assist location"
    config CONFIG_ULOCATION_GPRS
        bool "GPRS"
        help
            Enable GPRS module information to get location.

    config CONFIG_ULOCATION_WIFI
        bool "WIFI"
        help
            Enable WIFI module information to get location.
endmenu
endif

endmenu
```

## components/services/Config.in
```kconfig
menu "Services Configurations"

source "./components/services/uservice/Config.in"
source "./components/services/ulog/Config.in"
source "./components/services/und/Config.in"
source "./components/services/ota/Config.in"
source "./components/services/yloop/Config.in" #deprecated
source "./components/services/select/Config.in" #deprecated

endmenu
```

## components/services/select/Config.in
```kconfig
if AOS_CREATE_PROJECT
config AOS_COMP_SELECT
    bool
    select AOS_COMP_VFS
    default y
    help
        multiplexing implementation
endif

# Backward compatibility
if !AOS_CREATE_PROJECT
config AOS_COMP_SELECT
    bool "select"
    default n
    select AOS_COMP_VFS
    help
        multiplexing implementation
endif
if AOS_COMP_SELECT
config CONFIG_SELECT_SYSCALL
    bool
    default y
    help
        enable poll/select syscall
endif
###################################################################
# Component configuration items
```

## components/services/uagent/Config.in
```kconfig
menu "uAgent Configuration"
source "kernel/components/dm/uagent/uagent/Config.in"
source "component/ulog/Config.in"
endmenu
```

## components/services/ulog/Config.in
```kconfig
menuconfig AOS_COMP_ULOG
    bool "uLog Support"
    select AOS_COMP_OSAL_AOS

    default n

if AOS_COMP_ULOG
# Configurations for component ulog

config ULOG_CONFIG_STOP_FILTER_DEFAULT
    int "Level Stop Filter of Default Direction(UART for RTOS)"
    range 0 8
    default 8
    help
        Level Stop Filter of default direction(uart for rtos), any log level qual or lower than this (value higher than it)
        will be abondoned. 0 will make none log pop out.

config ULOG_CONFIG_LOG_SIZE
    int "Max Length of Log Text"
    range 36 2048
    default 2048
    help
        The max length of every trace log to be recorded, log Content will be trimmed if it's too long.

config ULOG_CONFIG_SYSLOG_TIME_FORMAT
    bool "Support syslog Time Format when Log"
    default y
    help
        Switch on this option will make log time format follow syslog type

config ULOG_CONFIG_SYNC_LOG_DETAILS
    bool "Enable Rich Details for Log"
    default n
    help
        enable rich details for log, includes mod name, file path and line.

if ULOG_CONFIG_SYNC_LOG_DETAILS

config ULOG_CONFIG_SYNC_DETAIL_COLOR
    bool "Enable Color Font for More Details"
    default n
    help
        enable color font for more details

config ULOG_CONFIG_SYNC_ABS_PATH
    bool "Enable Log Absolute Path under Detail Mode"
    default n
    help
        enable log absolute path
endif

config ULOG_CONFIG_POP_CLOUD
     bool "Switch on Pop Out Log to Cloud"
     select AOS_COMP_UAGENT
     select ULOG_CONFIG_ASYNC
     default n
     help
        switch on/off the function that pop out log to cloud

if ULOG_CONFIG_POP_CLOUD
config ULOG_CONFIG_STOP_FILTER_CLOUD
    int "Level Stop Filter to Cloud"
    range 0 8
    default 0
    help
        Level Stop Filter of Cloud, any log level qual or lower than this (value higher than it)
        will be abondoned LOG_EMERG will make none log pop out.
endif

config ULOG_CONFIG_POP_FS
     bool "Switch on Pop Out Log Into File System"
     select ULOG_CONFIG_ASYNC
     select AOS_COMP_VFS
     select AOS_COMP_GENIE_CJSON
     default n
     help
        switch on/off the function that pop out log file into file system
        comp vfs and spiffs is necessary if switch on this function

if ULOG_CONFIG_POP_FS
config ULOG_CONFIG_STOP_FILTER_FS
    int "Level Stop Filter of FS"
    range 0 8
    default 4
    help
        Level Stop Filter of fs, any log level qual or lower than this (value higher than it)
        will be abondoned LOG_EMERG will make none log pop out.
        please keep this value on "LOG_EMERG" if you have no plan to use log out fs

choice
    prompt "Choose File System Type"
    default ULOG_CONFIG_FS_LITTLEFS
    help
        Select the type of fs which ulog recorded in.

    config ULOG_CONFIG_FS_SPIFFS
        bool "SPIFFS"

    config ULOG_CONFIG_FS_FATFS_SD
        bool "SD Card"

    config ULOG_CONFIG_FS_FATFS_FLASH
        bool "FATFS Flash"

    config ULOG_CONFIG_FS_LITTLEFS
        bool "LittleFS"
endchoice

config ULOG_CONFIG_LOCAL_FILE_CNT
    int "Max uLog Files on File System"
    default 5
    range 1 256
    help
        Max log files support in fs, if the recording file more than this value, rolling back mechanism trigged.

config ULOG_CONFIG_LOCAL_FILE_SIZE
    int "Max uLog File Size"
    default 1024000
    range 256 1024000
    help
        Max log file size locate in local file system, if the recording file larger than this value, new files will be used to be recored.

config ULOG_CONFIG_ENCODE_FS
    bool "Encode ulog to reduce size"
    default n
    help
        A special log format will be used to save log for fs .


config ULOG_CONFIG_RESERVED_FS
    bool "Reserved Log Temporary When FS is not Ready"
    default n
    help
        A FIFO queue will be used to save log for temporary until the FS is ready.

if ULOG_CONFIG_RESERVED_FS
config ULOG_CONFIG_RESERVED_FS_SIZE
    int "Count of Reserved Log When FS is not Ready"
    default 64
    range 8 256
    help
        Reserved Log Item when FS is not Ready.
endif

config ULOG_CONFIG_UPLOAD
    bool "Upload Log File via http"
    select AOS_COMP_UAGENT
    default n
    help
        Upload Log File via http.

config ULOG_CONFIG_SYNC
    bool "Sync Log File when Idle Timeout Reached or Operating File Reached"
    default y
    help
        Sync log file cyclely.
endif

if ULOG_CONFIG_SYNC
config ULOG_CONFIG_FILE_SYNC_SIZE
    int "Log Length Reached will make File Sync to File System"
    range 64 65535
    default 4096
    help
        When logs into File System reached this value, force syncing one time.
        This make the Log Files Tree update in time, avoid lost too much logs
        if unexpect shut down happens. The smaller this value setted, the higher
        frequency will exaust write flash operation.

config ULOG_CONFIG_FILE_SYNC_TIMEOUT
    int "Timeout(s) no New Log Produced Will Make Sync Logs into File by Force"
    range 0 600
    default 10
    help
        If timeout no new Log shall be pop out to FileSystem, then the accumulative
        logs is sync to Files by Froce.
        This make the Log Files Tree update in time, avoid lost too much logs
        if unexpect shut down happens. Values 0 will disable this function.
endif

config ULOG_CONFIG_POP_UDP
     bool "Switch on Pop Out Log via Syslog UDP"
     select ULOG_CONFIG_ASYNC
     default n
     help
        switch on/off the function that pop out log file via syslog udp
        do not switch on if there is no tcp/ip stack in, or sal module included
        currently only support in soc.

if ULOG_CONFIG_POP_UDP
config ULOG_CONFIG_STOP_FILTER_UDP
    int "Level Stop Filter of UDP"
    range 0 8
    default 4
    help
        Level Stop Filter of udp, any log level qual or lower than this (value higher than it)
        will be abondoned LOG_EMERG will make none log pop out.
        please keep this value on "LOG_EMERG" if you have no plan to use udp log
endif

config ULOG_CONFIG_DEFAULT_DIR_ASYNC
     bool "Using Async Mode to Log on Default Direct"
     select ULOG_CONFIG_ASYNC
     default y
     help
        switch on/off the function using async mode

config ULOG_CONFIG_ASYNC
    bool "uLog Async mode on-off"
    default y
    help
        enable ulog async mode

if ULOG_CONFIG_ASYNC
# Configurations for ulog async mode

config ULOG_CONFIG_LOG_ROUTINE_TASK_STACK_DEPTH
    int "Stack Depth of Log Task Under Async Mode"
    default 6144 if !TEST_CONFIG_GCOV_REPORT
    default 10240 if TEST_CONFIG_GCOV_REPORT
    help
        STACK DEPTH of Log Task

config ULOG_CONFIG_ASYNC_BUF_SIZE
    int "Default Size of Buffer Queue Under Async Mode"
    default 65536
    help
        Default size of buffer queue that used to record log under aync mode.
        May the trace log miss if this value was set too small.
        More RAM will be costed if it set too large
        So consider balance of this value and system resouce
endif

endif
```

## components/services/uservice/Config.in
```kconfig
config AOS_COMP_USERVICE
    bool "USERVICE"
    default n
    help
      AliOS things USERVICE component
```

## components/services/yloop/Config.in
```kconfig
config AOS_COMP_YLOOP
    bool "yloop"
    default n
    select AOS_COMP_VFS
    select AOS_COMP_SELECT
    help
      AliOS things yloop -- event notifications

if AOS_COMP_YLOOP
# Configurations for comp yloop
endif
```
