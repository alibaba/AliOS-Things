## components/drivers/external_device/m5driver/i2c_manager/Kconfig
```kconfig
config HAVE_I2C_MANAGER
def_bool y

menu "I2C Port Settings"

    rsource "i2c_manager/Kconfig"
    
    config I2C_MANAGER_I2CDEV
        bool "i2cdev compatibility"
        help
            This allows you to run code that was written for i2cdev, another
            i2c port abstraction layer. I2C Manager keeps doing what it does
            and additionally emulates i2cdev if you use this feature. Make 
            sure to remove the other 'i2cdev.c' and 'i2cdev.h' files. See the 
            README for further details.

endmenu
```

## components/drivers/flash/Config.in
```kconfig
menuconfig AOS_COMP_U_FLASH
    select AOS_COMP_DEVICEVFS
    bool "flash core module"
    default n
    help
        AliOS flash module flash layer
```

## components/drivers/gpio/Config.in
```kconfig
menuconfig AOS_COMP_U_GPIO
    select AOS_COMP_DEVICEVFS
    bool "gpio core module"
    default n
    help
        AliOS gpio module core layer
```

## components/drivers/i2c/Config.in
```kconfig
menuconfig AOS_COMP_U_I2C
    select AOS_COMP_DEVICEVFS
    bool "i2c core module"
    default n
    help
        AliOS i2c module core layer
```

## components/drivers/irq/Config.in
```kconfig
#
# The configs required by AliOS Things
#
config AOS_COMP_IRQ
    bool "general irq Enable"
    default n

menu "irq configuration"
# Add component configs here ...
endmenu
```

## components/drivers/platform/Config.in
```kconfig
menuconfig AOS_COMP_UPLATFORM
    bool "platform bus driver"
    default n
    help
        AliOS u_platform bus driver
```

## components/drivers/pwm/Config.in
```kconfig
menuconfig AOS_COMP_U_PWM
    select AOS_COMP_DEVICEVFS
    bool "pwm core module"
    default n
    help
        AliOS pwm module core layer
```

## components/drivers/qspi/Config.in
```kconfig
menuconfig AOS_COMP_U_QSPI
    select AOS_COMP_DEVICEVFS
    bool "qspi core module"
    default n
    help
        AliOS qspi module core layer
```
