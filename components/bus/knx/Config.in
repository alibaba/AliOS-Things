## components/bus/knx/Config.in
```kconfig
config AOS_COMP_KNX
    bool "KNX Support"
    default n
    help
    	lightweight KNX stack

if AOS_COMP_KNX
# Configurations for comp KNX
config KNX_CONFIG_NCN5120
    bool "support chipset NCN5120"
    default n
    help
        Enable link layer support for NCN5120 UART TP chipset

endif
```

## components/bus/mbmaster/Config.in
```kconfig
menuconfig AOS_COMP_MBMASTER
    bool "Modbus Master Support"
    default n
    help
        modbus master stack. This module is used to communicate with modbus slave devices.

if AOS_COMP_MBMASTER

config MBMASTER_CONFIG_RTU_ENABLED
    bool "Enable the rtu transmission mode"
        default y
        help
            excludes this feature if you want to use modbus master with rtu.
            default y

config MBMASTER_CONFIG_HANDLER_MAX
    int "The max number of handler resources"
        range 0 10
        default 1
        help
            config the number of handler resources. The task which want to communication with modbus master stack
            must call mb_alloc_handler to alloc a handler.
            default 1

endif
```

## components/bus/usb/Config.in
```kconfig
if AOS_CREATE_PROJECT
config AOS_COMP_USB
    bool
    default y
endif

if !AOS_CREATE_PROJECT
config AOS_COMP_USB
    bool "USB Support"
    default n
    help
        usb host library and usb device library support
endif
```

## components/dm/bootloader/Config.in
```kconfig
###################################################################
# Component enable/disable selection
# in the updated build system, default is y and can not be disabled
if AOS_CREATE_PROJECT
config AOS_COMP_BOOTLOADER
    bool 
    default y
# do NOT select depend component in this file
# use $(NAME)_COMPONENTS in aos.mk
endif

# Backward compatibility
if !AOS_CREATE_PROJECT
config AOS_COMP_UDATA
    bool "BootLoader Support"
    default n
    help
        BootLoader Support
endif
###################################################################
# Component configuration items
menu "BootLoader Configuration"
depends on AOS_COMP_BOOTLOADER

config AOS_COMP_UPDATER
    bool "Boot Updater Support"
    default y
    help

if AOS_COMP_UPDATER
config OTA_2NDBOOT_WDG_TIMEOUT
    int "OTA BootLoader Watch Dog Timeout(s)"
    default 120
    help
    setup OTA BootLoader Watch Dog Timeout, default:120s.

config OTA_2NDBOOT_XZ_BUF_SIZE
    int "OTA BootLoader XZ upgrade buffer size(byte)"
    default 2048
    help
    setup OTA BootLoader XZ upgrade buffer size, default:2048.

endif

config AOS_COMP_YMODEM
    bool "Ymodem Support"
    default y
    help

endmenu
```

## components/dm/ota/2ndboot/Config.in
```kconfig
config AOS_COMP_OTA_2NDBOOT
    bool "2ndboot Support"
    default n
    help

if AOS_COMP_OTA_2NDBOOT
config OTA_2NDBOOT_WDG_TIMEOUT
    int "OTA 2ndboot Watch Dog Timeout(s)"
    default 120
    help
    setup OTA 2ndboot Watch Dog Timeout, default:120s.

config OTA_2NDBOOT_XZ_BUF_SIZE
    int "OTA 2ndboot XZ upgrade buffer size(byte)"
    default 2048
    help
    setup OTA 2ndboot XZ upgrade buffer size, default:2048.

endif
```

## components/dm/ota/Config.in
```kconfig
menuconfig AOS_COMP_OTA
    bool "OTA Features"
    select MBEDTLS_CONFIG_CRYPTO_MD5 if AOS_COMP_MBEDTLS
    select AOS_COMP_CJSON
    select OTA_CONFIG_BLE if AOS_COMP_BREEZE
    select CONFIG_COMP_BZ_HAL_CRYPTO_MEBDTLS if AOS_COMP_BREEZE
    select AOS_COMP_SDK_MQTT if !OTA_CONFIG_BLE
    select AOS_COMP_HTTP    if !OTA_CONFIG_BLE
    default n
    help

if AOS_COMP_OTA
config OTA_CONFIG_DOWNLOAD
    bool "Download Config"
    default n
    help
    select Y to config OTA download.

if OTA_CONFIG_DOWNLOAD
config OTA_CONFIG_SECURE_DL_MODE
    bool "Secure Download Mode"
    select CONFIG_HTTP_SECURE
    default n
    help
    select Y to enter into OTA secure download mode, only run download task in this mode.

config OTA_DOWNLOAD_RETRY_CNT
    int "Download Retry Count"
    default 5
    help
    setup ota download retry count when fail to download.

config OTA_DOWNLOAD_TIMEOUT
    int "Download Timeout(ms)"
    default 20000
    help
    setup ota download timeout, default:20000.

config OTA_DOWNLOAD_BLOCK_SIZE
    int "Download Block Size(bytes)"
    default 512
    help
    setup ota download block size.
endif

config OTA_CONFIG_RSA
    bool "RSA Verify Support"
    default n
    help
    select Y to support RSA Verify.

if OTA_CONFIG_RSA
choice
    prompt "Select signature"
    default OTA_CONFIG_LOCAL_RSA
    help
        choose where to sign

    config OTA_CONFIG_CLOUD_RSA
        bool "cloud sign"
        help
            signature in the cloud.

    config OTA_CONFIG_LOCAL_RSA
        bool "local sign"
        help
            signature in the alios studio.
endchoice
endif

config OTA_FLASH_WRITE_CACHE_SIZE
     int "write flash cache size(bytes)"
     default 1024
     help
        This option sets the ota write flash cache size for 8-byte alignment.
        This option is limited by the board memory size.
        This value could be 512 1024 2048 4096 ...
        The default value is 1024

config OTA_CONFIG_MCU_OTA
    bool "MCU OTA Config"
    default n
    help
    select Y to config MCU OTA.

if OTA_CONFIG_MCU_OTA
config OTA_CONFIG_MCU_YMODEM
    bool "Ymodem upgrade Support"
    default y
    help
    select Y to support ymodem upgrade for MCU OTA.

config OTA_CONFIG_MCU_CAN
    bool "CAN Master upgrade Support"
    default n
    help
    select Y to support CAN master upgrade for MCU OTA.
endif

config OTA_CONFIG_BLE
    bool "BLE upgrade Support"
    default y if AOS_COMP_BREEZE
    default n
    help
    select Y to support BLE upgrade.

config OTA_CONFIG_UAGENT
    bool "OTA via uAgent"
    select AOS_COMP_UAGENT
    default n
    help
    mount ota function to uAgent
endif
```

## components/dm/ota/ota_core/ble/Config.in
```kconfig
config AOS_COMP_OTA_BLE
    bool  "BLE OTA Support"
    default n

if AOS_COMP_OTA_BLE
# Configurations for comp ota_ble
endif
```

## components/dm/uagent/Config.in
```kconfig
menu "uAgent Configuration"
source "components/dm/uagent/uagent/Config.in"
endmenu
```

## components/dm/uagent/uagent/Config.in
```kconfig
menuconfig AOS_COMP_UAGENT
    bool "uAgent Support"
    select AOS_COMP_OSAL_AOS

    default n

if AOS_COMP_UAGENT
endif
```

## components/dm/ulog/Config.in
```kconfig
menuconfig AOS_COMP_ULOG
    bool "uLog Support"
    select AOS_COMP_OSAL_AOS

    default n

if AOS_COMP_ULOG
# Configurations for component ulog

config ULOG_CONFIG_STOP_FILTER_DEFAULT
    int "Level Stop Filter of Default Direction(UART for RTOS)"
    range 0 8
    default 6
    help
        Level Stop Filter of default direction(uart for rtos), any log level qual or lower than this (value higher than it)
        will be abondoned. 0 will make none log pop out.

config ULOG_CONFIG_LOG_SIZE
    int "Max Length of Log Text"
    range 36 512
    default 256
    help
        The max length of every trace log to be recorded, log Content will be trimmed if it's too long.

config ULOG_CONFIG_SYSLOG_TIME_FORMAT
    bool "Support syslog Time Format when Log"
    default n
    help
        Switch on this option will make log time format follow syslog type

config ULOG_CONFIG_SYNC_LOG_DETAILS
    bool "Enable Rich Details for Log"
    default n
    help
        enable rich details for log, includes mod name, file path and line.

if ULOG_CONFIG_SYNC_LOG_DETAILS

config ULOG_CONFIG_SYNC_DETAIL_COLOR
    bool "Enable Color Font for More Details"
    default n
    help
        enable color font for more details

config ULOG_CONFIG_SYNC_ABS_PATH
    bool "Enable Log Absolute Path under Detail Mode"
    default n
    help
        enable log absolute path
endif

config ULOG_CONFIG_POP_CLOUD
     bool "Switch on Pop Out Log to Cloud"
     select AOS_COMP_UAGENT
     select ULOG_CONFIG_ASYNC
     default n
     help
        switch on/off the function that pop out log to cloud

if ULOG_CONFIG_POP_CLOUD
config ULOG_CONFIG_STOP_FILTER_CLOUD
    int "Level Stop Filter to Cloud"
    range 0 8
    default 0
    help
        Level Stop Filter of Cloud, any log level qual or lower than this (value higher than it)
        will be abondoned LOG_EMERG will make none log pop out.
endif

config ULOG_CONFIG_POP_FS
     bool "Switch on Pop Out Log Into File System"
     select ULOG_CONFIG_ASYNC
     select AOS_COMP_CJSON
     select AOS_COMP_VFS
     default n
     help
        switch on/off the function that pop out log file into file system
        comp vfs and spiffs is necessary if switch on this function

if ULOG_CONFIG_POP_FS
config ULOG_CONFIG_STOP_FILTERFS
    int "Level Stop Filter of FS"
    range 0 8
    default 4
    help
        Level Stop Filter of fs, any log level qual or lower than this (value higher than it)
        will be abondoned LOG_EMERG will make none log pop out.
        please keep this value on "LOG_EMERG" if you have no plan to use log out fs

choice
    prompt "Choose File System Type"
    default ULOG_CONFIG_FS_SPIFFS
    help
        Select the type of fs which ulog recorded in.

    config ULOG_CONFIG_FS_SPIFFS
        bool "SPIFFS"

    config ULOG_CONFIG_FS_FATFS_SD
        bool "SD Card"

    config ULOG_CONFIG_FS_FATFS_FLASH
        bool "FATFS Flash"
endchoice

config ULOG_CONFIG_LOCAL_FILE_CNT
    int "Max uLog Files on File System"
    default 5
    range 1 256
    help
        Max log files support in fs, if the recording file more than this value, rolling back mechanism trigged.

config ULOG_CONFIG_LOCAL_FILE_SIZE
    int "Max uLog File Size"
    default 4096
    range 256 10240
    help
        Max log file size locate in local file system, if the recording file larger than this value, new files will be used to be recored.

config ULOG_CONFIG_RESERVED_FS
    bool "Reserved Log Temporary When FS is not Ready"
    default n
    help
        A FIFO queue will be used to save log for temporary until the FS is ready.

if ULOG_CONFIG_RESERVED_FS
config ULOG_CONFIG_RESERVED_FS_SIZE
    int "Count of Reserved Log When FS is not Ready"
    default 64
    range 8 256
    help
        Reserved Log Item when FS is not Ready.
endif

config ULOG_CONFIG_UPLOAD
    bool "Upload Log File via http"
    select AOS_COMP_UAGENT
    default n
    help
        Upload Log File via http.

endif

config ULOG_CONFIG_POP_UDP
     bool "Switch on Pop Out Log via Syslog UDP"
     select ULOG_CONFIG_ASYNC
     default n
     help
        switch on/off the function that pop out log file via syslog udp
        do not switch on if there is no tcp/ip stack in, or sal module included
        currently only support in soc.

if ULOG_CONFIG_POP_UDP
config ULOG_CONFIG_STOP_FILTER_UDP
    int "Level Stop Filter of UDP"
    range 0 8
    default 4
    help
        Level Stop Filter of udp, any log level qual or lower than this (value higher than it)
        will be abondoned LOG_EMERG will make none log pop out.
        please keep this value on "LOG_EMERG" if you have no plan to use udp log
endif

config ULOG_CONFIG_DEFAULT_DIR_ASYNC
     bool "Using Async Mode to Log on Default Direct"
     select ULOG_CONFIG_ASYNC
     default n
     help
        switch on/off the function using async mode

config ULOG_CONFIG_ASYNC
    bool
    default n
    help
        enable ulog async mode

if ULOG_CONFIG_ASYNC
# Configurations for ulog async mode

config ULOG_CONFIG_LOG_ROUTINE_TASK_STACK_DEPTH
    int "Stack Depth of Log Task Under Async Mode"
    default 3072
    help
        STACK DEPTH of Log Task

config ULOG_CONFIG_ASYNC_BUF_SIZE
    int "Default Size of Buffer Queue Under Async Mode"
    default 5120
    help
        Default size of buffer queue that used to record log under aync mode.
        May the trace log miss if this value was set too small.
        More RAM will be costed if it set too large
        So consider balance of this value and system resouce
endif

endif
```

## components/dm/und/Config.in
```kconfig
config AOS_COMP_UND
    bool "Network Diagnosis"
    default n
    help
      AliOS things uND -- Nework Diagnosis

if AOS_COMP_UND
# Configurations for comp uND
menu "Config Network Diagnosis Connection:"
    config UND_CONFIG_USE_MQTT
        bool "MQTT-Direct"
        default y
        help
            use mqtt connection.

    config UND_CONFIG_USE_UAGENT
        bool "uAgent"
        default n
        help
            use uagent.
endmenu

choice
    prompt "Config Network Diagnosis Wireless:"
    default UND_CONFIG_WITH_WIFI
    help
      Choose right Network

    config UND_CONFIG_WITH_WIFI
        bool "Wi-Fi"
        help
          support net with Wi-Fi.

    config UND_CONFIG_WITH_BLE
        bool "BLE"
        help
          support net with BLE.
endchoice

endif
```

## components/drivers/Config.in
```kconfig
menu "Drivers Configurations"

source "components/drivers/core/Config.in"
source "components/drivers/devicevfs/Config.in"
source "components/drivers/platform/Config.in"
source "components/drivers/adc/Config.in"
source "components/drivers/gpio/Config.in"
source "components/drivers/i2c/Config.in"
source "components/drivers/pwm/Config.in"
source "components/drivers/flash/Config.in"
source "components/drivers/qspi/Config.in"
source "components/drivers/spi/Config.in"
source "components/drivers/timer/Config.in"
source "components/drivers/uart/Config.in"
source "components/drivers/wifi/Config.in"
source "components/drivers/ramdrv/Config.in"
source "components/drivers/wdg/Config.in"
source "components/drivers/irq/Config.in"
source "components/drivers/test/Config.in"
endmenu
```

## components/drivers/adc/Config.in
```kconfig
menuconfig AOS_COMP_U_ADC
    select AOS_COMP_DEVICEVFS
    bool "adc core module"
    default n
    help
        AliOS adc module core layer
```

## components/drivers/core/Config.in
```kconfig
menuconfig AOS_COMP_UDRIVER
    bool "bus/device/driver model"
    default n
    help
        AliOS bus/device/driver model layer
```

## components/drivers/dac/Config.in
```kconfig
menuconfig AOS_COMP_U_DAC
    select AOS_COMP_DEVICEVFS
    bool "dac core module"
    default n
    help
        AliOS dac module core layer
```

## components/drivers/devicevfs/Config.in
```kconfig
menuconfig AOS_COMP_DEVICEVFS
    select AOS_COMP_UDRIVER
    select AOS_COMP_UPLATFORM
    bool "device vfs for bus-disabled model"
    default n
    help
        AliOS device vfs for bus-disabled module
```
