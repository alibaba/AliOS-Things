## board/numaker-pfm-nano130/Config.in
```kconfig
config AOS_BOARD_NUMAKER_PFM_NANO130
    bool "numaker-pfm-nano130"
    select AOS_MCU_NANO130KE3BN
    select AOS_COMP_KERNEL_INIT
    select AOS_COMP_NEWLIB_STUB
    select AOS_COMP_NETMGR
    help

if AOS_BOARD_NUMAKER_PFM_NANO130
# Configurations for board numaker-pfm-nano130
endif
```

## board/nutiny-evb-nano130/Config.in
```kconfig
menuconfig AOS_BOARD_NUTINY-EVB-NANO130
    bool "nutiny-evb-nano130"
    select AOS_MCU_NANO130KE3BN
    help

if AOS_BOARD_NUTINY-EVB-NANO130
# Configurations for board nutiny-evb-nano130
endif
```

## board/pca10040/Config.in
```kconfig
config AOS_BOARD_PCA10040
    bool "PCA10040"
    select AOS_MCU_NRF52XXX
    select AOS_COMP_KERNEL_INIT
    help
        The Pca10040's mcu is nRF52832. The nRF52832 is the mid-range member of the nRF52 Series SoC family. It meets the challenges of a broad range of applications that need Bluetooth 5 feature sets, protocol concurrency and a rich and varied set of peripherals and features. In addition, it offers generous memory availability for both Flash and RAM.

if AOS_BOARD_PCA10040
# Configurations for board board_pca10040

config DEBUG_CONFIG_PANIC
    bool "Enable debug panic feature"
    default y
    help
        set to y if you want to enable panic debug feature when system crash happened,
        default y

config DEBUG_CONFIG_BACKTRACE
    bool "Enable stack backtrace feature"
    default y
    help
        set to y if you want to enable stack backtrace feature when system crash happened,
        default y

config DEBUG_CONFIG_PANIC_CLI
    bool "Enable cli after panic"
    default n
    help
        set to y if you want to enable cli feature after system crash,
        default n

# "BSP SUPPORT FEATURE"
config BSP_SUPPORT_UART
    bool
    default y

config BSP_SUPPORT_FLASH
    bool
    default y

config BSP_SUPPORT_GPIO
    bool
    default y

config BSP_SUPPORT_TIMER
    bool
    default y

config BSP_SUPPORT_BLE
    bool
    default y

endif
```

## board/pca10040e/Config.in
```kconfig
config AOS_BOARD_PCA10040E
    bool "PCA10040E"
    select AOS_MCU_NRF52XXX
    select AOS_COMP_KERNEL_INIT
    help

if AOS_BOARD_PCA10040E
# Configurations for board board_pca10040e

# "BSP SUPPORT FEATURE"
config BSP_SUPPORT_UART
    bool
    default y

config BSP_SUPPORT_FLASH
    bool
    default y

config BSP_SUPPORT_GPIO
    bool
    default y

config BSP_SUPPORT_TIMER
    bool
    default y

config BSP_SUPPORT_BLE
    bool
    default y

endif
```

## board/pca10056/Config.in
```kconfig
config AOS_BOARD_PCA10056
    bool "board_pca10056"
    select AOS_MCU_NRF52XXX
    select AOS_COMP_KERNEL_INIT
    help

if AOS_BOARD_PCA10056
# Configurations for board board_pca10056

menu "BSP SUPPORT FEATURE"

config BSP_SUPPORT_UART
    bool "BSP_SUPPORT_UART"
    default y

config BSP_SUPPORT_FLASH
    bool "BSP_SUPPORT_FLASH"
    default y

config BSP_SUPPORT_GPIO
    bool "BSP_SUPPORT_GPIO"
    default y

config BSP_SUPPORT_TIMER
    bool "BSP_SUPPORT_TIMER"
    default y

config BSP_SUPPORT_BLE
    bool "BSP_SUPPORT_BLE"
    default y

endmenu

endif
```

## board/rda8955/Config.in
```kconfig
menuconfig AOS_BOARD_RDA8955
    bool "board_rda8955"
    select AOS_MCU_RDA8955
    select AOS_COMP_KERNEL_INIT
    help

if AOS_BOARD_RDA8955
# Configurations for board board_rda8955

menu "BSP SUPPORT FEATURE"

config BSP_SUPPORT_FLASH
    bool "BSP_SUPPORT_FLASH"
    default y

endmenu

endif
```

## board/rk1108/Config.in
```kconfig
config AOS_BOARD_RK1108
    bool "board_rk1108"
    select AOS_MCU_LINUXIMPL
    select AOS_COMP_KERNEL_INIT
    help

if AOS_BOARD_RK1108
# Configurations for board board_rk1108

menu "BSP SUPPORT FEATURE"

config BSP_SUPPORT_WIFI
    bool "BSP_SUPPORT_WIFI"
    default y

endmenu

endif
```

## board/saml21_iot_sk/Config.in
```kconfig
config AOS_BOARD_SAML21_IOT_SK
    bool "saml21_iot_sk"
    select AOS_MCU_ATSAML21
    select AOS_COMP_KERNEL_INIT
    select AOS_COMP_NETMGR
    select AOS_COMP_NEWLIB_STUB
    select AOS_COMP_SAL if AOS_NETWORK_SAL
    help

if AOS_BOARD_SAML21_IOT_SK
# Configurations for board saml21_iot_sk

config AOS_NETWORK_SAL
    bool "AOS_NETWORK_SAL"
    default n

config SAL_MODULE
    string
    default "wifi.mk3060"

# "BSP SUPPORT FEATURE"
config BSP_SUPPORT_WIFI
    bool
    default y

endif
```

## board/ssc1667/Config.in
```kconfig
config AOS_BOARD_SSC1667
    bool "SSC1667"
    select AOS_MCU_SSCP131
    select AOS_COMP_NEWLIB_STUB
    help

if AOS_BOARD_SSC1667
# Configurations for board ssc1667
endif
```

## board/starterkit/Config.in
```kconfig
menuconfig AOS_BOARD_STARTERKIT
    bool "starterkit"
    select AOS_MCU_STM32L4XX_CUBE
    select AOS_COMP_KERNEL_INIT
    select SAL_ENABLED if AOS_NETWORK_SAL
    select AOS_COMP_NETMGR if AOS_NETWORK_SAL
    select AOS_COMP_SENSOR
    help

if AOS_BOARD_STARTERKIT
# Configurations for board starterkit

# Set default value of AOS_NETWORK_SAL
config AOS_NETWORK_SAL
    default y

config DEBUG_CONFIG_PANIC
    default 1

config DEBUG_CONFIG_BACKTRACE
    default 1

endif
```

## board/starterkit/audio_hal/Config.in
```kconfig
menuconfig AOS_BOARD_AUDIO_HAL
    bool "audio_hal"
    help

if AOS_BOARD_AUDIO_HAL
# Configurations for board audio_hal
endif
```

## board/stm32f103rb-nucleo/Config.in
```kconfig
config AOS_BOARD_STM32F103RB_NUCLEO
    bool "STM32F103RB_Nucleo"
    select AOS_MCU_STM32F1XX
    select AOS_COMP_KERNEL_INIT
    select AOS_COMP_OSAL_AOS
    help

if AOS_BOARD_STM32F103RB_NUCLEO
# Configurations for board stm32f103rb-nucleo

endif
```

## board/stm32f103ze/Config.in
```kconfig
config AOS_BOARD_STM32F103ZE
    bool "stm32f103ze"
    select AOS_MCU_STM32F1XX
    select AOS_COMP_KERNEL_INIT
    help

if AOS_BOARD_STM32F103ZE
# Configurations for board stm32f103ze

# "BSP SUPPORT FEATURE"
config BSP_SUPPORT_WIFI
    bool
    default y

endif
```

## board/stm32f401re-nucleo/Config.in
```kconfig
menuconfig AOS_BOARD_STM32F401RE-NUCLEO
    bool "stm32f401re-nucleo"
    select AOS_MCU_STM32F4XX_CUBE
    select AOS_COMP_KERNEL_INIT
    select AOS_COMP_NETMGR if AOS_NETWORK_SAL
    help

if AOS_BOARD_STM32F401RE-NUCLEO
# Configurations for board stm32f401re-nucleo

# Set default value of AOS_NETWORK_SAL
config AOS_NETWORK_SAL
    bool "AOS_NETWORK_SAL"
    default y

menu "BSP SUPPORT FEATURE"

config BSP_SUPPORT_UART
    bool "BSP_SUPPORT_UART"
    default y

config BSP_SUPPORT_FLASH
    bool "BSP_SUPPORT_FLASH"
    default y

config BSP_SUPPORT_GPIO
    bool "BSP_SUPPORT_GPIO"
    default y

config BSP_SUPPORT_I2C
    bool "BSP_SUPPORT_I2C"
    default y

endmenu

endif
```

## board/stm32f411re-nucleo/Config.in
```kconfig
config AOS_STM32F411RE-NUCLEO
    bool "stm32f411re-nucleo"
    default n
    help
```

## board/stm32f412zg-nucleo/Config.in
```kconfig
menuconfig AOS_BOARD_STM32F412ZG-NUCLEO
    bool "stm32f412zg-nucleo"
    select AOS_MCU_STM32F4XX_CUBE
    select AOS_COMP_KERNEL_INIT
    select SAL_ENABLED if AOS_NETWORK_SAL
    select AOS_COMP_NETMGR if AOS_NETWORK_SAL
    help

if AOS_BOARD_STM32F412ZG-NUCLEO
# Configurations for board stm32f412zg-nucleo

# Set default value of AOS_NETWORK_SAL
config AOS_NETWORK_SAL
    bool "AOS_NETWORK_SAL"
    default y

menu "BSP SUPPORT FEATURE"

config BSP_SUPPORT_UART
    bool "BSP_SUPPORT_UART"
    default y

config BSP_SUPPORT_FLASH
    bool "BSP_SUPPORT_FLASH"
    default y

config BSP_SUPPORT_GPIO
    bool "BSP_SUPPORT_GPIO"
    default y

config BSP_SUPPORT_I2C
    bool "BSP_SUPPORT_I2C"
    default y

endmenu

endif
```

## board/stm32f429zi-mk/Config.in
```kconfig
config AOS_BOARD_STM32F429ZI_MK
    bool "stm32f429zi-mk"
    select AOS_MCU_STM32F4XX_CUBE
    select AOS_COMP_LWIP if AOS_NETWORK_SAL
    select AOS_COMP_CLI
    help

if AOS_BOARD_STM32F429ZI_MK
# Configurations for board stm32f429zi-mk

# Set default value of AOS_NETWORK_SAL
config AOS_NETWORK_SAL
    bool "AOS_NETWORK_SAL"
    default n

config BSP_SUPPORT_UART
    bool "BSP_SUPPORT_UART"
    default y

config BSP_SUPPORT_FLASH
    bool "BSP_SUPPORT_FLASH"
    default y

config BSP_SUPPORT_GPIO
    bool "BSP_SUPPORT_GPIO"
    default y

config BSP_SUPPORT_I2C
    bool "BSP_SUPPORT_I2C"
    default y

endif
```

## board/stm32f429zi-nucleo/Config.in
```kconfig
config AOS_BOARD_STM32F429ZI_NUCLEO
    bool "STM32F429ZI_Nucleo"
    select AOS_MCU_STM32F4XX_CUBE
    select AOS_COMP_KERNEL_INIT
    select AOS_COMP_SAL if AOS_NETWORK_SAL
    select AOS_COMP_LWIP if AOS_NETWORK_SAL
    select AOS_COMP_NETMGR
    help
        **Stm32f429zi-nucleo** is hardware board base on [AliOS-Things](https://github.com/alibaba/AliOS-Things), with a variety of peripherals.

if AOS_BOARD_STM32F429ZI_NUCLEO
# Configurations for board stm32f429zi-nucleo

config DEBUG_CONFIG_PANIC
    bool "Enable debug panic feature"
    default y
    help
        set to y if you want to enable panic debug feature when system crash happened,
        default y

config DEBUG_CONFIG_BACKTRACE
    bool "Enable stack backtrace feature"
    default y
    help
        set to y if you want to enable stack backtrace feature when system crash happened,
        default y

# "BSP SUPPORT FEATURE"
config BSP_SUPPORT_UART
    bool
    default y

config BSP_SUPPORT_FLASH
    bool
    default y

config BSP_SUPPORT_GPIO
    bool
    default y

config BSP_SUPPORT_I2C
    bool
    default y

config BSP_SUPPORT_WIFI
    bool
    default y

config BSP_SUPPORT_EXTERNAL_MODULE
    bool
    default n

config BSP_EXTERNAL_WIFI_MODULE
    string
    depends on BSP_SUPPORT_EXTERNAL_MODULE
    default "wifi.mk3060"

endif
```

## board/stm32f429zi-syscall/Config.in
```kconfig
config AOS_BOARD_STM32F429ZI_SYSCALL
    bool "stm32f429zi-syscall"
    select AOS_MCU_STM32F4XX_SYSCALL
    select AOS_COMP_LWIP
    help

if AOS_BOARD_STM32F429ZI_SYSCALL
# Configurations for board stm32f429zi-syscall

# Set default value of AOS_NETWORK_SAL
config AOS_NETWORK_SAL
    bool "AOS_NETWORK_SAL"
    default n

menu "BSP SUPPORT FEATURE"

config BSP_SUPPORT_UART
    bool "BSP_SUPPORT_UART"
    default y

config BSP_SUPPORT_FLASH
    bool "BSP_SUPPORT_FLASH"
    default y

config BSP_SUPPORT_GPIO
    bool "BSP_SUPPORT_GPIO"
    default y

config BSP_SUPPORT_I2C
    bool "BSP_SUPPORT_I2C"
    default y

config BSP_SUPPORT_WIFI
    bool "BSP_SUPPORT_WIFI"
    default y

endmenu

endif
```

## board/stm32f769i-discovery/Config.in
```kconfig
menuconfig AOS_BOARD_B_F769
    bool "board_b_f769"
    select AOS_MCU_STM32F7XX
    select AOS_COMP_KERNEL_INIT
    help

if AOS_BOARD_B_F769
# Configurations for board board_b_f769

menu "BSP SUPPORT FEATURE"

config BSP_SUPPORT_UART
    bool "BSP_SUPPORT_UART"
    default y

config BSP_SUPPORT_FLASH
    bool "BSP_SUPPORT_FLASH"
    default y

config BSP_SUPPORT_WIFI
    bool "BSP_SUPPORT_WIFI"
    default y

endmenu

endif
```

## board/stm32l432kc-nucleo/Config.in
```kconfig
menuconfig AOS_BOARD_STM32L432KC-NUCLEO
    bool "stm32l432kc-nucleo"
    select AOS_MCU_STM32L4XX_CUBE
    select AOS_COMP_KERNEL_INIT
    select SAL_ENABLED if AOS_NETWORK_SAL
    select AOS_COMP_NETMGR if AOS_NETWORK_SAL
    help

if AOS_BOARD_STM32L432KC-NUCLEO
# Configurations for board stm32l432kc-nucleo

# Set default value of AOS_NETWORK_SAL
config AOS_NETWORK_SAL
    bool "AOS_NETWORK_SAL"
    default y
endif
```

## board/stm32l433rc-nucleo/Config.in
```kconfig
config AOS_BOARD_STM32L433RC_NUCLEO
    bool "stm32l433rc-nucleo"
    select AOS_MCU_STM32L4XX_CUBE
    select AOS_COMP_KERNEL_INIT
    select AOS_COMP_NETMGR if AOS_NETWORK_SAL
    select AOS_COMP_SAL if AOS_NETWORK_SAL
    help

if AOS_BOARD_STM32L433RC_NUCLEO
# Configurations for board stm32l433rc-nucleo

# Set default value of AOS_NETWORK_SAL
config AOS_NETWORK_SAL
    bool "AOS_NETWORK_SAL"
    default y

config SAL_MODULE
    string
    default "wifi.mk3060"

menu "BSP SUPPORT FEATURE"

config BSP_SUPPORT_UART
    bool "BSP_SUPPORT_UART"
    default y

config BSP_SUPPORT_FLASH
    bool "BSP_SUPPORT_FLASH"
    default y

config BSP_SUPPORT_GPIO
    bool "BSP_SUPPORT_GPIO"
    default y

config BSP_SUPPORT_I2C
    bool "BSP_SUPPORT_I2C"
    default y

config BSP_SUPPORT_SPI
    bool "BSP_SUPPORT_SPI"
    default y

config BSP_SUPPORT_RTC
    bool "BSP_SUPPORT_RTC"
    default y

config BSP_SUPPORT_TIMER
    bool "BSP_SUPPORT_TIMER"
    default y

config BSP_SUPPORT_WIFI
    bool "BSP_SUPPORT_WIFI"
    default y

endmenu

endif
```

## board/stm32l476rg-nucleo/Config.in
```kconfig
menuconfig AOS_BOARD_STM32L476RG-NUCLEO
    bool "stm32l476rg-nucleo"
    select AOS_MCU_STM32L4XX_CUBE
    select SAL_ENABLED if AOS_NETWORK_SAL
    select AOS_COMP_NETMGR if AOS_NETWORK_SAL
    help

if AOS_BOARD_STM32L476RG-NUCLEO
# Configurations for board stm32l476rg-nucleo

# Set default value of AOS_NETWORK_SAL
config AOS_NETWORK_SAL
    default y
endif
```

## board/stm32l496g-discovery/Config.in
```kconfig
menuconfig AOS_BOARD_STM32L496G-DISCOVERY
    bool "stm32l496g-discovery"
    select AOS_MCU_STM32L4XX_CUBE
    select AOS_COMP_KERNEL_INIT
    select AOS_COMP_NETMGR if AOS_NETWORK_SAL
    help

if AOS_BOARD_STM32L496G-DISCOVERY
# Configurations for board stm32l496g-discovery

# Set default value of AOS_NETWORK_SAL
config AOS_NETWORK_SAL
    default y
endif
```

## board/sv6266_evb/Config.in
```kconfig
config AOS_BOARD_SV6266_EVB
    bool "SV6266_EVB"
    select AOS_MCU_SV6266
    select AOS_COMP_KERNEL_INIT
    select AOS_COMP_NEWLIB_STUB
    select AOS_COMP_NETMGR
    select AOS_COMP_CJSON
    select AOS_COMP_LWIP
    select AOS_COMP_CLI
    help

if AOS_BOARD_SV6266_EVB
# Configurations for board sv6266_evb
endif
```
