## board/gd32f350r-eval/Config.in
```kconfig
config AOS_BOARD_GD32F350R-EVAL
    bool "gd32f350r-eval"
    select AOS_MCU_GD32F3X0
    select AOS_COMP_KERNEL_INIT
    select AOS_COMP_NETMGR
    select AOS_COMP_NEWLIB_STUB
    help

if AOS_BOARD_GD32F350R-EVAL
# Configurations for board gd32f350r-eval
endif
```

## board/gd32f450z-eval/Config.in
```kconfig
menuconfig AOS_BOARD_GD32F450Z-EVAL
    bool "gd32f450z-eval"
    select AOS_MCU_GD32F30X
    help

if AOS_BOARD_GD32F450Z-EVAL
# Configurations for board gd32f450z-eval
endif
```

## board/hifive1/Config.in
```kconfig
config AOS_BOARD_HIFIVE1
    bool "board_hifive1"
    default n
    select AOS_MCU_E310
    help

if AOS_BOARD_HIFIVE1
# Configurations for board hifive1
endif
```

## board/hk32f103rb_evb/Config.in
```kconfig
config AOS_BOARD_HK32F103RB_EVB
    bool "hk32f103rb_evb"
    select AOS_MCU_HK32F103
    select AOS_COMP_NEWLIB_STUB
    help

if AOS_BOARD_HK32F103RB_EVB
# Configurations for board hk32f103rb_evb
endif
```

## board/hr8p287fjlt/Config.in
```kconfig
config AOS_BOARD_HR8P287FJLT
    bool "HR8P287FJLT"
    select AOS_MCU_HR8P2XX
    select AOS_COMP_NEWLIB_STUB
    help

if AOS_BOARD_HR8P287FJLT
# Configurations for board hr8p287fjlt
endif
```

## board/hr8p296fllt/Config.in
```kconfig
config AOS_BOARD_HR8P296FLLT
    bool "HR8P296FLLT"
    select AOS_MCU_HR8P2XX
    select AOS_COMP_NEWLIB_STUB
    help

if AOS_BOARD_HR8P296FLLT
# Configurations for board hr8p296fllt
endif
```

## board/imx6dq/Config.in
```kconfig
config AOS_BOARD_IMX6DQ
    bool "board_imx6dq"
    select AOS_MCU_IMX6
    select AOS_COMP_KERNEL_INIT
    help

if AOS_BOARD_IMX6DQ
# Configurations for board imx6dq
endif
```

## board/imx6sl/Config.in
```kconfig
config AOS_BOARD_IMX6SL
    bool "board_imx6sl"
    select AOS_MCU_IMX6
    select AOS_COMP_KERNEL_INIT
    help

if AOS_BOARD_IMX6SL
# Configurations for board imx6sl
endif
```

## board/imx6sl_svc/Config.in
```kconfig
menuconfig AOS_BOARD_IMX6SL_SVC
    bool "board_imx6sl_svc"
    select AOS_MCU_IMX6SL_SVC
    help

if AOS_BOARD_IMX6SL_SVC
# Configurations for board imx6sl_svc
endif
```

## board/linuxhost/Config.in
```kconfig
menuconfig AOS_BOARD_LINUXHOST
    bool "board_linuxhost"
    select AOS_MCU_LINUXIMPL
    select AOS_COMP_KERNEL_INIT
    select SAL_ENABLED if AOS_NETWORK_SAL
    help
      configuration for board linuxhost

if AOS_BOARD_LINUXHOST
# Configurations for board linuxhost

# Set default value of AOS_NETWORK_SAL
config AOS_NETWORK_SAL
    bool "AOS_NETWORK_SAL"
    default n

menu "BSP SUPPORT FEATURE"

config BSP_SUPPORT_WIFI
    bool "BSP_SUPPORT_WIFI"
    default y

endmenu

endif
```

## board/lpcxpresso54018/Config.in
```kconfig
config AOS_BOARD_LPCXPRESSO54018
    bool "board_lpcxpresso54018"
    select AOS_MCU_LPC54018IMPL
    select AOS_COMP_KERNEL_INIT
    help

if AOS_BOARD_LPCXPRESSO54018
# Configurations for board board_lpcxpresso54018

menu "BSP SUPPORT FEATURE"

config BSP_SUPPORT_UART
    bool "BSP_SUPPORT_UART"
    default y

config BSP_SUPPORT_FLASH
    bool "BSP_SUPPORT_FLASH"
    default y

endmenu

endif
```

## board/lpcxpresso54102/Config.in
```kconfig
menuconfig AOS_BOARD_LPCXPRESSO54102
    bool "board_lpcxpresso54102"
    select AOS_MCU_LPC54102IMPL
    select AOS_COMP_SAL if @CONDITION@
    help

if AOS_BOARD_LPCXPRESSO54102
# Configurations for board board_lpcxpresso54102
endif
```

## board/lpcxpresso54114/Config.in
```kconfig
config AOS_BOARD_LPCXPRESSO54114
    bool "board_lpcxpresso54114"
    select AOS_MCU_LPC54114IMPL
    select AOS_COMP_KERNEL_INIT
    help

if AOS_BOARD_LPCXPRESSO54114
# Configurations for board board_lpcxpresso54114

# "BSP SUPPORT FEATURE"
config BSP_SUPPORT_UART
    bool
    default y

config BSP_SUPPORT_FLASH
    bool
    default y

endif
```

## board/lpcxpresso54608/Config.in
```kconfig
menuconfig AOS_BOARD_LPCXPRESSO54608
    bool "board_lpcxpresso54608"
    select AOS_MCU_LPC54608IMPL
    select AOS_COMP_KERNEL_INIT
    help

if AOS_BOARD_LPCXPRESSO54608
# Configurations for board board_lpcxpresso54608
endif
```

## board/lpcxpresso54628/Config.in
```kconfig
menuconfig AOS_BOARD_LPCXPRESSO54628
    bool "board_lpcxpresso54628"
    select AOS_MCU_LPC54628IMPL
    select AOS_COMP_KERNEL_INIT
    help

if AOS_BOARD_LPCXPRESSO54628
# Configurations for board board_lpcxpresso54628
endif
```

## board/m100c/Config.in
```kconfig
config AOS_BOARD_M100C
    bool "M100C"
    select AOS_MCU_EFM32GXX
    select AOS_COMP_KERNEL_INIT
    select AOS_COMP_LORAWAN_4_4_2 if lorawanback = 0
    select AOS_COMP_LORAWAN_4_4_0 if lorawanback = 1
    help

if AOS_BOARD_M100C
# Configurations for board board_m100c

config lorawanback
    int "lorawanback"
    range 0 1
    default 0

# "BSP SUPPORT FEATURE"
config BSP_SUPPORT_UART
    bool
    default y

config BSP_SUPPORT_FLASH
    bool
    default y

config BSP_SUPPORT_LORA
    bool
    default y

endif
```

## board/m400/Config.in
```kconfig
config AOS_BOARD_M400
    bool "M400"
    select AOS_MCU_STM32L0XX
    select AOS_COMP_KERNEL_INIT
    select AOS_COMP_LORAWAN_4_4_2 if lorawanback = 0
    select AOS_COMP_LORAWAN_4_4_0 if lorawanback = 1
    help

if AOS_BOARD_M400
# Configurations for board board_m400

config lorawanback
    int "lorawanback"
    range 0 1
    default 0

# "BSP SUPPORT FEATURE"
config BSP_SUPPORT_I2C
    bool
    default y

config BSP_SUPPORT_FLASH
    bool
    default y

config BSP_SUPPORT_LORA
    bool
    default y

endif
```

## board/mk1101/Config.in
```kconfig
config AOS_BOARD_MK1101
    bool "board_mk1101"
    select AOS_MCU_MX1101
    select AOS_COMP_KERNEL_INIT
    help

if AOS_BOARD_MK1101
# Configurations for board board_mk1101

config BSP_SUPPORT_I2C
    bool "BSP_SUPPORT_I2C"
    default y

config BSP_SUPPORT_FLASH
    bool "BSP_SUPPORT_FLASH"
    default y

config SAL_MODULE
    string
    default ""
endif
```

## board/mk3080/Config.in
```kconfig
config AOS_BOARD_MK3080
    bool "MK3080"
    select AOS_MCU_RTL8710BN
    select AOS_COMP_KERNEL_INIT
    help

if AOS_BOARD_MK3080
# Configurations for board board_mk3080

config DEBUG_CONFIG_PANIC
    bool "Enable debug panic feature"
    default y
    help
        set to y if you want to enable panic debug feature when system crash happened,
        default y

config DEBUG_CONFIG_BACKTRACE
    bool "Enable stack backtrace feature"
    default y
    help
        set to y if you want to enable stack backtrace feature when system crash happened,
        default y

config MK3080_CONFIG_SPIFFS
    bool "Locate SPIFFS for using"
    default n
    help
        Locate flash for spiffs fs, most of them comes from OTA temp room.

if MK3080_CONFIG_SPIFFS
choice
    prompt "Choose Size of SPIFFS"
    default MK3080_CONFIG_SPIFFS_SIZE_256KB
    help
        Select the size for spiffs

    config MK3080_CONFIG_SPIFFS_SIZE_64KB
        bool "64KB"

    config MK3080_CONFIG_SPIFFS_SIZE_128KB
        bool "128KB"

    config MK3080_CONFIG_SPIFFS_SIZE_256KB
        bool "256KB"
endchoice

config CONFIG_SPIFFS_PHYS_SZ
    int
    default 65536  if MK3080_CONFIG_SPIFFS_SIZE_64KB
    default 131072 if MK3080_CONFIG_SPIFFS_SIZE_128KB
    default 262144 if MK3080_CONFIG_SPIFFS_SIZE_256KB
endif

# "BSP SUPPORT FEATURE"
config BSP_SUPPORT_UART
    bool
    default y

config BSP_SUPPORT_GPIO
    bool
    default y

config BSP_SUPPORT_TIMER
    bool
    default y

config BSP_SUPPORT_FLASH
    bool
    default y

config BSP_SUPPORT_WDG
    bool
    default y

config BSP_SUPPORT_WIFI
    bool
    default y

# link security config
config CONFIG_LS_DEBUG
    bool
    default n
config CONFIG_LS_ID2_OTP
    bool
    default y
config CONFIG_LS_KM_SE
    bool
    default n
config CONFIG_LS_KM_TEE
    bool
    default n

config BSP_SUPPORT_WIFI_LOWPOWER
    bool
    default y

endif
```

## board/mk3165/Config.in
```kconfig
config AOS_BOARD_MK3165
    bool "MK3165"
    select AOS_MCU_STM32F4XX
    select AOS_COMP_KERNEL_INIT
    help

if AOS_BOARD_MK3165
# Configurations for board board_mk3165

# "BSP SUPPORT FEATURE"
config BSP_SUPPORT_UART
    bool
    default y

config BSP_SUPPORT_I2C
    bool
    default y

config BSP_SUPPORT_FLASH
    bool
    default y

config BSP_SUPPORT_TIMER
    bool
    default y

config BSP_SUPPORT_WIFI
    bool
    default y

endif
```

## board/mk3239/Config.in
```kconfig
menuconfig AOS_BOARD_MK3239
    bool "board_mk3239"
    select AOS_MCU_STM32F4XX
    select AOS_COMP_KERNEL_INIT
    help

if AOS_BOARD_MK3239
# Configurations for board board_mk3239
endif
```

## board/msp432p4111launchpad/Config.in
```kconfig
menuconfig AOS_BOARD_MSP432P4111LAUNCHPAD
    bool "msp432p4111launchpad"
    select AOS_MCU_MSP432P4XX
    select AOS_COMP_SAL if @CONDITION@
    help

if AOS_BOARD_MSP432P4111LAUNCHPAD
# Configurations for board msp432p4111launchpad
endif
```

## board/numaker-pfm-m487/Config.in
```kconfig
config AOS_BOARD_NUMAKER_PFM_M487
    bool "NUMAKER_PFM_M487"
    select AOS_MCU_M487JIDAE
    select AOS_COMP_KERNEL_INIT
    select AOS_COMP_NEWLIB_STUB
    select AOS_COMP_NETMGR
    select AOS_COMP_SAL if WIFI = 1
    select AOS_COMP_DEVICE_SAL_MK3060 if WIFI = 1
    select AOS_COMP_LWIP if ETHERNET = 1
    select AOS_COMP_YLOOP if ETHERNET = 1
    help

if AOS_BOARD_NUMAKER_PFM_M487
# Configurations for board numaker-pfm-m487

config ETHERNET
    int "ETHERNET"
    range 0 1
    default 1

endif
```
