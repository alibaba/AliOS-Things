## board/bk7231sdevkitc/Config.in
```kconfig
config AOS_BOARD_BK7231S
    bool "BK7231S"
    select AOS_MCU_BK7231S
    select AOS_COMP_KERNEL_INIT
    help
      configuration for board bk7231s

if AOS_BOARD_BK7231S
# Configurations for board board_bk7231s

config DEBUG_CONFIG_PANIC
    bool "Enable debug panic feature"
    default y
    help
        set to y if you want to enable panic debug feature when system crash happened,
        default y

config DEBUG_CONFIG_BACKTRACE
    bool "Enable stack backtrace feature"
    default y
    help
        set to y if you want to enable stack backtrace feature when system crash happened,
        default y

# "BSP SUPPORT FEATURE"
config BSP_SUPPORT_UART
    bool
    default y

config BSP_SUPPORT_GPIO
    bool
    default y

config BSP_SUPPORT_FLASH
    bool
    default y

config BSP_SUPPORT_TIMER
    bool
    default y

config BSP_SUPPORT_WDG
    bool
    default y

config BSP_SUPPORT_WIFI
    bool
    default y

endif
```

## board/bk7231udevkitc/Config.in
```kconfig
menuconfig AOS_BOARD_BK7231U
    bool "board_bk7231u"
    select AOS_MCU_BK7231U
    select AOS_COMP_KERNEL_INIT
    help
      configuration for board bk7231u

if AOS_BOARD_BK7231U
# Configurations for board board_bk7231u

menu "BSP SUPPORT FEATURE"

config BSP_SUPPORT_UART
    bool "BSP_SUPPORT_UART"
    default y

config BSP_SUPPORT_GPIO
    bool "BSP_SUPPORT_GPIO"
    default y

config BSP_SUPPORT_FLASH
    bool "BSP_SUPPORT_FLASH"
    default y

config BSP_SUPPORT_TIMER
    bool "BSP_SUPPORT_TIMER"
    default y

config BSP_SUPPORT_WDG
    bool "BSP_SUPPORT_WDG"
    default y

endmenu

endif
```

## board/cb2201/Config.in
```kconfig
config AOS_BOARD_CB2201
    bool "board_cb2201"
    select AOS_MCU_CSKY
    select AOS_COMP_KERNEL_INIT
    help
      configuration for board cb2201

if AOS_BOARD_CB2201
# Configurations for board board_cb2201

menu "BSP SUPPORT FEATURE"

config BSP_SUPPORT_UART
    bool "BSP_SUPPORT_UART"
    default y

config BSP_SUPPORT_FLASH
    bool "BSP_SUPPORT_FLASH"
    default y

config BSP_SUPPORT_I2C
    bool "BSP_SUPPORT_I2C"
    default y

config BSP_SUPPORT_WIFI
    bool "BSP_SUPPORT_WIFI"
    default y

endmenu

config VFS_CONFIG_STAT_INCLUDE_SIZE
    int "VFS_CONFIG_STAT_INCLUDE_SIZE"
    default 0

# link security config 
config CONFIG_LS_DEBUG
    bool
    default n
config CONFIG_LS_ID2_OTP
    bool
    default y
config CONFIG_LS_KM_SE
    bool
    default n
config CONFIG_LS_KM_TEE
    bool
    default y

endif
#AOS_BOARD_CB2201
```

## board/cy8ckit-062/Config.in
```kconfig
config AOS_BOARD_CY8CKIT-062
    bool "board_cy8ckit-062"
    select AOS_MCU_CY8C6347
    select AOS_COMP_KERNEL_INIT
    select AOS_COMP_SAL if AOS_NETWORK_SAL
    help
      configuration for board cy8ckit-062

if AOS_BOARD_CY8CKIT-062
# Configurations for board board_cy8ckit-062

# Set default value of AOS_NETWORK_SAL
config AOS_NETWORK_SAL
    bool "AOS_NETWORK_SAL"
    default y

config SAL_MODULE
    string
    default "wifi.mk3060"

menu "BSP SUPPORT FEATURE"

config BSP_SUPPORT_UART
    bool "BSP_SUPPORT_UART"
    default y

config BSP_SUPPORT_FLASH
    bool "BSP_SUPPORT_FLASH"
    default y

config BSP_SUPPORT_TIMER
    bool "BSP_SUPPORT_TIMER"
    default y

config BSP_SUPPORT_WIFI
    bool "BSP_SUPPORT_WIFI"
    default y

endmenu

endif
```

## board/developerkit-mk/Config.in
```kconfig
config AOS_BOARD_DEVELOPERKIT_MK
    bool "developerkit-mk"
    select AOS_MCU_STM32L4XX_CUBE
    select RHINO_CONFIG_USER_SPACE
    select RHINO_CONFIG_URES
    select RHINO_CONFIG_UCLI
    #select RHINO_CONFIG_UTCPIP
    #select RHINO_CONFIG_UFS
    select RHINO_CONFIG_UIPC
    #select RHINO_CONFIG_ULINKKIT
    #select RHINO_CONFIG_HAL_ADC_SYSCALL
    #select RHINO_CONFIG_HAL_DAC_SYSCALL
    #select RHINO_CONFIG_HAL_ADC_SYSCALL
    #select RHINO_CONFIG_HAL_FLASH_SYSCALL
    #select RHINO_CONFIG_HAL_GPIO_SYSCALL
    #select RHINO_CONFIG_HAL_I2C_SYSCALL
    #select RHINO_CONFIG_HAL_NAND_SYSCALL
    #select RHINO_CONFIG_HAL_NOR_SYSCALL
    #select RHINO_CONFIG_HAL_RTC_SYSCALL
    #select RHINO_CONFIG_HAL_SD_SYSCALL
    #select RHINO_CONFIG_HAL_SPI_SYSCALL
    select RHINO_CONFIG_HAL_UART_SYSCALL
    #select RHINO_CONFIG_DYN_SYSCALL_TBL
    help
      Developer Kit is hardware development board base on AliOS-Things

if AOS_BOARD_DEVELOPERKIT_MK
# Configurations for board stm32f429zi-mk

config DEBUG_CONFIG_PANIC
    bool "Enable debug panic feature"
    default y
    help
        set to y if you want to enable panic debug feature when system crash happened,
        default y

config DEBUG_CONFIG_BACKTRACE
    bool "Enable stack backtrace feature"
    default y
    help
        set to y if you want to enable stack backtrace feature when system crash happened,
        default y

# "BSP SUPPORT FEATURE"
config BSP_SUPPORT_UART
    bool
    default y

config BSP_SUPPORT_GPIO
    bool
    default y

config BSP_SUPPORT_I2C
    bool
    default y

config BSP_SUPPORT_SPI
    bool
    default y

config BSP_SUPPORT_FLASH
    bool
    default y

config BSP_SUPPORT_TIMER
    bool
    default y

config BSP_SUPPORT_RTC
    bool
    default y

config BSP_SUPPORT_WIFI
    bool
    default y

config BSP_SUPPORT_EXTERNAL_MODULE
    bool
    default y

config BSP_EXTERNAL_WIFI_MODULE
    string
    depends on BSP_SUPPORT_EXTERNAL_MODULE
    default "wifi.bk7231"

endif
```

## board/developerkit/Config.in
```kconfig
config AOS_BOARD_DEVELOPERKIT
    bool "DeveloperKit"
    select AOS_MCU_STM32L4XX_CUBE
    select AOS_COMP_KERNEL_INIT
    select AOS_COMP_SAL if AOS_NETWORK_SAL
    select AOS_COMP_NETMGR if AOS_NETWORK_SAL
    select AOS_COMP_SENSOR
    help
      Developer Kit is hardware development board base on AliOS-Things

if AOS_BOARD_DEVELOPERKIT
# Configurations for board developerkit

config DEBUG_CONFIG_PANIC
    bool "Enable debug panic feature"
    default y
    help
        set to y if you want to enable panic debug feature when system crash happened,
        default y

config DEBUG_CONFIG_BACKTRACE
    bool "Enable stack backtrace feature"
    default y
    help
        set to y if you want to enable stack backtrace feature when system crash happened,
        default y

config DEBUG_CONFIG_PANIC_CLI
    bool "Enable cli after panic"
    default n
    help
        set to y if you want to enable cli feature after system crash,
        default n

# "BSP SUPPORT FEATURE"
config BSP_SUPPORT_UART
    bool
    default y

config BSP_SUPPORT_GPIO
    bool
    default y

config BSP_SUPPORT_I2C
    bool
    default y

config BSP_SUPPORT_SPI
    bool
    default y

config BSP_SUPPORT_FLASH
    bool
    default y

config BSP_SUPPORT_TIMER
    bool
    default y

config BSP_SUPPORT_RTC
    bool
    default y

config BSP_SUPPORT_WIFI
    bool
    default y

config BSP_SUPPORT_EXTERNAL_MODULE
    bool
    default y

config BSP_EXTERNAL_WIFI_MODULE
    string
    depends on BSP_SUPPORT_EXTERNAL_MODULE
    default "wifi.bk7231"

endif
```

## board/developerkit_syscall/Config.in
```kconfig
menuconfig AOS_BOARD_DEVELOPERKIT_SYSCALL
    bool "developerkit_syscall"
    select AOS_MCU_STM32L4XX_SYSCALL
    help
      configuration for board developerkit_syscall

if AOS_BOARD_DEVELOPERKIT_SYSCALL
# Configurations for board developerkit_syscall
endif
```

## board/dh5021a_evb/Config.in
```kconfig
config AOS_BOARD_DH5021A_EVB
    bool "board_dh5021a_evb"
    select AOS_MCU_DAHUA
    select AOS_COMP_KERNEL_INIT
    help

if AOS_BOARD_DH5021A_EVB
# Configurations for board dh5021a_evb

menu "BSP SUPPORT FEATURE"

config BSP_SUPPORT_UART
    bool "BSP_SUPPORT_UART"
    default y

config BSP_SUPPORT_FLASH
    bool "BSP_SUPPORT_FLASH"
    default y

config BSP_SUPPORT_WIFI
    bool "BSP_SUPPORT_WIFI"
    default y

endmenu

endif
```

## board/eml3047/Config.in
```kconfig
config AOS_BOARD_EML3047
    bool "EML3047"
    select AOS_MCU_STM32L0XX
    select AOS_COMP_KERNEL_INIT
    select AOS_COMP_LORAWAN_4_4_2 if lorawanback = 0
    select AOS_COMP_LORAWAN_4_4_0 if lorawanback = 1
    help

if AOS_BOARD_EML3047
# Configurations for board eml3047
config lorawanback
    int "lorawanback"
    range 0 1
    default 0

# "BSP SUPPORT FEATURE"
config BSP_SUPPORT_I2C
    bool
    default y

config BSP_SUPPORT_FLASH
    bool
    default y

config BSP_SUPPORT_LORA
    bool
    default y

endif
```

## board/esp32devkitc/Config.in
```kconfig
config AOS_BOARD_ESP32DEVKITC
    bool "ESP32DevKitc"
    select AOS_MCU_ESP32
    select AOS_COMP_KERNEL_INIT
    help

if AOS_BOARD_ESP32DEVKITC
# Configurations for board esp32devkitc

config DEBUG_CONFIG_PANIC
    bool "Enable debug panic feature"
    default y
    help
        set to y if you want to enable panic debug feature when system crash happened,
        default y

config DEBUG_CONFIG_BACKTRACE
    bool "Enable stack backtrace feature"
    default y
    help
        set to y if you want to enable stack backtrace feature when system crash happened,
        default y

# "BSP SUPPORT FEATURE"
config BSP_SUPPORT_UART
    bool
    default y

config BSP_SUPPORT_GPIO
    bool
    default y

config BSP_SUPPORT_I2C
    bool
    default y

config BSP_SUPPORT_FLASH
    bool
    default y

config BSP_SUPPORT_ADC
    bool
    default y

config BSP_SUPPORT_DAC
    bool
    default y

config BSP_SUPPORT_PWM
    bool
    default y

config BSP_SUPPORT_RTC
    bool
    default y

config BSP_SUPPORT_WDG
    bool
    default y

endif
```

## board/esp32sram/Config.in
```kconfig
config AOS_BOARD_ESP32SRAM
    bool "board_esp32sram"
    select AOS_MCU_ESP32
    select AOS_COMP_KERNEL_INIT
    help

if AOS_BOARD_ESP32SRAM
# Configurations for board board_esp32sram

menu "BSP SUPPORT FEATURE"

config BSP_SUPPORT_UART
    bool "BSP_SUPPORT_UART"
    default y

config BSP_SUPPORT_GPIO
    bool "BSP_SUPPORT_GPIO"
    default y

config BSP_SUPPORT_I2C
    bool "BSP_SUPPORT_I2C"
    default y

config BSP_SUPPORT_FLASH
    bool "BSP_SUPPORT_FLASH"
    default y

config BSP_SUPPORT_ADC
    bool "BSP_SUPPORT_ADC"
    default y

config BSP_SUPPORT_DAC
    bool "BSP_SUPPORT_DAC"
    default y

config BSP_SUPPORT_PWM
    bool "BSP_SUPPORT_PWM"
    default y

config BSP_SUPPORT_RTC
    bool "BSP_SUPPORT_RTC"
    default y

config BSP_SUPPORT_WDG
    bool "BSP_SUPPORT_WDG"
    default y

endmenu

endif
```

## board/esp8266/Config.in
```kconfig
config AOS_BOARD_ESP8266
    bool "ESP8266"
    select AOS_MCU_ESP8266
    select AOS_COMP_KERNEL_INIT
    help

if AOS_BOARD_ESP8266
# Configurations for board esp8266

config DEBUG_CONFIG_PANIC
    bool "Enable debug panic feature"
    default y
    help
        set to y if you want to enable panic debug feature when system crash happened,
        default y

config DEBUG_CONFIG_BACKTRACE
    bool "Enable stack backtrace feature"
    default y
    help
        set to y if you want to enable stack backtrace feature when system crash happened,
        default y

# "BSP SUPPORT FEATURE"
config BSP_SUPPORT_UART
    bool
    default y

config BSP_SUPPORT_GPIO
    bool
    default y

config BSP_SUPPORT_FLASH
    bool
    default y

config BSP_SUPPORT_BLE
    bool
    default y

endif
```

## board/evkbimxrt1050/Config.in
```kconfig
config AOS_BOARD_EVKBIMXRT1050
    bool "board_evkbimxrt1050"
    select AOS_MCU_MIMXRT1052IMPL
    select AOS_COMP_KERNEL_INIT
    help

if AOS_BOARD_EVKBIMXRT1050
# Configurations for board evkbimxrt1050

menu "BSP SUPPORT FEATURE"

config BSP_SUPPORT_UART
    bool "BSP_SUPPORT_UART"
    default y

config BSP_SUPPORT_FLASH
    bool "BSP_SUPPORT_FLASH"
    default y

endmenu


endif
```

## board/evkmimxrt1020/Config.in
```kconfig
config AOS_BOARD_EVKMIMXRT1020
    bool "board_evkmimxrt1020"
    default n
    help
```

## board/fm33a0xx-discovery/Config.in
```kconfig
config AOS_BOARD_FM33A0XX_DISCOVERY
    bool "FM33A0XX_Discovery"
    select AOS_MCU_FM33A0XX
    select AOS_COMP_NEWLIB_STUB
    select AOS_COMP_KERNEL_INIT
    help

if AOS_BOARD_FM33A0XX_DISCOVERY
# Configurations for board fm33a0xx-discovery
endif
```

## board/frdmkl26z/Config.in
```kconfig
config AOS_BOARD_FRDMKL26Z
    bool "board_frdmkl26z"
    select AOS_MCU_MKL26Z4IMPL
    select AOS_COMP_KERNEL_INIT
    help

if AOS_BOARD_FRDMKL26Z
# Configurations for board frdmkl26z

# "BSP SUPPORT FEATURE"
config BSP_SUPPORT_UART
    bool
    default y

config BSP_SUPPORT_FLASH
    bool
    default y

endif
```

## board/frdmkl27z/Config.in
```kconfig
menuconfig AOS_BOARD_FRDMKL27Z
    bool "board_frdmkl27z"
    select AOS_MCU_MKL27Z644IMPL
    select AOS_COMP_KERNEL_INIT
    help

if AOS_BOARD_FRDMKL27Z
# Configurations for board frdmkl27z
endif
```

## board/frdmkl28z/Config.in
```kconfig
menuconfig AOS_BOARD_FRDMKL28Z
    bool "board_frdmkl28z"
    select AOS_MCU_MKL28Z7IMPL
    help

if AOS_BOARD_FRDMKL28Z
# Configurations for board frdmkl28z
endif
```

## board/frdmkl43z/Config.in
```kconfig
config AOS_BOARD_FRDMKL43Z
    bool "board_frdmkl43z"
    select AOS_MCU_MKL43Z4IMPL
    select AOS_COMP_KERNEL_INIT
    help

if AOS_BOARD_FRDMKL43Z
# Configurations for board frdmkl43z

# "BSP SUPPORT FEATURE"
config BSP_SUPPORT_UART
    bool
    default y

config BSP_SUPPORT_FLASH
    bool
    default y

endif
```

## board/frdmkl81z/Config.in
```kconfig
config AOS_BOARD_FRDMKL81Z
    bool "board_frdmkl81z"
    select AOS_MCU_MKL81Z7IMPL
    select AOS_COMP_KERNEL_INIT
    help

if AOS_BOARD_FRDMKL81Z
# Configurations for board frdmkl81z

# "BSP SUPPORT FEATURE"
config BSP_SUPPORT_UART
    bool
    default y

config BSP_SUPPORT_FLASH
    bool
    default y

endif
```

## board/frdmkl82z/Config.in
```kconfig
menuconfig AOS_BOARD_FRDMKL82Z
    bool "board_frdmkl82z"
    select AOS_MCU_MKL82Z7IMPL
    help

if AOS_BOARD_FRDMKL82Z
# Configurations for board frdmkl82z
endif
```

## board/gd32f307c-eval/Config.in
```kconfig
config AOS_BOARD_GD32F307C-EVAL
    bool "gd32f307c-eval"
    select AOS_MCU_GD32F30X
    select AOS_COMP_KERNEL_INIT
    select AOS_COMP_NEWLIB_STUB
    select AOS_COMP_NETMGR
    help

if AOS_BOARD_GD32F307C-EVAL
# Configurations for board gd32f307c-eval
endif
```
