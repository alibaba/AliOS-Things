## board/uno-91h/Config.in
```kconfig
config AOS_BOARD_UNO_91H
    bool "UNO_91H"
    select AOS_MCU_RDA5981X
    select AOS_COMP_KERNEL_INIT
    help
        **Uno-91h** is hardware board base on [AliOS-Things](https://github.com/alibaba/AliOS-Things), with a variety of peripherals. The chip's mcu is RDA5981. The RDA5981A is a WiFi IoT chip specifically designed for smart home & audio application, such as smart speakers. The company explains it can be widely used in televisions, set-top boxes, smart appliances, wireless monitors, and other products.

if AOS_BOARD_UNO_91H
# Configurations for board board_uno-91h

config DEBUG_CONFIG_PANIC
    bool "Enable debug panic feature"
    default y
    help
        set to y if you want to enable panic debug feature when system crash happened,
        default y

config DEBUG_CONFIG_BACKTRACE
    bool "Enable stack backtrace feature"
    default y
    help
        set to y if you want to enable stack backtrace feature when system crash happened,
        default y

# "BSP SUPPORT FEATURE"
config BSP_SUPPORT_UART
    bool
    default y

config BSP_SUPPORT_GPIO
    bool
    default y

config BSP_SUPPORT_FLASH
    bool
    default y

config BSP_SUPPORT_SPI
    bool
    default y

config BSP_SUPPORT_PWM
    bool
    default y

config BSP_SUPPORT_WIFI
    bool
    default y

config BSP_SUPPORT_WIFI_LOWPOWER
    bool
    default y

endif
```

## board/wm_w600_kit/Config.in
```kconfig
config AOS_BOARD_WM_W600_KIT
    bool "wm_w600_kit"
    select AOS_MCU_WM_W600
    select AOS_COMP_KERNEL_INIT
    select AOS_COMP_LWIP
    select AOS_COMP_NETMGR
    select AOS_COMP_NEWLIB_STUB
    help

if AOS_BOARD_WM_W600_KIT
# Configurations for board wm_w600_kit

# "BSP SUPPORT FEATURE"
config BSP_SUPPORT_WIFI
    bool
    default y

endif
```

## board/xm510_evb/Config.in
```kconfig
menuconfig AOS_BOARD_XM510
    bool "board_xm510"
    select AOS_MCU_XM510
    select AOS_COMP_KERNEL_INIT
    help

if AOS_BOARD_XM510
# Configurations for board board_xm510
endif
```

## board/xr809/Config.in
```kconfig
menuconfig AOS_BOARD_XR809
    bool "xr809"
    select AOS_MCU_XR871
    help

if AOS_BOARD_XR809
# Configurations for board xr809
endif
```

## board/xr871evb/Config.in
```kconfig
config AOS_BOARD_XR871EVB
    bool "XR871EVB"
    select AOS_MCU_XR871
    select AOS_COMP_KERNEL_INIT
    select AOS_COMP_NETMGR
    select AOS_COMP_NEWLIB_STUB
    select AOS_COMP_LWIP
    select AOS_COMP_YLOOP
    select AOS_COMP_CLI
    select AOS_COMP_FATFS
    help

if AOS_BOARD_XR871EVB
# Configurations for board xr871evb

# "BSP SUPPORT FEATURE"
config BSP_SUPPORT_WIFI
    bool
    default y

endif
```

## build/Config.in
```kconfig
#

mainmenu "AliOS Things Configuration"

# Hidden config symbols
config AOS_BUILD
    bool
    default y
    help
      This option indicates AOS build env is running.

config AOS_BUILD_BOARD
    string
    help
      This option holds the name of the board that is going to build.

config AOS_BUILD_APP
    string
    help
      This option holds the name of the application that is going to build.

menu "Application Configuration"
choice
    prompt "Select App"
    default AOS_APP_NULL

config AOS_APP_NULL
    bool "Null"

source "application/example/Config.in"
source "application/profile/Config.in"
source "application/Config.in"
endchoice
endmenu

source "platform/board/Config.in"

menu "Kernel      Configuration"
source "core/Config.in"
source "core/osal/aos/Config.in"
source "core/osal/posix/Config.in"
source "core/osal/cmsis/Config.in"
endmenu

source "components/peripherals/Config.in"
source "components/network/Config.in"

menu "Middleware  Configuration"
source "components/linkkit/Config.in"
source "components/uagent/Config.in"
source "components/udata/Config.in"
source "components/ulocation/Config.in"
source "components/uai/Config.in"
source "components/cli/Config.in"
source "components/debug/Config.in"
source "components/fs/kv/Config.in"
source "components/fs/ramfs/Config.in"
source "components/fs/vfs/Config.in"
source "components/bus/mbmaster/Config.in"
source "components/bus/usb/Config.in"
source "components/bus/canopen/Config.in"
source "components/network/netmgr/activation/Config.in"
source "components/network/netmgr/activation/chip_code/Config.in"
source "components/ulog/Config.in"
source "components/ota/Config.in"
source "components/ota/2ndboot/Config.in"
source "components/jsengine/Config.in"
endmenu

source "components/security/Config.in"

menu "Utility     Configuration"
source "components/cjson/Config.in"
source "components/security/mbedtls/Config.in"
source "components/zlib/Config.in"
source "components/rbtree/Config.in"
endmenu

source "test/Config.in"
```

## build/configs/feature/linkkit-default_defconfig
```kconfig
NAME := feature_linkkit-default

$(NAME)_COMPONENTS := middleware.linkkit.sdk-c

## Show Variables in generated config.mk
FEATURE_SHOW_VARS += \
    FEATURE_ALCS_ENABLED \
    FEATURE_CMP_VIA_CLOUD_CONN \
    FEATURE_CMP_VIA_MQTT_DIRECT \
    FEATURE_COAP_COMM_ENABLED \
    FEATURE_COAP_DTLS_SUPPORT \
    FEATURE_DEV_BIND_ENABLED \
    FEATURE_DEV_RESET_ENABLED \
    FEATURE_ENHANCED_GATEWAY \
    FEATURE_HTTP2_COMM_ENABLED \
    FEATURE_HTTP_COMM_ENABLED \
    FEATURE_MQTT_COMM_ENABLED \
    FEATURE_MQTT_DIRECT \
    FEATURE_MQTT_SHADOW \
    FEATURE_NTP_ENABLED \
    FEATURE_OTA_ENABLED \
    FEATURE_OTA_FETCH_CHANNEL \
    FEATURE_OTA_SIGNAL_CHANNEL \
    FEATURE_SDK_ENHANCE \
    FEATURE_SUBDEVICE_CHANNEL \
    FEATURE_SUBDEVICE_ENABLED \
    FEATURE_SUBDEVICE_STATUS \
    FEATURE_SUPPORT_ITLS \
    FEATURE_SUPPORT_PRODUCT_SECRET \
    FEATURE_SUPPORT_TLS \
    FEATURE_WIFI_AWSS_ENABLED

FEATURE_MQTT_SHADOW             ?= n
FEATURE_COAP_DTLS_SUPPORT       ?= $(FEATURE_COAP_COMM_ENABLED)
FEATURE_OTA_ENABLED             ?= y
FEATURE_OTA_FETCH_CHANNEL       ?= HTTP
FEATURE_OTA_SIGNAL_CHANNEL      ?= MQTT
FEATURE_MQTT_COMM_ENABLED       ?= n

CONFIG_LIB_EXPORT               ?= static

# gateway & subdevice
FEATURE_SUBDEVICE_STATUS        ?= gateway   
# MQTT & CLOUD_CONN
FEATURE_SUBDEVICE_CHANNEL       ?= MQTT 

FEATURE_CMP_VIA_MQTT_DIRECT     ?= y
# MQTT & COAP & HTTP
FEATURE_CMP_VIA_CLOUD_CONN      ?= MQTT
FEATURE_SUPPORT_PRODUCT_SECRET  ?= n

GLOBAL_CFLAGS  += -D_IS_LINKKIT_
GLOBAL_CFLAGS  += -DFORCE_SSL_VERIFY
GLOBAL_CFLAGS  += \
    -DCOAP_OBSERVE_SERVER_SUPPORTED \
    -DCOAP_OBSERVE_CLIENT_SUPPORTED \
	-DCOAP_SERV_MULTITHREAD \
    -DCOAP_USE_PLATFORM_MEMORY -DCOAP_USE_PLATFORM_LOG \
```
