## platform/mcu/stm32f4xx_syscall/Config.in
```kconfig
config AOS_MCU_STM32F4XX_SYSCALL
    bool "mcu_stm32f4xx_syscall"
    select AOS_ARCH_ARMV7M_SVC
    select AOS_COMP_NEWLIB_STUB
    select AOS_COMP_RHINO
    help
      driver & sdk for platform/mcu stm32f4xx_syscall

if AOS_MCU_STM32F4XX_SYSCALL
# Configurations for mcu stm32f4xx_syscall
endif
```

## platform/mcu/stm32f7xx/Config.in
```kconfig
config AOS_MCU_STM32F7XX
    bool "mcu_stm32f7xx"
    select AOS_ARCH_ARMV7M
    select AOS_COMP_NEWLIB_STUB
    select AOS_COMP_RHINO
    help
      driver & sdk for platform/mcu stm32f7xx

if AOS_MCU_STM32F7XX
# Configurations for mcu stm32f7xx
endif
```

## platform/mcu/stm32l0xx/Config.in
```kconfig
config AOS_MCU_STM32L0XX
    bool
    select AOS_ARCH_ARMV6M
    select AOS_COMP_RHINO
    help
      driver & sdk for platform/mcu stm32l0xx

if AOS_MCU_STM32L0XX
# Configurations for mcu stm32l0xx
endif
```

## platform/mcu/stm32l0xx/stm32l071kb/Config.in
```kconfig
menuconfig AOS_MCU_STM32L071KB
    bool "mcu_stm32l071kb"
    default n
    select AOS_ARCH_ARMV6M
    select AOS_COMP_RHINO
    help
      driver & sdk for platform/mcu stm32l071kb

if AOS_MCU_STM32L071KB
# Configurations for mcu stm32l071kb
endif
```

## platform/mcu/stm32l475/Config.in
```kconfig
menuconfig AOS_MCU_STM32L475
    bool "stm32l475"
    default n
    select AOS_COMP_HAL
    select AOS_COMP_NEWLIB_STUB
    select AOS_ARCH_ARMV7M
    select AOS_COMP_HALWIFI
    select AOS_COMP_VFS
    select AOS_COMP_KV
    select AOS_COMP_RHINO
    select AOS_COMP_DIGEST_ALGORITHM
    help

if AOS_MCU_STM32L475
# Configurations for mcu stm32l475
endif
```

## platform/mcu/stm32l4xx/Config.in
```kconfig
menuconfig AOS_MCU_STM32L4XX
    bool "stm32l4xx"
    default n
    select AOS_COMP_HAL
    select AOS_COMP_NEWLIB_STUB
    select AOS_COMP_VFS
    select AOS_COMP_HALWIFI
    select AOS_ARCH_ARMV7M
    select AOS_COMP_RHINO
    select AOS_COMP_DIGEST_ALGORITHM
    help

if AOS_MCU_STM32L4XX
# Configurations for mcu stm32l4xx
endif
```

## platform/mcu/stm32l4xx_cube/Config.in
```kconfig
config AOS_MCU_STM32L4XX_CUBE
    bool
    select AOS_ARCH_ARMV7M_MK if AOS_BOARD_DEVELOPERKIT_MK
    select AOS_ARCH_ARMV7M if !AOS_BOARD_DEVELOPERKIT_MK
    select AOS_COMP_NEWLIB_STUB
    select AOS_COMP_RHINO
    help
      driver & sdk for platform/mcu stm32l4xx_cube

if AOS_MCU_STM32L4XX_CUBE
# Configurations for mcu stm32l4xx_cube
endif
```

## platform/mcu/stm32l4xx_syscall/Config.in
```kconfig
config AOS_MCU_STM32L4XX_SYSCALL
    bool "mcu_stm32l4xx_syscall"
    select AOS_ARCH_ARMV7M_SVC
    select AOS_COMP_NEWLIB_STUB
    select AOS_COMP_LWIP
    select AOS_COMP_RHINO
    help
      driver & sdk for platform/mcu stm32l4xx_syscall

if AOS_MCU_STM32L4XX_SYSCALL
# Configurations for mcu stm32l4xx_syscall
endif
```

## platform/mcu/sv6266/Config.in
```kconfig
if AOS_CREATE_PROJECT
config AOS_MCU_SV6266
    bool
    default y
endif

if !AOS_CREATE_PROJECT
config AOS_MCU_SV6266
    bool
    select  AOS_COMP_RHINO
    help
      driver & sdk for platform/mcu sv6266
endif

if AOS_MCU_SV6266
# Configurations for mcu sv6266
endif
```

## platform/mcu/swm320/Config.in
```kconfig
if AOS_CREATE_PROJECT
config AOS_MCU_SWM320
    bool
    default y
endif

if !AOS_CREATE_PROJECT
config AOS_MCU_SWM320
    bool
    select AOS_ARCH_ARMV7M
    select AOS_COMP_RHINO
    help
      driver & sdk for platform/mcu swm320
endif

if AOS_MCU_SWM320
# Configurations for mcu swm320
endif
```

## platform/mcu/wm_w600/Config.in
```kconfig
if AOS_CREATE_PROJECT
config AOS_MCU_WM_W600
    bool
    default y
endif

if !AOS_CREATE_PROJECT
config AOS_MCU_WM_W600
    bool
    select AOS_ARCH_ARMV7M
    select AOS_COMP_RHINO
    help
      driver & sdk for platform/mcu wm_w600
endif

if AOS_MCU_WM_W600
# Configurations for mcu wm_w600
endif
```

## platform/mcu/xm510/Config.in
```kconfig
config AOS_MCU_XM510
    bool "mcu_xm510"
    select AOS_ARCH_ARMV7A
    select AOS_COMP_LWIP
    select AOS_COMP_NEWLIB_STUB
    select AOS_COMP_CRAMFS
    select AOS_COMP_JFFS2
    select AOS_COMP_CPLUSPLUS
    select AOS_COMP_RAMFS
    select AOS_COMP_RHINO
    select AOS_COMP_OSAL_POSIX
    select AOS_COMP_FATFS
    select AOS_COMP_VFS
    help
      driver & sdk for platform/mcu xm510

if AOS_MCU_XM510
# Configurations for mcu xm510
endif
```

## platform/mcu/xmc/Config.in
```kconfig
if AOS_CREATE_PROJECT
config AOS_MCU_XMC
    bool
    default y
endif

if !AOS_CREATE_PROJECT
config AOS_MCU_XMC
    bool
    select AOS_ARCH_ARMV7M
    select AOS_COMP_NEWLIB_STUB
    select AOS_COMP_RHINO
    help
      driver & sdk for platform/mcu xmc
endif

if AOS_MCU_XMC
# Configurations for mcu xmc
endif
```

## platform/mcu/xr871/Config.in
```kconfig
if AOS_CREATE_PROJECT
config AOS_MCU_XR871
    bool
    default y
endif

if !AOS_CREATE_PROJECT
config AOS_MCU_XR871
    bool
    select AOS_ARCH_ARMV7M
    select AOS_COMP_RHINO
    help
      driver & sdk for platform/mcu xr871
endif

if AOS_MCU_XR871
# Configurations for mcu xr871
endif
```

## ports/esp32/components/bus/Kconfig
```kconfig
menu "Bus Options"

    menu "I2C Bus Options"
        config I2C_BUS_DYNAMIC_CONFIG
            bool "enable dynamic configuration"
            default y
            help
                If enable, i2c_bus will dynamically check configs and re-install i2c driver before each transfer,
                hence multiple devices with different configs on a single bus can be supported.

        config I2C_MS_TO_WAIT
            int "mutex block time"
            default 200
            range 50 5000 
            help
                task block time when try to take the bus, unit:milliseconds
    endmenu

endmenu
```

## ports/esp32/components/esp-dl/examples/cat_face_detect/sdkconfig.defaults
```kconfig
CONFIG_ESPTOOLPY_FLASHSIZE_4MB=y

CONFIG_ESPTOOLPY_FLASHFREQ_80M=y
CONFIG_ESPTOOLPY_FLASHMODE_QIO=y

CONFIG_SPIRAM_SPEED_80M=y
```

## ports/esp32/components/esp-dl/examples/face_recognition/sdkconfig.defaults
```kconfig
CONFIG_ESPTOOLPY_FLASHSIZE_4MB=y

CONFIG_ESPTOOLPY_FLASHFREQ_80M=y
CONFIG_ESPTOOLPY_FLASHMODE_QIO=y

CONFIG_SPIRAM_SPEED_80M=y

CONFIG_PARTITION_TABLE_CUSTOM=y
CONFIG_PARTITION_TABLE_CUSTOM_FILENAME="partitions.csv"
```

## ports/esp32/components/esp-dl/examples/face_recognition/sdkconfig.defaults.esp32s3
```kconfig
CONFIG_ESP32S3_DEFAULT_CPU_FREQ_240=y
CONFIG_ESP32S3_SPIRAM_SUPPORT=y

CONFIG_ESP32S3_DATA_CACHE_64KB=y
CONFIG_ESP32S3_DATA_CACHE_8WAYS=y
CONFIG_ESP32S3_DATA_CACHE_LINE_64B=y

CONFIG_ESPTOOLPY_NO_STUB=y
CONFIG_ESP_CONSOLE_USB_SERIAL_JTAG=y

CONFIG_SPIRAM_MODE_OCT=y
CONFIG_S8=y
```

## ports/esp32/components/esp-dl/tutorial/sdkconfig.defaults.esp32s2
```kconfig
CONFIG_ESP32S2_DEFAULT_CPU_FREQ_240=y
CONFIG_ESP32S2_SPIRAM_SUPPORT=y

CONFIG_ESP32S2_DATA_CACHE_16KB=y
ESP32S2_DATA_CACHE_LINE_32B=y
```

## ports/esp32/components/screen/Kconfig
```kconfig
menu "LCD Drivers"

    menu "Select Screen Controller"
        config LCD_DRIVER_SCREEN_CONTROLLER_ILI9341
            bool "ILI9341"
            default y
        config LCD_DRIVER_SCREEN_CONTROLLER_ILI9486
            bool "ILI9486"
            default n
        config LCD_DRIVER_SCREEN_CONTROLLER_ILI9806
            bool "ILI9806"
            default n
        config LCD_DRIVER_SCREEN_CONTROLLER_ILI9488
            bool "ILI9488"
            default n
        config LCD_DRIVER_SCREEN_CONTROLLER_NT35510
            bool "NT35510"
            default n
        config LCD_DRIVER_SCREEN_CONTROLLER_RM68120
            bool "RM68120"
            default n
        config LCD_DRIVER_SCREEN_CONTROLLER_SSD1351
            bool "SSD1351"
            default n
        config LCD_DRIVER_SCREEN_CONTROLLER_SSD1963
            bool "SSD1963"
            default n
        config LCD_DRIVER_SCREEN_CONTROLLER_ST7789
            bool "ST7789"
            default n
        config LCD_DRIVER_SCREEN_CONTROLLER_ST7796
            bool "ST7796"
            default n
        
        config LCD_DRIVER_SCREEN_CONTROLLER_SSD1306
            bool "SSD1306"
            default n
        config LCD_DRIVER_SCREEN_CONTROLLER_SSD1307
            bool "SSD1307"
            default n
        config LCD_DRIVER_SCREEN_CONTROLLER_SSD1322
            bool "SSD1322"
            default n
    endmenu

endmenu
```

## projects/Config.in
```kconfig
config AOS_APP_EXAMPLE
    bool "Builtin Examples"

if AOS_APP_EXAMPLE
choice
    prompt "Select example"

source "projects/main_driver/Config.in"
if AOS_APP_MAIN_DRIVER
    config AOS_BUILD_APP
           default "main_driver"
endif

source "projects/alios_kernel/Config.in"
if AOS_APP_ALIOS_KERNEL
    config AOS_BUILD_APP
        default "alios_kernel"
endif

source "projects/uapp_helloworld1/Config.in"
if AOS_APP_UAPP_HELLOWORLD1
    config AOS_BUILD_APP
        default "uapp_helloworld1"
endif

source "projects/uapp_helloworld2/Config.in"
if AOS_APP_UAPP_HELLOWORLD2
    config AOS_BUILD_APP
        default "uapp_helloworld2"
endif

source "projects/procmgmt/Config.in"
if AOS_APP_PROCMGMT
    config AOS_BUILD_APP
        default "procmgmt"
endif


source "projects/link_sdk_demos/Config.in"
if AOS_APP_LINK_SDK_DEMOS
    config AOS_BUILD_APP
        default "link_sdk_demos"
endif

source "projects/ulwip_service/Config.in"
if AOS_APP_ULWIP_SERVICE
    config AOS_BUILD_APP
        default "ulwip_service"
endif

endchoice
endif
```

## projects/alios_kernel/Config.in
```kconfig
config AOS_APP_ALIOS_KERNEL
    bool "alios_kernel"
    select AOS_COMP_OSAL_AOS
    select AOS_CONFIG_USER_SPACE
    select AOS_COMP_KV
    select AOS_COMP_ULOG
    select AOS_COMP_CLI
    select AOS_COMP_VFS
    select AOS_COMP_LWIP
    # select AOS_COMP_NETMGR # if build netmgr in kernel need open it
    #select AOS_COMP_EPOLL
    #select AOS_COMP_SELECT
    select AOS_COMP_ROMFS
    help
        alios kernel

if AOS_APP_ALIOS_KERNEL
# Configurations for app helloworld
config AOS_KERNEL_MODE
    bool
    default y

config LFS_CONFIG_IN_KERNEL
    bool "littlefs in kernel"
    select AOS_COMP_LITTLEFS
    select AOS_COMP_IOBOX
    default n
    help
        "set littlefs component in kernel"
endif
```

## projects/link_sdk_demos/Config.in
```kconfig
config AOS_APP_LINK_SDK_DEMOS
    bool "link_sdk_demos"
    select AOS_COMP_MBEDTLS
    select AOS_COMP_ULOG
    select AOS_COMP_VFS
    select AOS_COMP_LINK_SDK
    select AOS_COMP_NETMGR_RPC
    select AOS_COMP_SOCKET_RPC_CLIENT
    select AOS_COMP_OTA if AOS_BOARD_HAAS100_MK
    select CONFIG_NEW_HTTP_API if AOS_BOARD_HAAS100_MK
    help
        "link sdk demos"

if AOS_APP_LINK_SDK_DEMOS
# Configurations for app link_sdk_demos

config RHINO_CONFIG_APP_NAME
    string "app name"
    default "link_sdk_demos"
    help
        "set app name, it's also the first task name"

config RHINO_CONFIG_APP_VERSION
    hex "app version"
    default 0x00000001
    help
        "set app version"

config RHINO_CONFIG_APP_ENTRY_TASK_NAME
    string "app first task name"
    default "link_sdk_entry_task"
    help
        "set app first task name"

config RHINO_CONFIG_APP_ENTRY_TASK_PRIO
    int "app entry task priority"
    default 20
    help
        "set app entry task priority"

config RHINO_CONFIG_APP_ENTRY_TASK_KSTACK_SIZE
    int "app entry task kstack size"
    default 4096
    help
        "set app entry task kstack size, the unit is cpu_stack_t"

config RHINO_CONFIG_APP_ENTRY_TASK_USTACK_SIZE
    int "app entry task ustack size"
    default 10000
    help
        "set app entry task ustack size, the unit is cpu_stack_t"

config RHINO_CONFIG_APP_ULOG_FS_PATH
    string "app ulog fs path"
    default "/data/syslog/link_sdk_demo"
    help
        "set app ulog to fs path"

config RHINO_CONFIG_APP_ULOG_FS_BACKUP_PATH
    string "app ulog fs backup path"
    default "/data/syslog/backup/link_sdk_demo"
    help
        "set app ulog to fs backup path"

source "kernel/core/mk/uspace/Config.in"

choice
    prompt "Select demo"
    default LINK_SDK_DEMO_DATA_MODEL
    help
        Select the sample program to run

    config LINK_SDK_DEMO_MQTT_BASIC
        bool "mqtt basic"
        help
            build mqtt_basic_demo.c

    config LINK_SDK_DEMO_MQTT_BROADCAST
        bool "mqtt broadcast"
        help
            build mqtt_broadcast_demo.c

    config LINK_SDK_DEMO_MQTT_RRPC
        bool "mqtt pprc"
        help
            build mqtt_rrpc_demo.c

    config LINK_SDK_DEMO_DATA_MODEL
        bool "data model"
        select LINK_SDK_DATA_MODEL
        help
            build data_model_basic_demo.c

    config LINK_SDK_DEMO_SUBDEV
        bool "sub device"
        select LINK_SDK_SUBDEV
        help
            build subdev_basic_demo.c

    config LINK_SDK_DEMO_BOOTSTRAP
        bool "bootstrap"
        select LINK_SDK_BOOTSTRAP
        help
            build bootstrap_posix_demo.c

    config LINK_SDK_DEMO_COTA
        bool "cota"
        select LINK_SDK_OTA
        help
            build cota_basic_demo.c

    config LINK_SDK_DEMO_HTTP
        bool "http"
        select LINK_SDK_HTTP
        help
            build http_basic_demo.c

    config LINK_SDK_DEMO_NTP
        bool "ntp"
        select LINK_SDK_NTP
        help
            build ntp_posix_demo.c

    config LINK_SDK_DEMO_SHADOW
        bool "device shadow"
        select LINK_SDK_SHADOW
        help
            build shadow_basic_demo.c

    config LINK_SDK_DEMO_LOGPOST
        bool "log post"
        select LINK_SDK_LOGPOST
        help
            build logpost_basic_demo.c

    config LINK_SDK_DEMO_DIAG
        bool "diag"
        select LINK_SDK_DIAG
        select LINK_SDK_DATA_MODEL
        help
            build diag_basic_demo.c

    config LINK_SDK_DEMO_DEVINFO
        bool "device info"
        select LINK_SDK_DEVINFO
        help
            build devinfo_posix_demo.c

    config LINK_SDK_DEMO_DYNREG
        bool "dynamic register"
        select LINK_SDK_DYNREG_HTTP
        help
            build dynreg_basic_demo.c

    config LINK_SDK_DEMO_DYNREG_MQTT
        bool "dynamic register with mqtt"
        select LINK_SDK_DYNREG_MQTT
        help
            build dynregmqt_basic_demo.c

endchoice

endif
```
