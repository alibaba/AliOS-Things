/* This file is generated by nds_ldsag (version (2015-08-19) ). */
ENTRY(_start)
SECTIONS
{
	PROVIDE (__executable_start = 0x00000000);
	NDS_SAG_LMA_SYS = 0x00000000 ;
	SYS_BEGIN = NDS_SAG_LMA_SYS;
	. = 0x00000000;
	MEM_ILM_BEGIN = .;
	_ILM_BASE = 0x00000000;
	_DLM_BASE = 0x00100000;
	_ILM_SIZE = 0x00080000;
	_DLM_SIZE = 0x00010000;
	.vector 	: { *(.vector ) }
	.nds32_init 	: { KEEP(*(.nds32_init )) }
	.fast_prog 	: { *(.fast_prog ) }
	.text 	: { *(.text .stub .text.* .gnu.linkonce.t.* ) KEEP(*(.text.*personality* )) *(.gnu.warning ) . = ALIGN(4); }
	MEM_ILM_SIZE = . - MEM_ILM_BEGIN;
	. = 0x000F8000;
	SDRAM_BEGIN = .;
	.slow_prog 	: AT(LOADADDR (.text) + SIZEOF (.text))
		{ *(.slow_prog ) }
	SDRAM_SIZE = . - SDRAM_BEGIN;
	. = 0x00100000;
	MEM_DLM_BEGIN = .;
	.interp 	: AT(ALIGN(LOADADDR (.slow_prog) + SIZEOF (.slow_prog), ALIGNOF(.interp)))
		{ *(.interp ) }
	.hash 	: AT(ALIGN(LOADADDR (.interp) + SIZEOF (.interp), ALIGNOF(.hash)))
		{ *(.hash ) }
	.dynsym 	: AT(ALIGN(LOADADDR (.hash) + SIZEOF (.hash), ALIGNOF(.dynsym)))
		{ *(.dynsym ) }
	.dynstr 	: AT(ALIGN(LOADADDR (.dynsym) + SIZEOF (.dynsym), ALIGNOF(.dynstr)))
		{ *(.dynstr ) }
	.gnu.version 	: AT(ALIGN(LOADADDR (.dynstr) + SIZEOF (.dynstr), ALIGNOF(.gnu.version)))
		{ *(.gnu.version ) }
	.gnu.version_d 	: AT(ALIGN(LOADADDR (.gnu.version) + SIZEOF (.gnu.version), ALIGNOF(.gnu.version_d)))
		{ *(.gnu.version_d ) }
	.gnu.version_r 	: AT(ALIGN(LOADADDR (.gnu.version_d) + SIZEOF (.gnu.version_d), ALIGNOF(.gnu.version_r)))
		{ *(.gnu.version_r ) }
	.rel.init 	: AT(ALIGN(LOADADDR (.gnu.version_r) + SIZEOF (.gnu.version_r), ALIGNOF(.rel.init)))
		{ *(.rel.init ) }
	.rela.init 	: AT(ALIGN(LOADADDR (.rel.init) + SIZEOF (.rel.init), ALIGNOF(.rela.init)))
		{ *(.rela.init ) }
	.rel.text 	: AT(ALIGN(LOADADDR (.rela.init) + SIZEOF (.rela.init), ALIGNOF(.rel.text)))
		{ *(.rel.text .rel.text.* .rel.gnu.linkonce.t.* ) }
	.rela.text 	: AT(ALIGN(LOADADDR (.rel.text) + SIZEOF (.rel.text), ALIGNOF(.rela.text)))
		{ *(.rela.text .rela.text.* .rela.gnu.linkonce.t.* ) }
	.rel.fini 	: AT(ALIGN(LOADADDR (.rela.text) + SIZEOF (.rela.text), ALIGNOF(.rel.fini)))
		{ *(.rel.fini ) }
	.rela.fini 	: AT(ALIGN(LOADADDR (.rel.fini) + SIZEOF (.rel.fini), ALIGNOF(.rela.fini)))
		{ *(.rela.fini ) }
	.rel.rodata 	: AT(ALIGN(LOADADDR (.rela.fini) + SIZEOF (.rela.fini), ALIGNOF(.rel.rodata)))
		{ *(.rel.rodata .rel.rodata.* .rel.gnu.linkonce.r.* ) }
	.rela.rodata 	: AT(ALIGN(LOADADDR (.rel.rodata) + SIZEOF (.rel.rodata), ALIGNOF(.rela.rodata)))
		{ *(.rela.rodata .rela.rodata.* .rela.gnu.linkonce.r.* ) }
	.rel.data.rel.ro 	: AT(ALIGN(LOADADDR (.rela.rodata) + SIZEOF (.rela.rodata), ALIGNOF(.rel.data.rel.ro)))
		{ *(.rel.data.rel.ro* ) }
	.rela.data.rel.ro 	: AT(ALIGN(LOADADDR (.rel.data.rel.ro) + SIZEOF (.rel.data.rel.ro), ALIGNOF(.rela.data.rel.ro)))
		{ *(.rel.data.rel.ro* ) }
	.rel.data 	: AT(ALIGN(LOADADDR (.rela.data.rel.ro) + SIZEOF (.rela.data.rel.ro), ALIGNOF(.rel.data)))
		{ *(.rel.data .rel.data.* .rel.gnu.linkonce.d.* ) }
	.rela.data 	: AT(ALIGN(LOADADDR (.rel.data) + SIZEOF (.rel.data), ALIGNOF(.rela.data)))
		{ *(.rela.data .rela.data.* .rela.gnu.linkonce.d.* ) }
	.rel.tdata 	: AT(ALIGN(LOADADDR (.rela.data) + SIZEOF (.rela.data), ALIGNOF(.rel.tdata)))
		{ *(.rel.tdata .rel.tdata.* .rel.gnu.linkonce.td.* ) }
	.rela.tdata 	: AT(ALIGN(LOADADDR (.rel.tdata) + SIZEOF (.rel.tdata), ALIGNOF(.rela.tdata)))
		{ *(.rela.tdata .rela.tdata.* .rela.gnu.linkonce.td.* ) }
	.rel.tbss 	: AT(ALIGN(LOADADDR (.rela.tdata) + SIZEOF (.rela.tdata), ALIGNOF(.rel.tbss)))
		{ *(.rel.tbss .rel.tbss.* .rel.gnu.linkonce.tb.* ) }
	.rela.tbss 	: AT(ALIGN(LOADADDR (.rel.tbss) + SIZEOF (.rel.tbss), ALIGNOF(.rela.tbss)))
		{ *(.rela.tbss .rela.tbss.* .rela.gnu.linkonce.tb.* ) }
	.rel.ctors 	: AT(ALIGN(LOADADDR (.rela.tbss) + SIZEOF (.rela.tbss), ALIGNOF(.rel.ctors)))
		{ *(.rel.ctors ) }
	.rela.ctors 	: AT(ALIGN(LOADADDR (.rel.ctors) + SIZEOF (.rel.ctors), ALIGNOF(.rela.ctors)))
		{ *(.rela.ctors ) }
	.rel.dtors 	: AT(ALIGN(LOADADDR (.rela.ctors) + SIZEOF (.rela.ctors), ALIGNOF(.rel.dtors)))
		{ *(.rel.dtors ) }
	.rela.dtors 	: AT(ALIGN(LOADADDR (.rel.dtors) + SIZEOF (.rel.dtors), ALIGNOF(.rela.dtors)))
		{ *(.rela.dtors ) }
	.rela.dyn 	: AT(ALIGN(LOADADDR (.rela.dtors) + SIZEOF (.rela.dtors), ALIGNOF(.rela.dyn)))
		{ *(rela.dyn ) *(.rela__libc_subfreeres ) *(.rela__libc_atexit ) *(.rela__libc_thread_subfreeres ) *(.rela.init_array ) *(.rela.fini_array ) }
	.rel.got 	: AT(ALIGN(LOADADDR (.rela.dyn) + SIZEOF (.rela.dyn), ALIGNOF(.rel.got)))
		{ *(.rel.got ) }
	.rela.got 	: AT(ALIGN(LOADADDR (.rel.got) + SIZEOF (.rel.got), ALIGNOF(.rela.got)))
		{ *(.rela.got ) }
	.rel.sdata 	: AT(ALIGN(LOADADDR (.rela.got) + SIZEOF (.rela.got), ALIGNOF(.rel.sdata)))
		{ *(.rel.sdata .rel.sdata.* .rel.gnu.linkonce.s.* ) }
	.rela.sdata 	: AT(ALIGN(LOADADDR (.rel.sdata) + SIZEOF (.rel.sdata), ALIGNOF(.rela.sdata)))
		{ *(.rela.sdata .rela.sdata.* .rela.gnu.linkonce.s.* ) }
	.rel.sbss 	: AT(ALIGN(LOADADDR (.rela.sdata) + SIZEOF (.rela.sdata), ALIGNOF(.rel.sbss)))
		{ *(.rel.sbss .rel.sbss.* .rel.gnu.linkonce.sb.* ) }
	.rela.sbss 	: AT(ALIGN(LOADADDR (.rel.sbss) + SIZEOF (.rel.sbss), ALIGNOF(.rela.sbss)))
		{ *(.rela.sbss .rela.sbss.* .rela.gnu.linkonce.sb.* ) }
	.rel.sdata2 	: AT(ALIGN(LOADADDR (.rela.sbss) + SIZEOF (.rela.sbss), ALIGNOF(.rel.sdata2)))
		{ *(.rel.sdata2 .rel.sdata2.* .rel.gnu.linkonce.s2.* ) }
	.rela.sdata2 	: AT(ALIGN(LOADADDR (.rel.sdata2) + SIZEOF (.rel.sdata2), ALIGNOF(.rela.sdata2)))
		{ *(.rela.sdata2 .rela.sdata2.* .rela.gnu.linkonce.s2.* ) }
	.rel.sbss2 	: AT(ALIGN(LOADADDR (.rela.sdata2) + SIZEOF (.rela.sdata2), ALIGNOF(.rel.sbss2)))
		{ *(.rel.sbss2 .rel.sbss2.* .rel.gnu.linkonce.sb2.* ) }
	.rela.sbss2 	: AT(ALIGN(LOADADDR (.rel.sbss2) + SIZEOF (.rel.sbss2), ALIGNOF(.rela.sbss2)))
		{ *(.rela.sbss2 .rela.sbss2.* .rela.gnu.linkonce.sb2.* ) }
	.rel.bss 	: AT(ALIGN(LOADADDR (.rela.sbss2) + SIZEOF (.rela.sbss2), ALIGNOF(.rel.bss)))
		{ *(.rel.bss .rel.bss.* .rel.gnu.linkonce.b.* ) }
	.rela.bss 	: AT(ALIGN(LOADADDR (.rel.bss) + SIZEOF (.rel.bss), ALIGNOF(.rela.bss)))
		{ *(.rela.bss .rela.bss.* .rela.gnu.linkonce.b.* ) }
	.rel.plt 	: AT(ALIGN(LOADADDR (.rela.bss) + SIZEOF (.rela.bss), ALIGNOF(.rel.plt)))
		{ *(.rel.plt ) }
	.rela.plt 	: AT(ALIGN(LOADADDR (.rel.plt) + SIZEOF (.rel.plt), ALIGNOF(.rela.plt)))
		{ *(.rela.plt ) }
	.init 	: AT(ALIGN(LOADADDR (.rela.plt) + SIZEOF (.rela.plt), ALIGNOF(.init)))
		{ KEEP(*(.init )) }
	.plt 	: AT(ALIGN(LOADADDR (.init) + SIZEOF (.init), ALIGNOF(.plt)))
		{ *(.plt ) }
	.fini 	: AT(ALIGN(LOADADDR (.plt) + SIZEOF (.plt), ALIGNOF(.fini)))
		{ KEEP(*(.fini )) }
	.ex9.itable 	: AT(ALIGN(LOADADDR (.fini) + SIZEOF (.fini), ALIGNOF(.ex9.itable)))
		{ *(.ex9.itable ) }
	PROVIDE (__etext = .);
	PROVIDE (_etext = .);
	PROVIDE (etext = .);
	.rodata 	: AT(ALIGN(LOADADDR (.ex9.itable) + SIZEOF (.ex9.itable), ALIGNOF(.rodata)))
		{ *(.rodata .rodata.* .gnu.linkonce.r.* ) }
	.rodata1 	: AT(ALIGN(LOADADDR (.rodata) + SIZEOF (.rodata), ALIGNOF(.rodata1)))
		{ *(.rodata1 ) }
	.sdata2 	: AT(ALIGN(LOADADDR (.rodata1) + SIZEOF (.rodata1), ALIGNOF(.sdata2)))
		{ *(.sdata2 .sdata2.* .gnu.linkonce.s2.* ) }
	.sbss2 	: AT(ALIGN(LOADADDR (.sdata2) + SIZEOF (.sdata2), ALIGNOF(.sbss2)))
		{ *(.sbss2 .sbss2.* .gnu.linkonce.sb2.* ) }
	.eh_frame_hdr 	: AT(ALIGN(LOADADDR (.sbss2) + SIZEOF (.sbss2), ALIGNOF(.eh_frame_hdr)))
		{ *(.eh_frame_hdr ) }
	. = ALIGN(0x20);
	.eh_frame 	: AT(ALIGN(LOADADDR (.eh_frame_hdr) + SIZEOF (.eh_frame_hdr), 32))
		{ KEEP(*(.eh_frame )) }
	.gcc_except_table 	: AT(ALIGN(LOADADDR (.eh_frame) + SIZEOF (.eh_frame), ALIGNOF(.gcc_except_table)))
		{ KEEP(*(.gcc_except_table )) *(.gcc_except_table.* ) }
	.tdata 	: AT(ALIGN(LOADADDR (.gcc_except_table) + SIZEOF (.gcc_except_table), ALIGNOF(.tdata)))
		{ *(.tdata .tdata.* .gnu.linkonce.td.* ) }
	. = ALIGN(4);
	PROVIDE (__preinit_array_start = .);
	.preinit_array 	: AT(ALIGN(ALIGN(LOADADDR (.tdata) + SIZEOF (.tdata), ALIGNOF(.preinit_array)), 4))
		{ KEEP(*(.preinit_array )) }
	PROVIDE (__preinit_array_end = .);
	PROVIDE (__init_array_start = .);
	.init_array 	: AT(ALIGN(LOADADDR (.preinit_array) + SIZEOF (.preinit_array), ALIGNOF(.init_array)))
		{ KEEP(*(.init_array )) }
	PROVIDE (__init_array_end = .);
	PROVIDE (__fini_array_start = .);
	.fini_array 	: AT(ALIGN(LOADADDR (.init_array) + SIZEOF (.init_array), ALIGNOF(.fini_array)))
		{ KEEP(*(.fini_array )) }
	PROVIDE (__fini_array_end = .);
	.ctors 	: AT(ALIGN(LOADADDR (.fini_array) + SIZEOF (.fini_array), ALIGNOF(.ctors)))
		{ KEEP(*crtbegin*.o(.ctors)) KEEP(*(EXCLUDE_FILE (*crtend*.o) .ctors)) KEEP(*(SORT(.ctors.* ))) KEEP(*(.ctors )) }
	.dtors 	: AT(ALIGN(LOADADDR (.ctors) + SIZEOF (.ctors), ALIGNOF(.dtors)))
		{ KEEP(*crtbegin*.o(.dtors)) KEEP(*(EXCLUDE_FILE (*crtend*.o) .dtors)) KEEP(*(SORT(.dtors.* ))) KEEP(*(.dtors )) }
	.jcr 	: AT(ALIGN(LOADADDR (.dtors) + SIZEOF (.dtors), ALIGNOF(.jcr)))
		{ KEEP(*(.jcr )) }
	.data.rel.ro 	: AT(ALIGN(LOADADDR (.jcr) + SIZEOF (.jcr), ALIGNOF(.data.rel.ro)))
		{ *(.data.rel.ro.local ) *(.data.rel.ro* ) }
	.dynamic 	: AT(ALIGN(LOADADDR (.data.rel.ro) + SIZEOF (.data.rel.ro), ALIGNOF(.dynamic)))
		{ *(.dynamic ) }
	.data 	: AT(ALIGN(LOADADDR (.dynamic) + SIZEOF (.dynamic), ALIGNOF(.data)))
		{ *(.data .data.* .gnu.linkonce.d.* ) KEEP(*(.gnu.linkonce.d.*personality* )) SORT(CONSTRUCTORS) . = ALIGN(8); }
	.data1 	: AT(ALIGN(LOADADDR (.data) + SIZEOF (.data), ALIGNOF(.data1)))
		{ *(.data1 ) . = ALIGN(8); }
	. = ALIGN(4);
	.got 	: AT(ALIGN(ALIGN(LOADADDR (.data1) + SIZEOF (.data1), ALIGNOF(.got)), 4))
		{ *(.got.plt ) *(.got ) }
	.sdata_d 	: AT(ALIGN(LOADADDR (.got) + SIZEOF (.got), ALIGNOF(.sdata_d)))
		{ *(.sdata_d .sdata_d.* ) }
	.sdata_w 	: AT(ALIGN(LOADADDR (.sdata_d) + SIZEOF (.sdata_d), ALIGNOF(.sdata_w)))
		{ *(.sdata_w .sdata_w.* ) }
	.sdata_h 	: AT(ALIGN(LOADADDR (.sdata_w) + SIZEOF (.sdata_w), ALIGNOF(.sdata_h)))
		{ *(.sdata_h .sdata_h.* ) }
	.sdata_b 	: AT(ALIGN(LOADADDR (.sdata_h) + SIZEOF (.sdata_h), ALIGNOF(.sdata_b)))
		{ *(.sdata_b .sdata_b.* ) }
	.sdata_f 	: AT(ALIGN(LOADADDR (.sdata_b) + SIZEOF (.sdata_b), ALIGNOF(.sdata_f)))
		{ *(.sdata_f .sdata_f.* ) }
	. = ALIGN(4);
	_edata = .;
	PROVIDE (edata = .);
	__bss_start = .;
	PROVIDE (__sbss_start = .);
	PROVIDE (___sbss_start = .);
	.tbss 	: AT(ALIGN(ALIGN(LOADADDR (.sdata_f) + SIZEOF (.sdata_f), ALIGNOF(.tbss)), 4))
		{ *(.tbss .tbss.* .gnu.linkonce.tb.* ) *(.tcommon ) }
	.sbss_f 	: AT(ALIGN(LOADADDR (.tbss) + SIZEOF (.tbss), ALIGNOF(.sbss_f)))
		{ *(.sbss_f .sbss_f.* ) *(.scommon_f .scommon_f.* ) }
	.sbss_b 	: AT(ALIGN(LOADADDR (.sbss_f) + SIZEOF (.sbss_f), ALIGNOF(.sbss_b)))
		{ *(.sbss_b .sbss_b.* ) *(.scommon_b .scommon_b.* ) . = ALIGN(2); }
	.sbss_h 	: AT(ALIGN(LOADADDR (.sbss_b) + SIZEOF (.sbss_b), ALIGNOF(.sbss_h)))
		{ *(.sbss_h .sbss_h.* ) *(.scommon_h .scommon_h.* ) . = ALIGN(4); }
	.sbss_w 	: AT(ALIGN(LOADADDR (.sbss_h) + SIZEOF (.sbss_h), ALIGNOF(.sbss_w)))
		{ *(.sbss_w .sbss_w.* ) *(.scommon_w .scommon_w.* ) *(.dynsbss ) *(.scommon ) . = ALIGN(8); }
	.sbss_d 	: AT(ALIGN(LOADADDR (.sbss_w) + SIZEOF (.sbss_w), ALIGNOF(.sbss_d)))
		{ *(.sbss_d .sbss_d.* ) *(.scommon_d .scommon_d.* ) }
	.bss 	: AT(ALIGN(LOADADDR (.sbss_d) + SIZEOF (.sbss_d), ALIGNOF(.bss)))
		{ *(.dynbss ) *(.bss .bss.* .gnu.linkonce.b.* ) *(COMMON ) . = ALIGN(4); }
	PROVIDE (__sbss_end = .);
	PROVIDE (___sbss_end = .);
	. = ALIGN(4);
	_end = .;
	PROVIDE (end = .);
	PROVIDE (_stack = 0x00110000);
	MEM_DLM_SIZE = . - MEM_DLM_BEGIN;
	. = 0x00200000;
	LPRAM_BEGIN = .;
	.lpram 	: AT(LOADADDR (.bss) + SIZEOF (.bss))
		{ *(.lpram ) }
	LPRAM_SIZE = . - LPRAM_BEGIN;
	SYS_SIZE = LOADADDR(.lpram) + SIZEOF(.lpram) - SYS_BEGIN;
	.stab	0 : { *(.stab) }
	.stabstr	0 : { *(.stabstr) }
	.stab.excl	0 : { *(.stab.excl) }
	.stab.exclstr	0 : { *(.stab.exclstr) }
	.stab.index	0 : { *(.stab.index) }
	.stab.indexstr	0 : { *(.stab.indexstr) }
	.note.nds32	0 : { *(.note.nds32) *(.note.nds32.*) }
	.comment	0 : { *(.comment) }
	.debug	0 : { *(.debug) }
	.line	0 : { *(.line) }
	.debug_srcinfo	0 : { *(.debug_srcinfo) }
	.debug_sfnames	0 : { *(.debug_sfnames) }
	.debug_aranges	0 : { *(.debug_aranges) }
	.debug_pubnames	0 : { *(.debug_pubnames) }
	.debug_info	0 : { *(.debug_info .gnu.linkonce.wi.*) }
	.debug_abbrev	0 : { *(.debug_abbrev) }
	.debug_line	0 : { *(.debug_line) }
	.debug_frame	0 : { *(.debug_frame) }
	.debug_str	0 : { *(.debug_str) }
	.debug_loc	0 : { *(.debug_loc) }
	.debug_macinfo	0 : { *(.debug_macinfo) }
	.debug_weaknames	0 : { *(.debug_weaknames) }
	.debug_funcnames	0 : { *(.debug_funcnames) }
	.debug_typenames	0 : { *(.debug_typenames) }
	.debug_varnames	0 : { *(.debug_varnames) }
}
ASSERT((DEFINED (_RELAX_END_) ? MEM_ILM_SIZE : 0x0) <= 0x00010000, OVERFLOW);
ASSERT((DEFINED (_RELAX_END_) ? SDRAM_SIZE : 0x0) <= 0x00018000, OVERFLOW);
ASSERT((DEFINED (_RELAX_END_) ? MEM_DLM_SIZE : 0x0) <= 0x00010000, OVERFLOW);
ASSERT((DEFINED (_RELAX_END_) ? LPRAM_SIZE : 0x0) <= 0x00002000, OVERFLOW);
ASSERT((DEFINED (_RELAX_END_) ? SYS_SIZE : 0x0) <= 0x00202000, OVERFLOW);
