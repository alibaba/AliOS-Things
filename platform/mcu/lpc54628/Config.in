## platform/mcu/lpc54628/Config.in
```kconfig
if AOS_CREATE_PROJECT
config AOS_MCU_LPC54628IMPL
    bool
    default y
endif

if !AOS_CREATE_PROJECT
config AOS_MCU_LPC54628IMPL
    bool
    select AOS_ARCH_ARMV7M
    select AOS_COMP_NEWLIB_STUB
    select AOS_COMP_RHINO
    help
      driver & sdk for platform/mcu lpc54628impl
endif

if AOS_MCU_LPC54628IMPL
# Configurations for mcu lpc54628impl
endif
```

## platform/mcu/m487jidae/Config.in
```kconfig
if AOS_CREATE_PROJECT
config AOS_MCU_M487JIDAE
    bool
    default y
endif


if !AOS_CREATE_PROJECT
config AOS_MCU_M487JIDAE
    bool
    select AOS_ARCH_ARMV7M
    select AOS_COMP_RHINO
    help
      driver & sdk for platform/mcu m487jidae
endif

if AOS_MCU_M487JIDAE
# Configurations for mcu m487jidae
endif
```

## platform/mcu/mimxrt1021/Config.in
```kconfig
config AOS_MCU_MIMXRT1021IMPL
    bool
    select AOS_ARCH_ARMV7M
    select AOS_COMP_RHINO
    select AOS_COMP_NEWLIB_STUB
    select CONFIG_NO_TCPIP
    help
      driver & sdk for platform/mcu mimxrt1021impl

if AOS_MCU_MIMXRT1021IMPL
# Configurations for mcu mimxrt1021impl
endif
```

## platform/mcu/mimxrt1052/Config.in
```kconfig
if AOS_CREATE_PROJECT
config AOS_MCU_MIMXRT1052IMPL
    bool
    default y
    select CONFIG_NO_TCPIP
endif

if !AOS_CREATE_PROJECT
config AOS_MCU_MIMXRT1052IMPL
    bool
    select AOS_ARCH_ARMV7M
    select AOS_COMP_RHINO
    select AOS_COMP_NEWLIB_STUB
    select CONFIG_NO_TCPIP
    help
      driver & sdk for platform/mcu mimxrt1052impl
endif

if AOS_MCU_MIMXRT1052IMPL
# Configurations for mcu mimxrt1052impl
endif
```

## platform/mcu/mkl26z4/Config.in
```kconfig
if AOS_CREATE_PROJECT
config AOS_MCU_MKL26Z4IMPL
    bool
    default y
endif

if !AOS_CREATE_PROJECT
config AOS_MCU_MKL26Z4IMPL
    bool
    select AOS_ARCH_ARMV6M
    select AOS_COMP_RHINO
    select AOS_COMP_NEWLIB_STUB
    help
      driver & sdk for platform/mcu mkl26z4impl
endif

if AOS_MCU_MKL26Z4IMPL
# Configurations for mcu mkl26z4impl
endif
```

## platform/mcu/mkl27z644/Config.in
```kconfig
if AOS_CREATE_PROJECT
config AOS_MCU_MKL27Z644IMPL
    bool
    default y
endif

if !AOS_CREATE_PROJECT
config AOS_MCU_MKL27Z644IMPL
    bool
    select AOS_ARCH_ARMV6M
    select AOS_COMP_RHINO
    select AOS_COMP_NEWLIB_STUB
    help
      driver & sdk for platform/mcu mkl27z644impl
endif

if AOS_MCU_MKL27Z644IMPL
# Configurations for mcu mkl27z644impl
endif
```

## platform/mcu/mkl28z7/Config.in
```kconfig
config AOS_MCU_MKL28Z7IMPL
    bool
    select AOS_ARCH_ARMV6M
    select AOS_COMP_RHINO
    select AOS_COMP_NEWLIB_STUB
    help
      driver & sdk for platform/mcu mkl28z7impl

if AOS_MCU_MKL28Z7IMPL
# Configurations for mcu mkl28z7impl
endif
```

## platform/mcu/mkl43z4/Config.in
```kconfig
config AOS_MCU_MKL43Z4IMPL
    bool
    select AOS_ARCH_ARMV6M
    select AOS_COMP_RHINO
    select AOS_COMP_NEWLIB_STUB
    help
      driver & sdk for platform/mcu mkl43z4impl

if AOS_MCU_MKL43Z4IMPL
# Configurations for mcu mkl43z4impl
endif
```

## platform/mcu/mkl81z7/Config.in
```kconfig
if AOS_CREATE_PROJECT
config AOS_MCU_MKL81Z7IMPL
    bool
    default y
endif

if !AOS_CREATE_PROJECT
config AOS_MCU_MKL81Z7IMPL
    bool
    select AOS_ARCH_ARMV6M
    select AOS_COMP_RHINO
    select AOS_COMP_NEWLIB_STUB
    help
      driver & sdk for platform/mcu mkl81z7impl
endif

if AOS_MCU_MKL81Z7IMPL
# Configurations for mcu mkl81z7impl
endif
```

## platform/mcu/mkl82z7/Config.in
```kconfig
if AOS_CREATE_PROJECT
config AOS_MCU_MKL82Z7IMPL
    bool
    default y
endif

if !AOS_CREATE_PROJECT
config AOS_MCU_MKL82Z7IMPL
    bool
    select AOS_ARCH_ARMV6M
    select AOS_COMP_RHINO
    select AOS_COMP_NEWLIB_STUB
    help
      driver & sdk for platform/mcu mkl82z7impl
endif

if AOS_MCU_MKL82Z7IMPL
# Configurations for mcu mkl82z7impl
endif
```

## platform/mcu/moc108/Config.in
```kconfig
if AOS_CREATE_PROJECT
config AOS_MCU_MOC108
    bool
    default y
endif

if !AOS_CREATE_PROJECT
config AOS_MCU_MOC108
    bool
    select AOS_COMP_NETMGR
    select AOS_COMP_NEWLIB_STUB
    select AOS_ARCH_ARMV5
    select AOS_COMP_RHINO
    select AOS_COMP_YLOOP
    select AOS_COMP_LIBPROV
    help
      driver & sdk for platform/mcu moc108
endif

if AOS_MCU_MOC108
# Configurations for mcu moc108
endif
```

## platform/mcu/msp432p4xx/Config.in
```kconfig
menuconfig AOS_MCU_MSP432P4XX
    bool "mcu_msp432p4xx"
    default n
    select AOS_ARCH_ARMV7M
    select AOS_COMP_LIBC
    select AOS_COMP_RHINO
    help
      driver & sdk for platform/mcu msp432p4xx

if AOS_MCU_MSP432P4XX
# Configurations for mcu msp432p4xx
endif
```

## platform/mcu/mvs_ap80xx/Config.in
```kconfig
if AOS_CREATE_PROJECT
config AOS_MCU_MVS_AP80XX
    bool
    default y
endif

if !AOS_CREATE_PROJECT
config AOS_MCU_MVS_AP80XX
    bool
    select AOS_ARCH_ARMV7M
    select AOS_COMP_RHINO
    help
      driver & sdk for platform/mcu mvs_ap80xx
endif

if AOS_MCU_MVS_AP80XX
# Configurations for mcu mvs_ap80xx
endif
```

## platform/mcu/mx1101/Config.in
```kconfig
if AOS_CREATE_PROJECT
config AOS_MCU_MX1101
    bool
    default y
endif

if !AOS_CREATE_PROJECT
config AOS_MCU_MX1101
    bool
    select AOS_ARCH_ARMV7M
    select AOS_COMP_RHINO
    help
      driver & sdk for platform/mcu MX1101
endif

if AOS_MCU_MX1101
# Configurations for mcu MX1101
endif
```

## platform/mcu/nano130ke3bn/Config.in
```kconfig
menuconfig AOS_MCU_NANO130KE3BN
    bool "nano130ke3bn"
    default n
    select AOS_ARCH_ARMV6M
    select AOS_COMP_RHINO
    help

if AOS_MCU_NANO130KE3BN
# Configurations for mcu nano130ke3bn
endif
```

## platform/mcu/nrf52xxx/Config.in
```kconfig
menuconfig AOS_MCU_NRF52XXX
    bool "nrf52xxx"
    default n
    select AOS_COMP_NEWLIB_STUB
    select AOS_COMP_COMMON
    select AOS_ARCH_ARMV7M
    select AOS_COMP_HAL
    select AOS_COMP_RHINO
    select AOS_COMP_DIGEST_ALGORITHM
    select AOS_COMP_VFS
    select AOS_COMP_BT
    help

if AOS_MCU_NRF52XXX
# Configurations for mcu nrf52xxx
endif
```

## platform/mcu/nrf52xxx/bt_controller/Config.in
```kconfig
menuconfig AOS_COMP_BT_CONTROLLER
    bool "bt_controller"
    default n
    help

if AOS_COMP_BT_CONTROLLER
# Configurations for comp bt_controller
endif
```

## platform/mcu/rda5981x/Config.in
```kconfig
if AOS_CREATE_PROJECT
config AOS_MCU_RDA5981X
    bool
    default y
endif

if !AOS_CREATE_PROJECT
config AOS_MCU_RDA5981X
    bool
    select AOS_COMP_CLI
    select AOS_COMP_NETMGR
    select AOS_ARCH_ARMV7M
    select AOS_COMP_RHINO
    select AOS_COMP_NEWLIB_STUB
    help
      driver & sdk for platform/mcu RDA5981x
endif

if AOS_MCU_RDA5981X
# Configurations for mcu RDA5981x
endif
```

## platform/mcu/rda8955/Config.in
```kconfig
menuconfig AOS_MCU_RDA8955
    bool "mcu_RDA8955"
    default n
    select AOS_ARCH_MIPS-I
    select AOS_COMP_LWIP
    select AOS_COMP_NEWLIB_STUB
    select AOS_COMP_CJSON
    select AOS_COMP_NETMGR
    select AOS_COMP_RHINO
    help
      driver & sdk for platform/mcu RDA8955

if AOS_MCU_RDA8955
# Configurations for mcu RDA8955
endif
```

## platform/mcu/rtl8710bn/Config.in
```kconfig
if AOS_CREATE_PROJECT
config AOS_MCU_RTL8710BN
    bool
    default y
endif

if !AOS_CREATE_PROJECT
config AOS_MCU_RTL8710BN
    bool
    select AOS_COMP_NETMGR
    select AOS_ARCH_ARMV7M
    select AOS_COMP_RHINO
    select AOS_COMP_NEWLIB_STUB
    select AOS_COMP_DEBUG
    help
      driver & sdk for platform/mcu rtl8710bn
endif

if AOS_MCU_RTL8710BN
# Configurations for mcu rtl8710bn
endif
```

## platform/mcu/sscp131/Config.in
```kconfig
menuconfig AOS_MCU_SSCP131
    bool "sscp131"
    default n
    select AOS_ARCH_ARMV7M
    select AOS_COMP_RHINO
    help

if AOS_MCU_SSCP131
# Configurations for mcu sscp131
endif
```

## platform/mcu/stm32f0xx/Config.in
```kconfig
if AOS_CREATE_PROJECT
config AOS_MCU_STM32F0XX
    bool
    default y
endif

if !AOS_CREATE_PROJECT
config AOS_MCU_STM32F0XX
    bool
    select AOS_COMP_NEWLIB_STUB
    select AOS_ARCH_ARMV6M
    select AOS_COMP_RHINO
    help
      driver & sdk for platform/mcu stm32f0xx
endif

if AOS_MCU_STM32F0XX
# Configurations for mcu stm32f0xx
endif
```

## platform/mcu/stm32f1xx/Config.in
```kconfig
if AOS_CREATE_PROJECT
config AOS_MCU_STM32F1XX
    bool
    default y
endif

if !AOS_CREATE_PROJECT
config AOS_MCU_STM32F1XX
    bool
    select AOS_COMP_NEWLIB_STUB
    select AOS_ARCH_ARMV7M
    select AOS_COMP_RHINO
    help
      driver & sdk for platform/mcu stm32f1xx
endif

if AOS_MCU_STM32F1XX
# Configurations for mcu stm32f1xx
endif
```

## platform/mcu/stm32f4xx/Config.in
```kconfig
menuconfig AOS_MCU_STM32F4XX
    bool "stm32f4xx"
    default n
    select AOS_COMP_COMMON
    select AOS_MCU_STM32F4XX_PERIPHERAL_DRIVERS
    select AOS_MCU_LIB_SPI_FLASH_LIBRARY
    select AOS_COMP_HAL
    select AOS_COMP_CLI
    select AOS_COMP_NEWLIB_STUB
    select AOS_COMP_NETMGR
    select AOS_ARCH_ARMV7M
    select AOS_COMP_HALWIFI
    select AOS_COMP_CJSON
    select AOS_COMP_MBEDTLS
    select AOS_COMP_LWIP
    select AOS_COMP_RHINO
    select AOS_COMP_DIGEST_ALGORITHM
    help

if AOS_MCU_STM32F4XX
# Configurations for mcu stm32f4xx
endif
```

## platform/mcu/stm32f4xx_cube/Config.in
```kconfig
config AOS_MCU_STM32F4XX_CUBE
    bool
    select AOS_ARCH_ARMV7M_MK if AOS_BOARD_STM32F429ZI_MK
    select AOS_ARCH_ARMV7M if !AOS_BOARD_STM32F429ZI_MK
    select AOS_COMP_NEWLIB_STUB
    select AOS_COMP_RHINO
    help
      driver & sdk for platform/mcu stm32f4xx_cube

if AOS_MCU_STM32F4XX_CUBE
# Configurations for mcu stm32f4xx_cube
endif
```
