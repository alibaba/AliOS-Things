## platform/mcu/cy8c4147/Config.in
```kconfig
if AOS_CREATE_PROJECT
config AOS_MCU_CY8C4147
    bool
    default y
endif

if !AOS_CREATE_PROJECT
config AOS_MCU_CY8C4147
    bool
    select AOS_ARCH_ARMV6M
    select AOS_COMP_RHINO
    help
      driver & sdk for platform/mcu cy8c4147
endif

if AOS_MCU_CY8C4147
# Configurations for mcu cy8c4147
endif
```

## platform/mcu/cy8c6347/Config.in
```kconfig
if AOS_CREATE_PROJECT
config AOS_MCU_CY8C6347
    bool
    default y
endif

if !AOS_CREATE_PROJECT
config AOS_MCU_CY8C6347
    bool
    select AOS_ARCH_ARMV7M
    select AOS_COMP_NEWLIB_STUB
    select AOS_COMP_RHINO
    help
      driver & sdk for platform/mcu cy8c6347
endif

if AOS_MCU_CY8C6347
# Configurations for mcu cy8c6347
endif
```

## platform/mcu/dahua/Config.in
```kconfig
if AOS_CREATE_PROJECT
config AOS_MCU_DAHUA
    bool
    default y
    select CONFIG_AOS_TCPIP if MCU_DAHUA_CONFIG_LWIP
endif

if !AOS_CREATE_PROJECT
config AOS_MCU_DAHUA
    bool
    select AOS_COMP_NETMGR
    select AOS_COMP_RHINO
    select AOS_ARCH_CSKYV2_L
    select CONFIG_AOS_TCPIP if MCU_DAHUA_CONFIG_LWIP
    help
      driver & sdk for platform/mcu dahua
endif

if AOS_MCU_DAHUA
# Configurations for mcu dahua

config MCU_DAHUA_CONFIG_LWIP
    bool
    default y

config BSP_SUPPORT_EXTERNAL_MODULE
    bool
    default n

config BSP_EXTERNAL_WIFI_MODULE
    string
    depends on BSP_SUPPORT_EXTERNAL_MODULE
    default "wifi.esp8266"

endif
```

## platform/mcu/efm32gxx/Config.in
```kconfig
if AOS_CREATE_PROJECT
config AOS_MCU_EFM32GXX
    bool
    default y
endif

if !AOS_CREATE_PROJECT
config AOS_MCU_EFM32GXX
    bool
    select AOS_ARCH_ARMV7M
    select AOS_COMP_RHINO
    help
      driver & sdk for platform/mcu efm32gxx
endif

if AOS_MCU_EFM32GXX
# Configurations for mcu efm32gxx
endif
```

## platform/mcu/es8p508x/Config.in
```kconfig
if AOS_CREATE_PROJECT
config AOS_MCU_ES8P508X
    bool
    default y
endif

if !AOS_CREATE_PROJECT
config AOS_MCU_ES8P508X
    bool
    select AOS_ARCH_ARMV6M
    select AOS_COMP_RHINO
    help
      driver & sdk for platform/mcu es8p508x
endif

if AOS_MCU_ES8P508X
# Configurations for mcu es8p508x
endif
```

## platform/mcu/esp32/Config.in
```kconfig
if AOS_CREATE_PROJECT
config AOS_MCU_ESP32
    bool
    default y
endif

if !AOS_CREATE_PROJECT
config AOS_MCU_ESP32
    bool
    select AOS_COMP_BT_HOST if EN_BLE_HOST
    select AOS_COMP_BT_HOST if (EN_BLE_HOST && !bt_mesh_standalone_deploy)
    select AOS_COMP_MBEDTLS
    select AOS_COMP_NETMGR
    select AOS_ARCH_XTENSA_LX6 if OSAL_CONFIG = rhino
    select AOS_COMP_RHINO if OSAL_CONFIG = rhino
    select AOS_COMP_UMESH if  MESH_CONFIG != n
    help
      driver & sdk for platform/mcu esp32
endif

if AOS_MCU_ESP32
# Configurations for mcu esp32

config OSAL_CONFIG
    string
    default rhino
    help
        osal = rhino/freertos

config MESH_CONFIG
    bool "mesh config"
    default n

endif
```

## platform/mcu/esp8266/Config.in
```kconfig
config AOS_MCU_ESP8266
    bool
    select AOS_COMP_LWIP
    select AOS_COMP_NEWLIB_STUB
    select AOS_COMP_NETMGR
    select AOS_COMP_OTA_2ND_BOOT
    select AOS_COMP_RHINO if OSAL_CONFIG = rhino
    select AOS_COMP_YLOOP
    select AOS_ARCH_XTENSA_LX106 if OSAL_CONFIG = rhino
    help
      driver & sdk for platform/mcu esp8266

if AOS_MCU_ESP8266
# Configurations for mcu esp8266

config OSAL_CONFIG
    string
    default rhino

endif
```

## platform/mcu/fm33a0xx/Config.in
```kconfig
if AOS_CREATE_PROJECT
config AOS_MCU_FM33A0XX
    bool
    default y
endif

if !AOS_CREATE_PROJECT
config AOS_MCU_FM33A0XX
    bool
    select AOS_ARCH_ARMV6M
    select AOS_COMP_RHINO
    help
      driver & sdk for platform/mcu fm33a0xx
endif

if AOS_MCU_FM33A0XX
# Configurations for mcu fm33a0xx
endif
```

## platform/mcu/freedom-e/e310/Config.in
```kconfig
if AOS_CREATE_PROJECT
config AOS_MCU_E310
    bool
    default y
endif

if !AOS_CREATE_PROJECT
config AOS_MCU_E310
    bool
    select AOS_ARCH_RISC_V32I
    select AOS_COMP_NEWLIB_STUB
    select AOS_COMP_RHINO
    help
      driver & sdk for platform/mcu e310
endif

if AOS_MCU_E310
# Configurations for mcu e310
endif
```

## platform/mcu/gd32f30x/Config.in
```kconfig
config AOS_MCU_GD32F30X
    bool "mcu_gd32f30x"
    select AOS_ARCH_ARMV7M
    select AOS_COMP_RHINO
    help
      driver & sdk for platform/mcu gd32f30x

if AOS_MCU_GD32F30X
# Configurations for mcu gd32f30x
endif
```

## platform/mcu/gd32f3x0/Config.in
```kconfig
if AOS_CREATE_PROJECT
config AOS_MCU_GD32F3X0
    bool
    default y
endif

if !AOS_CREATE_PROJECT
config AOS_MCU_GD32F3X0
    bool
    select AOS_ARCH_ARMV7M
    select AOS_COMP_RHINO
    help
      driver & sdk for platform/mcu gd32f3x0
endif

if AOS_MCU_GD32F3X0
# Configurations for mcu gd32f3x0
endif
```

## platform/mcu/gd32f4xx/Config.in
```kconfig
if AOS_CREATE_PROJECT
config AOS_MCU_GD32F4XX
    bool
    default y
endif

if !AOS_CREATE_PROJECT
config AOS_MCU_GD32F4XX
    bool
    select AOS_ARCH_ARMV7M
    select AOS_COMP_RHINO
    help
      driver & sdk for platform/mcu gd32f30x
endif

if AOS_MCU_GD32F4XX
# Configurations for mcu gd32f4xx
endif
```

## platform/mcu/haas1000/Config.in
```kconfig
config AOS_MCU_HAAS1000
    bool
    select AOS_ARCH_ARMV7M
    select AOS_COMP_RHINO
    select CONFIG_MODERN_NETMGR if AOS_COMP_NETMGR
    select AOS_COMP_OSAL_POSIX
    select PING_ENABLED if AOS_COMP_LWIP
    select IFCONFIG_ENABLED if AOS_COMP_LWIP
    select DNSCLI_ENABLED if AOS_COMP_LWIP
    select ARPCLI_ENABLED if AOS_COMP_LWIP
    select SENDFILE_ENABLED if AOS_COMP_LWIP
    select LSFDCLI_ENABLED if AOS_COMP_LWIP
    select ULOG_CONFIG_ASYNC if AOS_COMP_ULOG
    select ULOG_CONFIG_SYSLOG_TIME_FORMAT if AOS_COMP_ULOG
    help
      driver & sdk for platform/mcu haas1000

if AOS_MCU_HAAS1000
# Configurations for mcu haas1000
endif
```

## platform/mcu/hc32l136/Config.in
```kconfig
if AOS_CREATE_PROJECT
config AOS_MCU_HC32L136
    bool
    default y
endif

if !AOS_CREATE_PROJECT
config AOS_MCU_HC32L136
    bool
    select AOS_ARCH_ARMV6M
    select AOS_COMP_RHINO
    help
      driver & sdk for platform/mcu hc32l136
endif

if AOS_MCU_HC32L136
# Configurations for mcu hc32l136
endif
```

## platform/mcu/hk32f103/Config.in
```kconfig
if AOS_CREATE_PROJECT
config AOS_MCU_HK32F103
    bool
    default y
endif

if !AOS_CREATE_PROJECT
config AOS_MCU_HK32F103
    bool
    select AOS_ARCH_ARMV7M
    select AOS_COMP_RHINO
    help
      driver & sdk for platform/mcu hk32f103
endif

if AOS_MCU_HK32F103
# Configurations for mcu hk32f103
endif
```

## platform/mcu/hr8p2xx/Config.in
```kconfig
if AOS_CREATE_PROJECT
config AOS_MCU_HR8P2XX
    bool
    default y
endif

if !AOS_CREATE_PROJECT
config AOS_MCU_HR8P2XX
    bool
    select AOS_ARCH_ARMV6M
    select AOS_COMP_RHINO
    help
      driver & sdk for platform/mcu hr8p2xx
endif

if AOS_MCU_HR8P2XX
# Configurations for mcu hr8p2xx
endif
```

## platform/mcu/imx6/Config.in
```kconfig
if AOS_CREATE_PROJECT
config AOS_MCU_IMX6
    bool
    default y
endif

if !AOS_CREATE_PROJECT
config AOS_MCU_IMX6
    bool
    select AOS_ARCH_ARMV7A
    select AOS_COMP_NEWLIB_STUB
    select AOS_COMP_RHINO
    help
      driver & sdk for platform/mcu imx6
endif

if AOS_MCU_IMX6
# Configurations for mcu imx6
endif
```

## platform/mcu/imx6/imx6dq/Config.in
```kconfig
menuconfig AOS_MCU_IMX6DQ
    bool "imx6dq"
    default n
    select AOS_COMP_NEWLIB_STUB
    select AOS_COMP_COMMON
    select AOS_ARCH_ARMV7A
    select AOS_COMP_HAL
    select AOS_COMP_RHINO
    help

if AOS_MCU_IMX6DQ
# Configurations for mcu imx6dq
endif
```

## platform/mcu/imx6/imx6sl/Config.in
```kconfig
menuconfig AOS_MCU_IMX6SX
    bool "imx6sx"
    default n
    select AOS_COMP_NEWLIB_STUB
    select AOS_COMP_COMMON
    select AOS_ARCH_ARMV7A
    select AOS_COMP_HAL
    select AOS_COMP_RHINO
    help

if AOS_MCU_IMX6SX
# Configurations for mcu imx6sx
endif
```

## platform/mcu/imx6sl_svc/Config.in
```kconfig
menuconfig AOS_MCU_IMX6SL_SVC
    bool "imx6sl_svc"
    default n
    select AOS_COMP_NEWLIB_STUB
    select AOS_ARCH_ARMV7A
    select AOS_COMP_HAL
    select AOS_COMP_VFS
    select AOS_COMP_RHINO
    help

if AOS_MCU_IMX6SL_SVC
# Configurations for mcu imx6sl_svc
endif
```

## platform/mcu/linux/Config.in
```kconfig
if AOS_CREATE_PROJECT
config AOS_MCU_LINUXIMPL
    bool
    default y
    select ULOG_CONFIG_SYNC_LOG_DETAILS
endif

if !AOS_CREATE_PROJECT
config AOS_MCU_LINUXIMPL
    bool
    select AOS_COMP_KERNEL_INIT
    select AOS_COMP_NETMGR
    select AOS_ARCH_LINUX
    select ULOG_CONFIG_SYNC_LOG_DETAILS
    help
      driver & sdk for platform/mcu linuximpl
endif

if AOS_MCU_LINUXIMPL
# Configurations for mcu linuximpl

endif
```

## platform/mcu/lpc54018/Config.in
```kconfig
if AOS_CREATE_PROJECT
config AOS_MCU_LPC54018IMPL
    bool
    default y
endif

if !AOS_CREATE_PROJECT
config AOS_MCU_LPC54018IMPL
    bool
    select AOS_ARCH_ARMV7M
    select AOS_COMP_NEWLIB_STUB
    select AOS_COMP_RHINO
    help
      driver & sdk for platform/mcu lpc54018impl
endif

if AOS_MCU_LPC54018IMPL
# Configurations for mcu lpc54018impl
endif
```

## platform/mcu/lpc54102/Config.in
```kconfig
if AOS_CREATE_PROJECT
config AOS_MCU_LPC54102IMPL
    bool
    default y
endif

if !AOS_CREATE_PROJECT
config AOS_MCU_LPC54102IMPL
    bool
    select AOS_COMP_NEWLIB_STUB
    select AOS_COMP_NETMGR
    select AOS_ARCH_ARMV7M
    select AOS_COMP_RHINO
    help
      driver & sdk for platform/mcu lpc54102impl
endif

if AOS_MCU_LPC54102IMPL
# Configurations for mcu lpc54102impl
endif
```

## platform/mcu/lpc54114/Config.in
```kconfig
if AOS_CREATE_PROJECT
config AOS_MCU_LPC54114IMPL
    bool
    default y
endif

if !AOS_CREATE_PROJECT
config AOS_MCU_LPC54114IMPL
    bool
    select AOS_ARCH_ARMV7M
    select AOS_COMP_NEWLIB_STUB
    select AOS_COMP_RHINO
    help
      driver & sdk for platform/mcu lpc54114impl
endif

if AOS_MCU_LPC54114IMPL
# Configurations for mcu lpc54114impl
endif
```

## platform/mcu/lpc54608/Config.in
```kconfig
config AOS_MCU_LPC54608IMPL
    bool
    select AOS_COMP_NETMGR
    select AOS_ARCH_ARMV7M
    select AOS_COMP_RHINO
    select AOS_COMP_NEWLIB_STUB
    help
      driver & sdk for platform/mcu lpc54608impl

if AOS_MCU_LPC54608IMPL
# Configurations for mcu lpc54608impl
endif
```
