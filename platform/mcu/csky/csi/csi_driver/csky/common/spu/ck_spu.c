/* ---------------------------------------------------------------------------
 * Copyright (C) 2016 CSKY Limited. All rights reserved.
 *
 * Redistribution and use of this software in source and binary forms,
 * with or without modification, are permitted provided that the following
 * conditions are met:
 *   * Redistributions of source code must retain the above copyright notice,
 *     this list of conditions and the following disclaimer.
 *   * Redistributions in binary form must reproduce the above copyright notice,
 *     this list of conditions and the following disclaimer in the documentation
 *     and/or other materials provided with the distribution.
 *   * Neither the name of CSKY Ltd. nor the names of CSKY's contributors may
 *     be used to endorse or promote products derived from this software without
 *     specific prior written permission of CSKY Ltd.
 *
 * THIS SOFTWARE IS PROVIDED BY THE COPYRIGHT HOLDERS AND CONTRIBUTORS "AS IS"
 * AND ANY EXPRESS OR IMPLIED WARRANTIES, INCLUDING, BUT NOT LIMITED TO,
 * THE IMPLIED WARRANTIES OF MERCHANTABILITY AND FITNESS FOR A PARTICULAR
 * PURPOSE ARE DISCLAIMED. IN NO EVENT SHALL THE COPYRIGHT OWNER OR CONTRIBUTORS
 * BE LIABLE FOR ANY DIRECT, INDIRECT, INCIDENTAL, SPECIAL, EXEMPLARY,
 * OR CONSEQUENTIAL DAMAGES (INCLUDING, BUT NOT LIMITED TO, PROCUREMENT OF
 * SUBSTITUTE GOODS OR SERVICES; LOSS OF USE, DATA, OR PROFITS; OR BUSINESS
 * INTERRUPTION) HOWEVER CAUSED AND ON ANY THEORY OF LIABILITY, WHETHER IN
 * CONTRACT, STRICT LIABILITY, OR TORT (INCLUDING NEGLIGENCE OR OTHERWISE)
 * ARISING IN ANY WAY OUT OF THE USE OF THIS SOFTWARE, EVEN IF ADVISED OF
 * THE POSSIBILITY OF SUCH DAMAGE.
 * -------------------------------------------------------------------------- */

/******************************************************************************
 * @file
 * @brief
 * @version  V1.0
 * @date
 ******************************************************************************/

#include <csi_config.h>
#include <stdint.h>
#include <stdbool.h>
#include <stddef.h>

#include "csi_core.h"
#include "drv_spu.h"
#include "ck_spu.h"

#include "soc.h"
#include "spu_pin_planning.h"

#define ERR_SPU(errno) (CSI_DRV_ERRNO_SPU_BASE | errno)

extern spu_pgpio_info_t get_pgpio_info(uint32_t spu_idx, uint8_t pgpio);
extern void ck_spu_usart_irqhandler(int32_t idx,spu_dev_signal_e signal);
extern void ck_spu_spi_irqhandler(int32_t idx,spu_dev_signal_e signal);
extern void ck_spu_i2c_irqhandler(int32_t idx,spu_dev_signal_e signal);
extern void ck_spu_can_irqhandler(int32_t idx,spu_dev_signal_e signal);

//------------------------------------------
//            data private
//------------------------------------------
typedef struct {
    uint32_t base;
    uint32_t irq;

    uint32_t clk_en_vec;
    bool clk_en;
    uint32_t prog_used;
    uint32_t usart_func_index_base;
    uint32_t spi_func_index_base;
    uint32_t i2c_func_index_base;
    uint32_t can_func_index_base;
} ck_spu_priv_t;

static ck_spu_priv_t spu_instance[CONFIG_SPU_NUM];

static const spu_capabilities_t spu_capabilities = {
    .spu_usart = 1,   //supports USART device
    .spu_spi   = 1,   //supports SPI device
    .spu_i2c   = 1,   //supports I2C device
    .spu_can   = 0,   //supports CAN device
};

//usart function
#define SPU_USART_FUNC_WORDS 180
#define SPU_USART_FUNC_BYTES SPU_USART_FUNC_WORDS*4
const static int32_t SPU_USART_FUNC_INDEX[16] = {
0x00000000,0x00000090,0x000000ba,0x00000000,
0x00000000,0x000000d8,0x00000184,0x00000000,
0x00000000,0x00000000,0x00000000,0x00000000,
0x00000000,0x00000000,0x00000000,0x00000000,
};
const static int32_t SPU_USART_FUNC[180] = {
0x2000d84d,0x3acd74c8,0xd80d082c,0xd82d2003,
0xe0002004,0x3ac800ef,0x4b620817,0x08083ac9,
0x08053aca,0x080a3acb,0x08093acc,0x36003ba4,
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0x6c036c03,0x6c036c03,0x6c036c03,0x00000000
};

//spi function
#define SPU_SPI_FUNC_WORDS 816
#define SPU_SPI_FUNC_BYTES SPU_SPI_FUNC_WORDS*4
const static int32_t SPU_SPI_FUNC_INDEX[128]={
0x00000000,0x00000048,0x000000a2,0x00000000,
0x00000000,0x00000000,0x00000000,0x00000000,
0x00000000,0x00000000,0x00000000,0x00000000,
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0x00000000,0x00000000,0x00000b6e,0x00000000
};
const static int32_t SPU_SPI_FUNC[816] = {
0x2001d84d,0x2000d8cd,0x0c0d3ac0,0x6d180093,
0x6421c144,0x2005d80d,0x2006d82d,0x05d5e000,
0x6421c104,0x0c053ac1,0x6d180099,0x6422c144,
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0x6c036c03,0x00000000,0x00000000,0x00000000
};

//i2c function
#define SPU_I2C_FUNC_WORDS 228
#define SPU_I2C_FUNC_BYTES SPU_I2C_FUNC_WORDS*4
const static int32_t SPU_I2C_FUNC_INDEX[16]={
0x00000000,0x0000004c,0x00000072,0x00000082,
0x0000010c,0x00000192,0x00000194,0x000001b0,
0x000001d4,0x00000206,0x0000022e,0x00000246,
0x00000000,0x00000000,0x00000000,0x00000286,
};
const static int32_t SPU_I2C_FUNC[228] = {
0x0004d80d,0x38c03413,0xc1440c0d,0xc1206421,
0x3cbe6024,0x6420c124,0x2004d80d,0x2005d82d,
0x38c1044c,0xc1440c09,0xc1206421,0x3cbe6024,
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0x6c036c03,0x00000000,0x00000000,0x00000000
};

//can function
#define SPU_CAN_FUNC_WORDS 0
#define SPU_CAN_FUNC_BYTES SPU_CAN_FUNC_WORDS*4
const static int32_t SPU_CAN_FUNC_INDEX[16]={0};
const static int32_t SPU_CAN_FUNC[1] = {0};

//------------------------------------------
//                  ISR
//------------------------------------------
extern void ck_spu_usart_irqhandler(int32_t idx,spu_dev_signal_e signal);
extern void ck_spu_spi_irqhandler(int32_t idx,spu_dev_signal_e signal);
extern void ck_spu_i2c_irqhandler(int32_t idx,spu_dev_signal_e signal);
extern void ck_spu_can_irqhandler(int32_t idx,spu_dev_signal_e signal);

void ck_spu_irqhandler(int32_t idx)
{
    ck_spu_priv_t *priv = &spu_instance[idx];

    //ISR of particular device
    int32_t base;
    int32_t data;
    int32_t intr_src;
    int32_t i;

    base = priv->base + GLOBAL_BASE;
    getData(data,base,OFFSET_PGPIO_INTR_STATUS);

    spu_pgpio_info_t pgpio_info;

    for(i=0; i<32; i++){
        intr_src = data & (1 << i);
        if(intr_src!=0){
            pgpio_info = get_pgpio_info(idx, i);
            switch(pgpio_info.dev_type){
                case ENUM_SPU_DEV_USART: ck_spu_usart_irqhandler(pgpio_info.dev_idx,pgpio_info.dev_signal); break;
                case ENUM_SPU_DEV_SPI: ck_spu_spi_irqhandler(pgpio_info.dev_idx,pgpio_info.dev_signal); break;
                case ENUM_SPU_DEV_I2C: ck_spu_i2c_irqhandler(pgpio_info.dev_idx,pgpio_info.dev_signal); break;
                //case ENUM_SPU_DEV_CAN: ck_spu_can_irqhandler(pgpio_info.dev_idx,pgpio_info.dev_signal); break;
                default: break;
            }
        }
    }
}

//------------------------------------------
//            CSI_DRIVER
//------------------------------------------
extern void csi_vic_enable_irq(int32_t irq_num);
extern void csi_vic_disable_irq(int32_t irq_num);
extern int32_t target_spu_init(int32_t pgpio[],uint32_t *base, uint32_t *irq);

spu_capabilities_t csi_spu_get_capabilities(spu_handle_t handle)
{
    return spu_capabilities;
}

spu_handle_t csi_spu_initialize(int32_t pgpio[])
{
    //get base address & irq
    int32_t idx;
    uint32_t base = 0u;
    uint32_t irq;
    ck_spu_priv_t *priv;

    idx = target_spu_init(pgpio, &base, &irq);

    if (idx<0){
        return NULL;
    }

    priv = &spu_instance[idx];
    priv->base = base;
    priv->irq  = irq;
    csi_vic_enable_irq(priv->irq);

    //initialize variable
    priv->clk_en_vec = 0;
    priv->clk_en = false;
    priv->prog_used = 0;

    return priv;
}

int32_t csi_spu_config(spu_handle_t handle,spu_capabilities_t capabilities)
{
    ck_spu_priv_t *priv = handle;

    //check if INST_RAM size enough or not
    uint32_t func_index_base = 256u;
    uint32_t inst_len = 0u;

    if(capabilities.spu_usart==1){
        priv->usart_func_index_base = func_index_base;
        func_index_base+=64;
        inst_len+=(SPU_USART_FUNC_BYTES);
    }

    if(capabilities.spu_spi==1){
        priv->spi_func_index_base = func_index_base;
        func_index_base+=512;
        inst_len+=(SPU_SPI_FUNC_BYTES);
    }

    if(capabilities.spu_i2c==1){
        priv->i2c_func_index_base = func_index_base;
        func_index_base+=64;
        inst_len+=(SPU_I2C_FUNC_BYTES);
    }

    if(capabilities.spu_can==1){
        priv->can_func_index_base = func_index_base;
        func_index_base+=64;
        inst_len+=(SPU_CAN_FUNC_BYTES);
    }

    inst_len += func_index_base;

    if((inst_len)>SPU_INST_RAM_SIZE){
        return ERR_SPU(EDRV_SPU_INST_OVERFLOW);
    }

    //write INST_RAM
    int i;
    uint32_t func_base;
    uint32_t glb_func_index_base;
    uint32_t glb_func_base;
    uint32_t data;
    uint32_t offset;

    func_base = func_index_base;
    glb_func_index_base = 256 + (priv->base+INST_BASE);
    glb_func_base = func_index_base + (priv->base+INST_BASE);

    putData(0x1,priv->base+GLOBAL_BASE,OFFSET_BLOCKS_CLK_EN);  //open BLOCKS-CLOCK

    for(i=0;i<256;i+=4){
        putData(0x0,priv->base+INST_BASE,i);
    }

    if(capabilities.spu_usart==1){
        for(i=0;i<16;i++){
            data=SPU_USART_FUNC_INDEX[i]+func_base;
            offset = i<<2;
            putData(data,glb_func_index_base,offset);
        }
        glb_func_index_base+=64;

        for(i=0;i<SPU_USART_FUNC_WORDS;i++){
            offset = i<<2;
            putData(SPU_USART_FUNC[i],glb_func_base,offset);
        }
        func_base+=(SPU_USART_FUNC_BYTES);
        glb_func_base+=(SPU_USART_FUNC_BYTES);
    }

    if(capabilities.spu_spi==1){
        for(i=0;i<128;i++){
            data=SPU_SPI_FUNC_INDEX[i]+func_base;
            offset = i<<2;
            putData(data,glb_func_index_base,offset);
        }
        glb_func_index_base+=512;

        for(i=0;i<SPU_SPI_FUNC_WORDS;i++){
            offset = i<<2;
            putData(SPU_SPI_FUNC[i],glb_func_base,offset);
        }
        func_base+=(SPU_SPI_FUNC_BYTES);
        glb_func_base+=(SPU_SPI_FUNC_BYTES);
    }

    if(capabilities.spu_i2c==1){
        for(i=0;i<16;i++){
            data=SPU_I2C_FUNC_INDEX[i]+func_base;
            offset = i<<2;
            putData(data,glb_func_index_base,offset);
        }
        glb_func_index_base+=64;

        for(i=0;i<SPU_I2C_FUNC_WORDS;i++){
            offset = i<<2;
            putData(SPU_I2C_FUNC[i],glb_func_base,offset);
        }
        func_base+=(SPU_I2C_FUNC_BYTES);
        glb_func_base+=(SPU_I2C_FUNC_BYTES);
    }

    if(capabilities.spu_can==1){
        for(i=0;i<16;i++){
            data=SPU_CAN_FUNC_INDEX[i]+func_base;
            offset = i<<2;
            putData(data,glb_func_index_base,offset);
        }
        glb_func_index_base+=64;

        for(i=0;i<SPU_CAN_FUNC_WORDS;i++){
            offset = i<<2;
            putData(SPU_CAN_FUNC[i],glb_func_base,offset);
        }
        func_base+=(SPU_CAN_FUNC_BYTES);
        glb_func_base+=(SPU_CAN_FUNC_BYTES);
    }

    putData(0x0,priv->base+GLOBAL_BASE,OFFSET_BLOCKS_CLK_EN);  //close BLOCKS-CLOCK

    return 0;
}

int32_t csi_spu_uninitialize(spu_handle_t handle)
{
    ck_spu_priv_t *priv = handle;

    csi_vic_disable_irq(priv->irq);  //close interrupt
    putData(0x0,priv->base+GLOBAL_BASE,OFFSET_BLOCKS_CLK_EN);  //close BLOCKS-CLOCK
    putData(0x0,priv->base+GLOBAL_BASE,OFFSET_PGPIO_CLK_EN);  //close CLOCK

    return 0;
}

//------------------------------------------
//          function for device
//------------------------------------------
uint32_t spu_get_base(int32_t idx){
    ck_spu_priv_t *priv = &spu_instance[idx];
    return priv->base;
}

void spu_enable_clock(int32_t idx,int32_t pgpio)
{
    ck_spu_priv_t *priv = &spu_instance[idx];

    priv->clk_en_vec |= (1 << pgpio);

    if(!priv->clk_en){
        priv->clk_en = true;
        putData(0x1,priv->base+GLOBAL_BASE,OFFSET_BLOCKS_CLK_EN);
    }
}

void spu_disable_clock(int32_t idx,int32_t pgpio)
{
    ck_spu_priv_t *priv = &spu_instance[idx];

    priv->clk_en_vec &= ~(1 << pgpio);

    if((priv->clk_en_vec==0) && priv->clk_en){
        priv->clk_en = false;
        putData(0x0,priv->base+GLOBAL_BASE,OFFSET_BLOCKS_CLK_EN);
    }
}


int32_t spu_apply_prog(int32_t idx,int32_t bytes)
{
    ck_spu_priv_t *priv = &spu_instance[idx];

    int32_t tmp;

    tmp = priv->prog_used;
    priv->prog_used += bytes;

    if(priv->prog_used > (SPU_PROG_RAM_SIZE)){
        priv->prog_used = tmp;
        return -1;
    }

    return tmp;
}

int32_t spu_get_usart_func_index_base(int32_t idx)
{
    ck_spu_priv_t *priv = &spu_instance[idx];
    return priv->usart_func_index_base;
}

int32_t spu_get_spi_func_index_base(int32_t idx)
{
    ck_spu_priv_t *priv = &spu_instance[idx];
    return priv->spi_func_index_base;
}

int32_t spu_get_i2c_func_index_base(int32_t idx)
{
    ck_spu_priv_t *priv = &spu_instance[idx];
    return priv->i2c_func_index_base;
}

int32_t spu_get_can_func_index_base(int32_t idx)
{
    ck_spu_priv_t *priv = &spu_instance[idx];
    return priv->can_func_index_base;
}
