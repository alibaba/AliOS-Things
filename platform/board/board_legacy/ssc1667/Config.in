## platform/board/board_legacy/ssc1667/Config.in
```kconfig
config AOS_BOARD_SSC1667
    bool "SSC1667"
    select AOS_MCU_SSCP131 if !AOS_CREATE_PROJECT
    select AOS_COMP_NEWLIB_STUB if !AOS_CREATE_PROJECT
    select CONFIG_AOS_TCPIP
    help

if AOS_BOARD_SSC1667
# Configurations for board ssc1667
endif
```

## platform/board/board_legacy/stm32f091rc-nucleo/Config.in
```kconfig
config AOS_BOARD_STM32F091RC_NUCLEO
    bool "STM32F091RC_Nucleo"
    select AOS_MCU_STM32F0XX
    select AOS_COMP_KERNEL_INIT
    select AOS_COMP_OSAL_AOS
    help

if AOS_BOARD_STM32F091RC_NUCLEO
# Configurations for board stm32f091rc-nucleo

endif
```

## platform/board/board_legacy/stm32f411re-nucleo/Config.in
```kconfig
config AOS_BOARD_STM32F411RE_NUCLEO
    bool "STM32F411RE_Nucleo"
    select AOS_MCU_STM32F4XX_CUBE
    select AOS_COMP_KERNEL_INIT
    help

if AOS_BOARD_STM32F411RE_NUCLEO
# Configurations for board stm32f411re-nucleo

# "BSP SUPPORT FEATURE"
config BSP_SUPPORT_UART
    bool
    default y

config BSP_SUPPORT_FLASH
    bool
    default y

config BSP_SUPPORT_GPIO
    bool
    default y

config BSP_SUPPORT_I2C
    bool
    default y

config BSP_SUPPORT_WIFI
    bool
    default y

config BSP_SUPPORT_EXTERNAL_MODULE
    bool "Support external module"
    default y

endif
```

## platform/board/board_legacy/stm32f429zi-mk/Config.in
```kconfig
config AOS_BOARD_STM32F429ZI_MK
    bool "stm32f429zi-mk"
    select AOS_MCU_STM32F4XX_CUBE
    select AOS_COMP_CLI
    select AOS_COMP_NETMGR
    select CONFIG_AOS_TCPIP
    select RHINO_CONFIG_USER_SPACE
    select RHINO_CONFIG_URES
    select RHINO_CONFIG_UCLI
    select RHINO_CONFIG_UTCPIP
    #select RHINO_CONFIG_UFS
    select RHINO_CONFIG_UIPC
    #select RHINO_CONFIG_ULINKKIT
    #select RHINO_CONFIG_HAL_ADC_SYSCALL
    #select RHINO_CONFIG_HAL_DAC_SYSCALL
    #select RHINO_CONFIG_HAL_ADC_SYSCALL
    #select RHINO_CONFIG_HAL_FLASH_SYSCALL
    #select RHINO_CONFIG_HAL_GPIO_SYSCALL
    #select RHINO_CONFIG_HAL_I2C_SYSCALL
    #select RHINO_CONFIG_HAL_NAND_SYSCALL
    #select RHINO_CONFIG_HAL_NOR_SYSCALL
    #select RHINO_CONFIG_HAL_RTC_SYSCALL
    #select RHINO_CONFIG_HAL_SD_SYSCALL
    #select RHINO_CONFIG_HAL_SPI_SYSCALL
    select RHINO_CONFIG_HAL_UART_SYSCALL
    #select RHINO_CONFIG_DYN_SYSCALL_TBL

if AOS_BOARD_STM32F429ZI_MK
# Configurations for board stm32f429zi-mk

config BSP_SUPPORT_UART
    bool "BSP_SUPPORT_UART"
    default y

config BSP_SUPPORT_FLASH
    bool "BSP_SUPPORT_FLASH"
    default y

config BSP_SUPPORT_GPIO
    bool "BSP_SUPPORT_GPIO"
    default y

config BSP_SUPPORT_I2C
    bool "BSP_SUPPORT_I2C"
    default y

endif
```

## platform/board/board_legacy/stm32f769i-discovery/Config.in
```kconfig
config AOS_BOARD_B_F769
    bool "STM32F769I-Discovery"
    select AOS_MCU_STM32F7XX if !AOS_CREATE_PROJECT
    select AOS_COMP_KERNEL_INIT if !AOS_CREATE_PROJECT
    select CONFIG_NO_TCPIP
    help

if AOS_BOARD_B_F769
# Configurations for board board_b_f769

# "BSP SUPPORT FEATURE"
config BSP_SUPPORT_UART
    bool
    default y

config BSP_SUPPORT_FLASH
    bool
    default y

config BSP_SUPPORT_WIFI
    bool
    default y

endif
```

## platform/board/board_legacy/stm32l433rc-nucleo/Config.in
```kconfig
config AOS_BOARD_STM32L433RC_NUCLEO
    bool "STM32L433RC_Nucleo"
    select AOS_MCU_STM32L4XX_CUBE if !AOS_CREATE_PROJECT
    select AOS_COMP_KERNEL_INIT if !AOS_CREATE_PROJECT
    select CONFIG_AOS_TCPIP if !BSP_SUPPORT_EXTERNAL_MODULE
    select CONFIG_NO_TCPIP  if BSP_SUPPORT_EXTERNAL_MODULE
    help

if AOS_BOARD_STM32L433RC_NUCLEO
# Configurations for board stm32l433rc-nucleo

# "BSP SUPPORT FEATURE"
config BSP_SUPPORT_UART
    bool
    default y

config BSP_SUPPORT_FLASH
    bool
    default y

config BSP_SUPPORT_GPIO
    bool
    default y

config BSP_SUPPORT_I2C
    bool
    default y

config BSP_SUPPORT_SPI
    bool
    default y

config BSP_SUPPORT_RTC
    bool
    default y

config BSP_SUPPORT_TIMER
    bool
    default y

config BSP_SUPPORT_WIFI
    bool
    default y

config BSP_SUPPORT_EXTERNAL_MODULE
    bool "Support external module"
    default y

endif
```

## platform/board/board_legacy/sv6266_evb/Config.in
```kconfig
config AOS_BOARD_SV6266_EVB
    bool "SV6266_EVB"
    select AOS_MCU_SV6266 if !AOS_CREATE_PROJECT
    select AOS_COMP_KERNEL_INIT if !AOS_CREATE_PROJECT
    select AOS_COMP_NEWLIB_STUB if !AOS_CREATE_PROJECT
    select AOS_COMP_NETMGR if !AOS_CREATE_PROJECT
    select AOS_COMP_CJSON if !AOS_CREATE_PROJECT
    select AOS_COMP_CLI if !AOS_CREATE_PROJECT
    select CONFIG_AOS_TCPIP
    help

if AOS_BOARD_SV6266_EVB
# Configurations for board sv6266_evb
endif
```

## platform/board/board_legacy/swm320evb/Config.in
```kconfig
config AOS_BOARD_SWM320EVB
    bool "SWM320EVB"
    select AOS_MCU_SWM320 if !AOS_CREATE_PROJECT
    select AOS_COMP_NEWLIB_STUB if !AOS_CREATE_PROJECT
    select AOS_COMP_KERNEL_INIT if !AOS_CREATE_PROJECT
    select CONFIG_AOS_TCPIP
    help

if AOS_BOARD_SWM320EVB
# Configurations for board swm320evb
endif
```

## platform/board/board_legacy/wm_w600_kit/Config.in
```kconfig
config AOS_BOARD_WM_W600_KIT
    bool "WM_W600_Kit"
    select AOS_MCU_WM_W600 if !AOS_CREATE_PROJECT
    select AOS_COMP_KERNEL_INIT if !AOS_CREATE_PROJECT
    select AOS_COMP_NETMGR if !AOS_CREATE_PROJECT
    select AOS_COMP_NEWLIB_STUB if !AOS_CREATE_PROJECT
    select CONFIG_AOS_TCPIP
    help

if AOS_BOARD_WM_W600_KIT
# Configurations for board wm_w600_kit

# "BSP SUPPORT FEATURE"
config BSP_SUPPORT_WIFI
    bool
    default y

endif
```

## platform/board/board_legacy/xm510_evb/Config.in
```kconfig
config AOS_BOARD_XM510
    bool "XM510"
    select AOS_MCU_XM510 if !AOS_CREATE_PROJECT
    select AOS_COMP_KERNEL_INIT if !AOS_CREATE_PROJECT
    select CONFIG_AOS_TCPIP
    help

if AOS_BOARD_XM510
# Configurations for board board_xm510

# "BSP SUPPORT FEATURE"
config BSP_SUPPORT_UART
    bool
    default y

config BSP_SUPPORT_FLASH
    bool
    default y

config BSP_SUPPORT_WIFI
    bool
    default y

endif
```

## platform/board/board_legacy/xmc4800-relax/Config.in
```kconfig
config AOS_BOARD_XMC4800_RELAX
    bool "xmc4800-relax"
    select AOS_MCU_XMC      if !AOS_CREATE_PROJECT
    select AOS_COMP_KERNEL_INIT    if !AOS_CREATE_PROJECT
    select AOS_COMP_NETMGR if BSP_SUPPORT_EXTERNAL_MODULE && !AOS_CREATE_PROJECT
    select CONFIG_AOS_TCPIP if !BSP_SUPPORT_EXTERNAL_MODULE
    select CONFIG_NO_TCPIP  if BSP_SUPPORT_EXTERNAL_MODULE
    help
        **xmc4800-relax**

if AOS_BOARD_XMC4800_RELAX
# Configurations for board xmc4800-relax

# "BSP SUPPORT FEATURE"
config BSP_SUPPORT_UART
    bool
    default y

config BSP_SUPPORT_FLASH
    bool
    default y

config BSP_SUPPORT_GPIO
    bool
    default y

config BSP_SUPPORT_I2C
    bool
    default y

config BSP_SUPPORT_SPI
    bool
    default y

config BSP_SUPPORT_RTC
    bool
    default y

config BSP_SUPPORT_TIMER
    bool
    default y

config BSP_SUPPORT_WIFI
    bool
    default y

config BSP_SUPPORT_EXTERNAL_MODULE
    bool "Support external module"
    default y

endif
```

## platform/board/board_legacy/xr809/Config.in
```kconfig
config AOS_BOARD_XR809
    bool "XR809"
    select AOS_MCU_XR871
    select AOS_COMP_KERNEL_INIT
    select AOS_COMP_NEWLIB_STUB
    select AOS_COMP_NETMGR
    select AOS_COMP_LWIP
    select AOS_COMP_CLI
    select AOS_COMP_YLOOP
    select AOS_COMP_FATFS
    help

if AOS_BOARD_XR809
# Configurations for board xr809

# "BSP SUPPORT FEATURE"

config BSP_SUPPORT_WIFI
    bool
    default y

endif
```

## platform/board/board_legacy/xr871evb/Config.in
```kconfig
config AOS_BOARD_XR871EVB
    bool "XR871EVB"
    select AOS_MCU_XR871 if !AOS_CREATE_PROJECT
    select AOS_COMP_KERNEL_INIT if !AOS_CREATE_PROJECT
    select AOS_COMP_NETMGR if !AOS_CREATE_PROJECT
    select AOS_COMP_NEWLIB_STUB if !AOS_CREATE_PROJECT
    select AOS_COMP_YLOOP if !AOS_CREATE_PROJECT
    select AOS_COMP_CLI if !AOS_CREATE_PROJECT
    select AOS_COMP_FATFS if !AOS_CREATE_PROJECT
    select CONFIG_AOS_TCPIP
    help

if AOS_BOARD_XR871EVB
# Configurations for board xr871evb

# "BSP SUPPORT FEATURE"
config BSP_SUPPORT_WIFI
    bool
    default y

endif
```

## platform/board/esp32devkitc/Config.in
```kconfig
config AOS_BOARD_ESP32DEVKITC
    bool "ESP32DevKitc"
    select AOS_MCU_ESP32
    select AOS_COMP_KERNEL_INIT
    help
        **ESP32** is a single 2.4 GHz Wi-Fi-and-Bluetooth combo chip designed with the TSMC ultra-low-power 40 nm technology. It is designed to achieve the best power and RF performance, showing robustness, versatility and reliability in a wide variety of applications and power scenarios.

if AOS_BOARD_ESP32DEVKITC
# Configurations for board esp32devkitc

config DEBUG_CONFIG_PANIC
    bool "Enable debug panic feature"
    default y
    help
        set to y if you want to enable panic debug feature when system crash happened,
        default y

config DEBUG_CONFIG_BACKTRACE
    bool "Enable stack backtrace feature"
    default y
    help
        set to y if you want to enable stack backtrace feature when system crash happened,
        default y

# "BSP SUPPORT FEATURE"
config BSP_SUPPORT_UART
    bool
    default y

config BSP_SUPPORT_GPIO
    bool
    default y

config BSP_SUPPORT_I2C
    bool
    default y

config BSP_SUPPORT_FLASH
    bool
    default y

config BSP_SUPPORT_ADC
    bool
    default y

config BSP_SUPPORT_DAC
    bool
    default y

config BSP_SUPPORT_PWM
    bool
    default y

config BSP_SUPPORT_RTC
    bool
    default y

config BSP_SUPPORT_WDG
    bool
    default y

endif
```

## platform/board/esp8266-demo/Config.in
```kconfig
config AOS_BOARD_ESP8266_DEMO
    bool "ESP8266"
    select AOS_MCU_ESP8266
    select AOS_COMP_KERNEL_INIT
    help
        The ESP8266 integrates a Tensilica L106 32-bit RISC processor, which achieves extralow power consumption and reaches a maximum clock speed of 160 MHz. The Real-Time Operating System (RTOS) and Wi-Fi stack allow 80% of the processing power to be available for user application programming and development.

if AOS_BOARD_ESP8266_DEMO
# Configurations for board esp8266-demo

# "BSP SUPPORT FEATURE"
config BSP_SUPPORT_UART
    bool
    default y

config BSP_SUPPORT_GPIO
    bool
    default y

config BSP_SUPPORT_FLASH
    bool
    default y

config BSP_SUPPORT_BLE
    bool
    default y

endif
```

## platform/board/esp8266/Config.in
```kconfig
config AOS_BOARD_ESP8266
    bool "ESP8266"
    select AOS_MCU_ESP8266
    select AOS_COMP_KERNEL_INIT
    help
        The ESP8266 integrates a Tensilica L106 32-bit RISC processor, which achieves extralow power consumption and reaches a maximum clock speed of 160 MHz. The Real-Time Operating System (RTOS) and Wi-Fi stack allow 80% of the processing power to be available for user application programming and development.

if AOS_BOARD_ESP8266
# Configurations for board esp8266

config DEBUG_CONFIG_PANIC
    bool "Enable debug panic feature"
    default y
    help
        set to y if you want to enable panic debug feature when system crash happened,
        default y

config DEBUG_CONFIG_BACKTRACE
    bool "Enable stack backtrace feature"
    default y
    help
        set to y if you want to enable stack backtrace feature when system crash happened,
        default y

# "BSP SUPPORT FEATURE"
config BSP_SUPPORT_UART
    bool
    default y

config BSP_SUPPORT_GPIO
    bool
    default y

config BSP_SUPPORT_FLASH
    bool
    default y

config BSP_SUPPORT_BLE
    bool
    default y

endif
```

## platform/board/evkbimxrt1050/Config.in
```kconfig
config AOS_BOARD_EVKBIMXRT1050
    bool "EVKBIMXRT1050"
    select AOS_MCU_MIMXRT1052IMPL
    select AOS_COMP_KERNEL_INIT
    help

if AOS_BOARD_EVKBIMXRT1050
# Configurations for board evkbimxrt1050

# "BSP SUPPORT FEATURE"
config BSP_SUPPORT_UART
    bool
    default y

config BSP_SUPPORT_FLASH
    bool
    default y

endif
```

## platform/board/haas100/Config.in
```kconfig
config AOS_BOARD_HAAS100
    bool "haas100"
    select AOS_MCU_HAAS1000
    select AOS_COMP_KERNEL_INIT
    help
        **haas100** is hardware board base on [AliOS-Things](https://github.com/alibaba/AliOS-Things), with a variety of peripherals. The chip's mcu is HAAS1000. The HAAS1000 is a AIoT chip specifically designed for smart home & audio application, such as smart speakers.

if AOS_BOARD_HAAS100
# Configurations for board haas100
config CONFIG_WORK_WITH_WIFI
    bool
    select CONFIG_AOS_TCPIP if CONFIG_WORK_WITH_WIFI

config CONFIG_WORK_WITH_ETH
    bool
    select AOS_COMP_SAL if CONFIG_WORK_WITH_ETH
    select CONFIG_NO_TCPIP if CONFIG_WORK_WITH_ETH

choice
    prompt "physical network selection"
    help
        Select WiFi or ethernet 

    config CONFIG_WORK_WITH_WIFI
        bool "ENABLE Soc WiFi"

    config CONFIG_WORK_WITH_ETH
        bool "ENABLE Ethernet"

endchoice

endif
```

## platform/board/haaseduk1/Config.in
```kconfig
config AOS_BOARD_HAASEDUK1
    bool "haaseduk1"
    select AOS_MCU_HAAS1000
    select AOS_COMP_KERNEL_INIT
    select CONFIG_AOS_TCPIP
    help
        **haaseduk1** is hardware board base on [AliOS-Things](https://github.com/alibaba/AliOS-Things), with a variety of peripherals. The chip's mcu is HAAS1000. The HAAS1000 is a AIoT chip specifically designed for smart home & audio application, such as smart speakers.

if AOS_BOARD_HAASEDUK1
# Configurations for board haaseduk1
endif
```

## platform/board/hc32l136k8ta/Config.in
```kconfig
config AOS_BOARD_HC32L136K8TA
    bool "HC32L136K8TA"
    select AOS_MCU_HC32L136
    select AOS_COMP_NEWLIB_STUB
    help

if AOS_BOARD_HC32L136K8TA
# Configurations for board hc32l136k8ta
endif
```

## platform/board/hk32f103rb_evb/Config.in
```kconfig
config AOS_BOARD_HK32F103RB_EVB
    bool "HK32F103RB_EVB"
    select AOS_MCU_HK32F103
    select AOS_COMP_NEWLIB_STUB
    help

if AOS_BOARD_HK32F103RB_EVB
# Configurations for board hk32f103rb_evb
endif
```

## platform/board/linuxhost-demo/Config.in
```kconfig
config AOS_BOARD_LINUXHOST_DEMO
    bool "LinuxHost"
    select AOS_MCU_LINUXIMPL
    select AOS_COMP_KERNEL_INIT
    select CONFIG_LINUX_TCPIP if !BSP_SUPPORT_EXTERNAL_MODULE
    select CONFIG_NO_TCPIP    if BSP_SUPPORT_EXTERNAL_MODULE
    help
      configuration for board linuxhost-demo

if AOS_BOARD_LINUXHOST_DEMO
# Configurations for board linuxhost-demo

# "BSP SUPPORT FEATURE"
config BSP_SUPPORT_WIFI
    bool
    default y

config BSP_SUPPORT_EXTERNAL_MODULE
    bool "Support external module"
    default n

config MESHLOWPOWER
    bool
    default y

# link security config
config CONFIG_LS_DEBUG
    bool
    default y
config CONFIG_LS_ID2_OTP
    bool
    default y
config CONFIG_LS_KM_SE
    bool
    default n
config CONFIG_LS_KM_TEE
    bool
    default n

endif #AOS_BOARD_LINUXHOST_DEMO
```

## platform/board/linuxhost/Config.in
```kconfig
config AOS_BOARD_LINUXHOST
    bool "LinuxHost"
    select AOS_MCU_LINUXIMPL
    select AOS_COMP_KERNEL_INIT
    select AOS_COMP_SAL if AOS_NETWORK_SAL
    help
      configuration for board linuxhost

if AOS_BOARD_LINUXHOST
# Configurations for board linuxhost

# "BSP SUPPORT FEATURE"
config BSP_SUPPORT_WIFI
    bool
    default y

config BSP_SUPPORT_EXTERNAL_MODULE
    bool
    default n

config BSP_EXTERNAL_WIFI_MODULE
    string
    depends on BSP_SUPPORT_EXTERNAL_MODULE
    default "wifi.mk3060"

config MESHLOWPOWER
    bool
    default y

# link security config
config CONFIG_LS_DEBUG
    bool
    default y
config CONFIG_LS_ID2_OTP
    bool
    default y
config CONFIG_LS_KM_SE
    bool
    default n
config CONFIG_LS_KM_TEE
    bool
    default n

endif #AOS_BOARD_LINUXHOST
```

## platform/board/lpcxpresso54628/Config.in
```kconfig
config AOS_BOARD_LPCXPRESSO54628
    bool "LPCXPRESSO54628"
    select AOS_MCU_LPC54628IMPL
    select AOS_COMP_KERNEL_INIT
    help

if AOS_BOARD_LPCXPRESSO54628
# Configurations for board board_lpcxpresso54628

# "BSP SUPPORT FEATURE"
config BSP_SUPPORT_UART
    bool
    default y

config BSP_SUPPORT_FLASH
    bool
    default y

endif
```
