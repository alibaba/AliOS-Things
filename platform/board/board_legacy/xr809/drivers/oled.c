/*
 * Copyright (C) 2017 YunOS Project. All rights reserved.
 *
 * Licensed under the Apache License, Version 2.0 (the "License");
 * you may not use this file except in compliance with the License.
 * You may obtain a copy of the License at
 *
 *   http://www.apache.org/licenses/LICENSE-2.0
 *
 * Unless required by applicable law or agreed to in writing, software
 * distributed under the License is distributed on an "AS IS" BASIS,
 * WITHOUT WARRANTIES OR CONDITIONS OF ANY KIND, either express or implied.
 * See the License for the specific language governing permissions and
 * limitations under the License.
 */

#include <aos/kernel.h>
#include "ssd1306.h"

#define OLED_MAX_TRANSFER_DATA_LEN 128

const unsigned char ascii_1608[95][16] = {
	{0x00,0x00,0x00,0x00,0x00,0x00,0x00,0x00,0x00,0x00,0x00,0x00,0x00,0x00,0x00,0x00},/*" ",0*/
	{0x00,0x00,0x00,0x1F,0x00,0x00,0x00,0x00,0x00,0x00,0x00,0xCC,0x0C,0x00,0x00,0x00},/*"!",1*/
	{0x00,0x08,0x30,0x60,0x08,0x30,0x60,0x00,0x00,0x00,0x00,0x00,0x00,0x00,0x00,0x00},/*""",2*/
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	{0x00,0x60,0x80,0x80,0x40,0x40,0x20,0x20,0x00,0x00,0x00,0x00,0x00,0x00,0x00,0x00},/*"~",94*/
};

const unsigned char flag[36]= {
	0x00,0x00,0x00,0x00,0x00,0x00,0x00,0x00,0x00,0x00,0x00,0x00,0x00,0x00,0x00,0x00,0x00,0x70,0x70,0x70,0x00,0x00,0x00,0x00,0x00,0x00,0x00,0x00,0x00,0x38,0x38,0x38,0x00,0x00,0x00,0x00,/*":",0*/
};/*":",0*/


static void oled_wrcmd(uint8_t cmd)
{
	ssd1306_write(cmd, SSD1306_CMD);
}

static void oled_wrdata(const uint8_t *data, uint32_t len)
{
	int i=0;
	if (len <= OLED_MAX_TRANSFER_DATA_LEN)
		for (i = 0; i < len; i++, data++)
			ssd1306_write(*data, SSD1306_DATA);
}

static void oled_setpos(uint8_t column, uint8_t page)
{
    oled_wrcmd(0xb0 + page);
    oled_wrcmd(((column & 0xf0) >> 4) | 0x10);
    oled_wrcmd((column & 0x0f) | 0x00);
}

static void oled_draw(uint8_t column, uint8_t page , const uint8_t *data, uint32_t len)
{
	oled_setpos(column, page);
	oled_wrdata(data, len);
}

int32_t oled_draw_char_1608(uint8_t x, uint8_t y, uint8_t c)
{
	const uint8_t *temp;
	c -= ' ';
	if (x > 128 || y > 7) {
		printf("oled show char %c error\n", c);
		return -1;
	}

	y = 7 - y;
	temp = &ascii_1608[c][0];
	oled_draw(x, y, temp, 8);
	oled_draw(x, y - 1, &temp[8], 8);
}

int32_t oled_draw_string_1608(uint8_t column, uint8_t page, const char *str)
{
	if (column > 128 || page > 7) {
		printf("oled show str error\n");
		return -1;
	}
    const char *p = str;
    while (*p != '\0') {
		oled_draw_char_1608(column, page, *(p++));
		column += 8;
		if (column > 128 || (128 - column) < 8) {
			page += 2;
			column = 0;
		}
	}
    return 0;
}

int32_t oled_draw_p8xnstr(uint8_t column, uint8_t page, const uint8_t* str, uint8_t len)
{
	oled_draw(column, page, str, len);
    return 0;
}

void oled_clear_screen(void)
{
	uint8_t data[128] = {0};
	int i = 0;
	for (i = 0; i <= 7; i++)
    	oled_draw_p8xnstr(0, i, data, 128);
}

