## platform/board/board_legacy/gd32f307c-eval/Config.in
```kconfig
config AOS_BOARD_GD32F307C_EVAL
    bool "GD32F307C_EVAL"
    select AOS_MCU_GD32F30X if !AOS_CREATE_PROJECT
    select AOS_COMP_KERNEL_INIT if !AOS_CREATE_PROJECT
    select AOS_COMP_NEWLIB_STUB if !AOS_CREATE_PROJECT
    select AOS_COMP_NETMGR if !AOS_CREATE_PROJECT
    select CONFIG_NO_TCPIP
    help

if AOS_BOARD_GD32F307C_EVAL
# Configurations for board gd32f307c-eval
endif
```

## platform/board/board_legacy/gd32f350r-eval/Config.in
```kconfig
config AOS_BOARD_GD32F350R_EVAL
    bool "GD32F350R_EVAL"
    select AOS_MCU_GD32F3X0 if !AOS_CREATE_PROJECT
    select AOS_COMP_KERNEL_INIT if !AOS_CREATE_PROJECT
    select AOS_COMP_NETMGR if !AOS_CREATE_PROJECT
    select AOS_COMP_NEWLIB_STUB if !AOS_CREATE_PROJECT
    select CONFIG_NO_TCPIP
    help

if AOS_BOARD_GD32F350R_EVAL
# Configurations for board gd32f350r-eval
endif
```

## platform/board/board_legacy/gd32f450z-eval/Config.in
```kconfig
config AOS_BOARD_GD32F450Z_EVAL
    bool "GD32F450Z_EVAL"
    select AOS_MCU_GD32F4XX
    select AOS_COMP_KERNEL_INIT
    select AOS_COMP_NEWLIB_STUB
    select AOS_COMP_NETMGR
    select CONFIG_NO_TCPIP
    help

if AOS_BOARD_GD32F450Z_EVAL
# Configurations for board gd32f450z-eval
endif
```

## platform/board/board_legacy/hc32l136k8ta/Config.in
```kconfig
config AOS_BOARD_HC32L136K8TA
    bool "HC32L136K8TA"
    select AOS_MCU_HC32L136 if !AOS_CREATE_PROJECT
    select AOS_COMP_NEWLIB_STUB if !AOS_CREATE_PROJECT
    select CONFIG_NO_TCPIP
    help

if AOS_BOARD_HC32L136K8TA
# Configurations for board hc32l136k8ta
endif
```

## platform/board/board_legacy/hifive1/Config.in
```kconfig
config AOS_BOARD_HIFIVE1
    bool "HIFIVE1"
    select AOS_MCU_E310 if !AOS_CREATE_PROJECT
    select AOS_COMP_KERNEL_INIT if !AOS_CREATE_PROJECT
    select CONFIG_NO_TCPIP
    help

if AOS_BOARD_HIFIVE1
# Configurations for board hifive1
endif
```

## platform/board/board_legacy/hk32f103rb_evb/Config.in
```kconfig
config AOS_BOARD_HK32F103RB_EVB
    bool "HK32F103RB_EVB"
    select AOS_MCU_HK32F103 if !AOS_CREATE_PROJECT
    select AOS_COMP_NEWLIB_STU if !AOS_CREATE_PROJECT
    select CONFIG_NO_TCPIP
    help

if AOS_BOARD_HK32F103RB_EVB
# Configurations for board hk32f103rb_evb
endif
```

## platform/board/board_legacy/hr8p287fjlt/Config.in
```kconfig
config AOS_BOARD_HR8P287FJLT
    bool "HR8P287FJLT"
    select AOS_MCU_HR8P2XX
    select AOS_COMP_NEWLIB_STUB
    select CONFIG_NO_TCPIP
    help
        **Hr8p287fjlt** is a highly integrated, general-purpose MCU chip with an integrated 32-bit ARM Cortex-M0 CPU core.

if AOS_BOARD_HR8P287FJLT
# Configurations for board hr8p287fjlt
endif
```

## platform/board/board_legacy/hr8p296fllt/Config.in
```kconfig
config AOS_BOARD_HR8P296FLLT
    bool "HR8P296FLLT"
    select AOS_MCU_HR8P2XX if !AOS_CREATE_PROJECT
    select AOS_COMP_NEWLIB_STUB if !AOS_CREATE_PROJECT
    select CONFIG_NO_TCPIP
    help
        **Hr8p296fllt** is a highly integrated, general-purpose MCU chip with an integrated 32-bit ARM Cortex-M0 CPU core.

if AOS_BOARD_HR8P296FLLT
# Configurations for board hr8p296fllt
endif
```

## platform/board/board_legacy/imx6dq/Config.in
```kconfig
config AOS_BOARD_IMX6DQ
    bool "IMX6DQ"
    select AOS_MCU_IMX6 if !AOS_CREATE_PROJECT
    select AOS_COMP_KERNEL_INIT if !AOS_CREATE_PROJECT
    select CONFIG_NO_TCPIP
    help

if AOS_BOARD_IMX6DQ
config AOS_CONFIG_SMP
    bool "Enable SMP"
    default y

# Configurations for board imx6dq
endif
```

## platform/board/board_legacy/imx6sl/Config.in
```kconfig
config AOS_BOARD_IMX6SL
    bool "IMX6SL"
    select AOS_MCU_IMX6 if !AOS_CREATE_PROJECT
    select AOS_COMP_KERNEL_INIT if !AOS_CREATE_PROJECT
    select CONFIG_NO_TCPIP
    help

if AOS_BOARD_IMX6SL
# Configurations for board imx6sl
endif
```

## platform/board/board_legacy/lpcxpresso54018/Config.in
```kconfig
config AOS_BOARD_LPCXPRESSO54018
    bool "LPCXPRESSO54018"
    select AOS_MCU_LPC54018IMPL if !AOS_CREATE_PROJECT
    select AOS_COMP_KERNEL_INIT if !AOS_CREATE_PROJECT
    select CONFIG_NO_TCPIP
    help

if AOS_BOARD_LPCXPRESSO54018
# Configurations for board board_lpcxpresso54018

# "BSP SUPPORT FEATURE"
config BSP_SUPPORT_UART
    bool
    default y

config BSP_SUPPORT_FLASH
    bool
    default y

endif
```

## platform/board/board_legacy/lpcxpresso54102/Config.in
```kconfig
config AOS_BOARD_LPCXPRESSO54102
    bool "LPCXPRESSO54102"
    select AOS_MCU_LPC54102IMPL
    select AOS_COMP_KERNEL_INIT
    select CONFIG_AOS_TCPIP if !BSP_SUPPORT_EXTERNAL_MODULE
    select CONFIG_NO_TCPIP  if BSP_SUPPORT_EXTERNAL_MODULE
    help

if AOS_BOARD_LPCXPRESSO54102
# Configurations for board board_lpcxpresso54102

# "BSP SUPPORT FEATURE"
config BSP_SUPPORT_UART
    bool
    default y

config BSP_SUPPORT_GPIO
    bool
    default y

config BSP_SUPPORT_I2C
    bool
    default y

config BSP_SUPPORT_SPI
    bool
    default y

config BSP_SUPPORT_FLASH
    bool
    default y

config BSP_SUPPORT_TIMER
    bool
    default y

config BSP_SUPPORT_WIFI
    bool
    default y

config BSP_SUPPORT_EXTERNAL_MODULE
    bool "Support external module"
    default y

endif
```

## platform/board/board_legacy/lpcxpresso54608/Config.in
```kconfig
config AOS_BOARD_LPCXPRESSO54608
    bool "LPCXPRESSO54608"
    select AOS_MCU_LPC54608IMPL
    select AOS_COMP_KERNEL_INIT
    select CONFIG_AOS_TCPIP
    help

if AOS_BOARD_LPCXPRESSO54608
# Configurations for board board_lpcxpresso54608

# "BSP SUPPORT FEATURE"
config BSP_SUPPORT_UART
    bool
    default y

config BSP_SUPPORT_FLASH
    bool
    default y

config BSP_SUPPORT_TIMER
    bool
    default y

endif
```

## platform/board/board_legacy/m100c/Config.in
```kconfig
config AOS_BOARD_M100C
    bool "M100C"
    select AOS_MCU_EFM32GXX
    select AOS_COMP_KERNEL_INIT
    select AOS_COMP_LORAWAN_STACK
    select CONFIG_NO_TCPIP
    help

if AOS_BOARD_M100C
# Configurations for board board_m100c

# "BSP SUPPORT FEATURE"
config BSP_SUPPORT_UART
    bool
    default y

config BSP_SUPPORT_FLASH
    bool
    default y

config BSP_SUPPORT_LORA
    bool
    default y

endif
```

## platform/board/board_legacy/m400/Config.in
```kconfig
config AOS_BOARD_M400
    bool "M400"
    select AOS_MCU_STM32L0XX if !AOS_CREATE_PROJECT
    select AOS_COMP_KERNEL_INIT if !AOS_CREATE_PROJECT
    select AOS_COMP_LORAWAN_STACK if !AOS_CREATE_PROJECT
    select CONFIG_NO_TCPIP
    help

if AOS_BOARD_M400
# Configurations for board board_m400

# "BSP SUPPORT FEATURE"
config BSP_SUPPORT_I2C
    bool
    default y

config BSP_SUPPORT_FLASH
    bool
    default y

config BSP_SUPPORT_LORA
    bool
    default y

endif
```

## platform/board/board_legacy/mk1101/Config.in
```kconfig
config AOS_BOARD_MK1101
    bool "MK1101"
    select AOS_MCU_MX1101 if !AOS_CREATE_PROJECT
    select AOS_COMP_KERNEL_INIT if !AOS_CREATE_PROJECT
    select CONFIG_NO_TCPIP
    help

if AOS_BOARD_MK1101
# Configurations for board board_mk1101

# "BSP SUPPORT FEATURE"
config BSP_SUPPORT_I2C
    bool
    default y

config BSP_SUPPORT_FLASH
    bool
    default y

config SAL_MODULE
    string
    default ""
endif
```

## platform/board/board_legacy/mk3060/Config.in
```kconfig
config AOS_BOARD_MK3060
    bool "MK3060"
    select AOS_MCU_MOC108 if !AOS_CREATE_PROJECT
    select AOS_COMP_KERNEL_INIT if !AOS_CREATE_PROJECT
    select CONFIG_AOS_TCPIP
    help
        MK3060's mcu is MOC108. The MOC108 is a highly integrated, high-performance, low-power IoT WiFi SOC.

if AOS_BOARD_MK3060
# Configurations for board board_mk3060


# "BSP SUPPORT FEATURE"
config BSP_SUPPORT_UART
    bool
    default y

config BSP_SUPPORT_I2C
    bool
    default y

config BSP_SUPPORT_GPIO
    bool
    default y

config BSP_SUPPORT_SPI
    bool
    default y

config BSP_SUPPORT_FLASH
    bool
    default y

config BSP_SUPPORT_ADC
    bool
    default y

config BSP_SUPPORT_TIMER
    bool
    default y

config BSP_SUPPORT_WDG
    bool
    default y

config BSP_SUPPORT_WIFI
    bool
    default y

# link security config
config CONFIG_LS_DEBUG
    bool
    default n
config CONFIG_LS_ID2_OTP
    bool
    default y
config CONFIG_LS_KM_SE
    bool
    default n
config CONFIG_LS_KM_TEE
    bool
    default n

endif
```

## platform/board/board_legacy/msp432p4111launchpad/Config.in
```kconfig
config AOS_BOARD_MSP432P4111LAUNCHPAD
    bool "MSP432P4111LaunchPad"
    select AOS_MCU_MSP432P4XX
    select AOS_COMP_KERNEL_INIT
    select CONFIG_AOS_TCPIP if !BSP_SUPPORT_EXTERNAL_MODULE
    select CONFIG_NO_TCPIP  if BSP_SUPPORT_EXTERNAL_MODULE
    help

if AOS_BOARD_MSP432P4111LAUNCHPAD
# Configurations for board msp432p4111launchpad

# "BSP SUPPORT FEATURE"
config BSP_SUPPORT_UART
    bool
    default y

config BSP_SUPPORT_FLASH
    bool
    default y

config BSP_SUPPORT_I2C
    bool
    default y

config BSP_SUPPORT_GPIO
    bool
    default y

config BSP_SUPPORT_WIFI
    bool
    default y

config BSP_SUPPORT_EXTERNAL_MODULE
    bool "Support external module"
    default y

endif
```

## platform/board/board_legacy/numaker-pfm-m487/Config.in
```kconfig
config AOS_BOARD_NUMAKER_PFM_M487
    bool "NUMAKER_PFM_M487"
    select AOS_MCU_M487JIDAE
    select AOS_COMP_KERNEL_INIT
    select AOS_COMP_NEWLIB_STUB
    select AOS_COMP_NETMGR
    select CONFIG_AOS_TCPIP if !BSP_SUPPORT_EXTERNAL_MODULE
    select CONFIG_NO_TCPIP  if BSP_SUPPORT_EXTERNAL_MODULE
    help

if AOS_BOARD_NUMAKER_PFM_M487
# Configurations for board numaker-pfm-m487

config BSP_SUPPORT_EXTERNAL_MODULE
    bool "Support external module"
    default n

endif
```

## platform/board/board_legacy/numaker-pfm-nano130/Config.in
```kconfig
config AOS_BOARD_NUMAKER_PFM_NANO130
    bool "NUMAKER_PFM_Nano130"
    select AOS_MCU_NANO130KE3BN if !AOS_CREATE_PROJECT
    select AOS_COMP_KERNEL_INIT if !AOS_CREATE_PROJECT
    select AOS_COMP_NEWLIB_STUB if !AOS_CREATE_PROJECT
    select AOS_COMP_NETMGR if !AOS_CREATE_PROJECT
    select CONFIG_NO_TCPIP
    help

if AOS_BOARD_NUMAKER_PFM_NANO130
# Configurations for board numaker-pfm-nano130
endif
```

## platform/board/board_legacy/nutiny-evb-nano130/Config.in
```kconfig
config AOS_BOARD_NUTINY_EVB_NANO130
    bool "NUTINY_EVB_Nano130"
    select AOS_MCU_NANO130KE3BN if !AOS_CREATE_PROJECT
    select AOS_COMP_NEWLIB_STUB if !AOS_CREATE_PROJECT
    select AOS_COMP_NETMGR if !AOS_CREATE_PROJECT
    select AOS_COMP_KERNEL_INIT if !AOS_CREATE_PROJECT
    select CONFIG_NO_TCPIP
    help

if AOS_BOARD_NUTINY_EVB_NANO130
# Configurations for board nutiny-evb-nano130
endif
```

## platform/board/board_legacy/pca10040e/Config.in
```kconfig
config AOS_BOARD_PCA10040E
    bool "PCA10040E"
    select AOS_MCU_NRF52XXX if !AOS_CREATE_PROJECT
    select AOS_COMP_KERNEL_INIT if !AOS_CREATE_PROJECT
    select CONFIG_NO_TCPIP
    help

if AOS_BOARD_PCA10040E
# Configurations for board board_pca10040e

# "BSP SUPPORT FEATURE"
config BSP_SUPPORT_UART
    bool
    default y

config BSP_SUPPORT_FLASH
    bool
    default y

config BSP_SUPPORT_GPIO
    bool
    default y

config BSP_SUPPORT_TIMER
    bool
    default y

config BSP_SUPPORT_BLE
    bool
    default y

endif
```

## platform/board/board_legacy/pca10056/Config.in
```kconfig
config AOS_BOARD_PCA10056
    bool "PCA10056"
    select AOS_MCU_NRF52XXX if !AOS_CREATE_PROJECT
    select AOS_COMP_KERNEL_INIT if !AOS_CREATE_PROJECT
    select CONFIG_NO_TCPIP
    help

if AOS_BOARD_PCA10056
# Configurations for board board_pca10056

# "BSP SUPPORT FEATURE"
config BSP_SUPPORT_UART
    bool
    default y

config BSP_SUPPORT_FLASH
    bool
    default y

config BSP_SUPPORT_GPIO
    bool
    default y

config BSP_SUPPORT_TIMER
    bool
    default y

config BSP_SUPPORT_BLE
    bool
    default y

endif
```

## platform/board/board_legacy/rk1108/Config.in
```kconfig
config AOS_BOARD_RK1108
    bool "RK1108"
    select AOS_MCU_LINUXIMPL if !AOS_CREATE_PROJECT
    select AOS_COMP_KERNEL_INIT if !AOS_CREATE_PROJECT
    select CONFIG_AOS_TCPIP
    help

if AOS_BOARD_RK1108
# Configurations for board board_rk1108

# "BSP SUPPORT FEATURE"
config BSP_SUPPORT_WIFI
    bool
    default y

endif
```

## platform/board/board_legacy/saml21_iot_sk/Config.in
```kconfig
config AOS_BOARD_SAML21_IOT_SK
    bool "SAML21_IOT_SK"
    select AOS_MCU_ATSAML21 if !AOS_CREATE_PROJECT
    select AOS_COMP_KERNEL_INIT if !AOS_CREATE_PROJECT
    select AOS_COMP_NETMGR if !AOS_CREATE_PROJECT
    select AOS_COMP_NEWLIB_STUB if !AOS_CREATE_PROJECT
    select CONFIG_AOS_TCPIP if !BSP_SUPPORT_EXTERNAL_MODULE
    select CONFIG_NO_TCPIP  if BSP_SUPPORT_EXTERNAL_MODULE
    help

if AOS_BOARD_SAML21_IOT_SK
# Configurations for board saml21_iot_sk

# "BSP SUPPORT FEATURE"
config BSP_SUPPORT_WIFI
    bool
    default y

config BSP_SUPPORT_EXTERNAL_MODULE
    bool "Support external module"
    default y

endif
```
