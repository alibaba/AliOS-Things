## platform/board/mk3072/Config.in
```kconfig
config AOS_BOARD_MK3072
    bool "MK3072"
    select AOS_MCU_ASR5501MK
    select AOS_COMP_KERNEL_INIT
    select AOS_COMP_LWIP if AOS_NETWORK_SAL
    select AOS_COMP_NETMGR
    help

if AOS_BOARD_MK3072
# Configurations for board mk3072

# "BSP SUPPORT FEATURE"
config BSP_SUPPORT_UART
    bool
    default y

config BSP_SUPPORT_GPIO
    bool
    default y

config BSP_SUPPORT_FLASH
    bool
    default y

config BSP_SUPPORT_I2C
    bool
    default y

config BSP_SUPPORT_WIFI
    bool
    default y

config BSP_SUPPORT_WIFI_LOWPOWER
    bool
    default y

endif
```

## platform/board/mk3080/Config.in
```kconfig
config AOS_BOARD_MK3080
    bool "MK3080"
    select AOS_MCU_RTL8710BN if !AOS_CREATE_PROJECT
    select AOS_COMP_KERNEL_INIT if !AOS_CREATE_PROJECT
    select CONFIG_AOS_TCPIP
    help

if AOS_BOARD_MK3080
# Configurations for board board_mk3080

config MK3080_CONFIG_SPIFFS
    bool "Locate SPIFFS for using"
    default n
    help
        Locate flash for spiffs fs, most of them comes from OTA temp room.

if MK3080_CONFIG_SPIFFS
choice
    prompt "Choose Size of SPIFFS"
    default MK3080_CONFIG_SPIFFS_SIZE_256KB
    help
        Select the size for spiffs

    config MK3080_CONFIG_SPIFFS_SIZE_64KB
        bool "64KB"

    config MK3080_CONFIG_SPIFFS_SIZE_128KB
        bool "128KB"

    config MK3080_CONFIG_SPIFFS_SIZE_256KB
        bool "256KB"
endchoice

config CONFIG_SPIFFS_PHYS_SZ
    int
    default 65536  if MK3080_CONFIG_SPIFFS_SIZE_64KB
    default 131072 if MK3080_CONFIG_SPIFFS_SIZE_128KB
    default 262144 if MK3080_CONFIG_SPIFFS_SIZE_256KB
endif

# "BSP SUPPORT FEATURE"
config BSP_SUPPORT_UART
    bool
    default y

config BSP_SUPPORT_GPIO
    bool
    default y

config BSP_SUPPORT_TIMER
    bool
    default y

config BSP_SUPPORT_FLASH
    bool
    default y

config BSP_SUPPORT_WDG
    bool
    default y

config BSP_SUPPORT_WIFI
    bool
    default y

# link security config
config CONFIG_LS_DEBUG
    bool
    default n
config CONFIG_LS_ID2_OTP
    bool
    default y
config CONFIG_LS_KM_SE
    bool
    default n
config CONFIG_LS_KM_TEE
    bool
    default n

config BSP_SUPPORT_WIFI_LOWPOWER
    bool
    default y

endif
```

## platform/board/msp432p4111launchpad/Config.in
```kconfig
config AOS_BOARD_MSP432P4111LAUNCHPAD
    bool "MSP432P4111LaunchPad"
    select AOS_MCU_MSP432P4XX
    select AOS_COMP_KERNEL_INIT
    select AOS_COMP_SAL if AOS_NETWORK_SAL
    select AOS_COMP_NETMGR if AOS_NETWORK_SAL
    help

if AOS_BOARD_MSP432P4111LAUNCHPAD
# Configurations for board msp432p4111launchpad

# "BSP SUPPORT FEATURE"
config BSP_SUPPORT_UART
    bool
    default y

config BSP_SUPPORT_FLASH
    bool
    default y

config BSP_SUPPORT_I2C
    bool
    default y

config BSP_SUPPORT_GPIO
    bool
    default y

config BSP_SUPPORT_WIFI
    bool
    default y

config BSP_SUPPORT_EXTERNAL_MODULE
    bool "Support external module"
    default y

endif
```

## platform/board/mt7682s/Config.in
```kconfig
config AOS_BOARD_MT7682S
    bool "MT7682S"
    select AOS_MCU_MTK7682
    select AOS_COMP_KERNEL_INIT
    select AOS_COMP_NEWLIB_STUB
    select AOS_COMP_NETMGR
    select AOS_COMP_LWIP
    help

if AOS_BOARD_MT7682S
# Configurations for board mt7682s
endif
```

## platform/board/numaker-iot-m487/Config.in
```kconfig
config AOS_BOARD_NUMAKER_IOT_M487
    bool "NUMAKER_IOT_M487"
    select AOS_MCU_M487JIDAE
    select AOS_COMP_KERNEL_INIT
    select AOS_COMP_NEWLIB_STUB
    select AOS_COMP_NETMGR
    help

if AOS_BOARD_NUMAKER_IOT_M487
# Configurations for board numaker-iot-m487

config BSP_SUPPORT_EXTERNAL_MODULE
    bool "Support external module"
    default n

endif
```

## platform/board/pca10040/Config.in
```kconfig
config AOS_BOARD_PCA10040
    bool "PCA10040"
    select AOS_MCU_NRF52XXX
    select AOS_COMP_KERNEL_INIT
    help
        The Pca10040's mcu is nRF52832. The nRF52832 is the mid-range member of the nRF52 Series SoC family. It meets the challenges of a broad range of applications that need Bluetooth 5 feature sets, protocol concurrency and a rich and varied set of peripherals and features. In addition, it offers generous memory availability for both Flash and RAM.

if AOS_BOARD_PCA10040
# Configurations for board board_pca10040

# "BSP SUPPORT FEATURE"
config BSP_SUPPORT_UART
    bool
    default y

config BSP_SUPPORT_FLASH
    bool
    default y

config BSP_SUPPORT_GPIO
    bool
    default y

config BSP_SUPPORT_TIMER
    bool
    default y

config BSP_SUPPORT_BLE
    bool
    default y

endif
```

## platform/board/saml21_iot_sk/Config.in
```kconfig
config AOS_BOARD_SAML21_IOT_SK
    bool "SAML21_IOT_SK"
    select AOS_MCU_ATSAML21
    select AOS_COMP_KERNEL_INIT
    select AOS_COMP_NETMGR
    select AOS_COMP_NEWLIB_STUB
    select AOS_COMP_SAL if AOS_NETWORK_SAL
    help

if AOS_BOARD_SAML21_IOT_SK
# Configurations for board saml21_iot_sk

# "BSP SUPPORT FEATURE"
config BSP_SUPPORT_WIFI
    bool
    default y

config BSP_SUPPORT_EXTERNAL_MODULE
    bool "Support external module"
    default y

endif
```

## platform/board/starterkit/Config.in
```kconfig
config AOS_BOARD_STARTERKIT
    bool "StarterKit"
    select AOS_MCU_STM32L4XX_CUBE
    select AOS_COMP_KERNEL_INIT
    select AOS_COMP_SENSOR
    help

if AOS_BOARD_STARTERKIT
# Configurations for board starterkit

# "BSP SUPPORT FEATURE"
config BSP_SUPPORT_UART
    bool
    default y

config BSP_SUPPORT_I2C
    bool
    default y

config BSP_SUPPORT_FLASH
    bool
    default y

config BSP_SUPPORT_GPIO
    bool
    default y

config BSP_SUPPORT_TIMER
    bool
    default y

config BSP_SUPPORT_SPI
    bool
    default y

config BSP_SUPPORT_RTC
    bool
    default y

config BSP_SUPPORT_WIFI
    bool
    default y

config BSP_SUPPORT_EXTERNAL_MODULE
    bool
    default y

config BSP_EXTERNAL_WIFI_MODULE
    string
    depends on BSP_SUPPORT_EXTERNAL_MODULE
    default "wifi.bk7231"

endif
```

## platform/board/stm32f103rb-demo/Config.in
```kconfig
config AOS_BOARD_STM32F103RB_DEMO
    bool "STM32F103RB_Nucleo"
    select AOS_MCU_STM32F1XX
    select AOS_COMP_KERNEL_INIT
    select AOS_COMP_OSAL_AOS
    help
        **The Stm32f103rb-nucleo** performance line microcontroller incorporates the high-performance ARM® Cortex™-M3 32-bit RISC core operating at a 72 MHz frequency, high-speed embedded memories, and an extensive range of enhanced I/Os and peripherals connected to two APB buses. The STM32F103RC offers three 12-bit ADCs, four general-purpose 16- bit timers plus two PWM timers, as well as standard and advanced communication interfaces: up to two I2Cs, three SPIs, two I2Ss, one SDIO, five USARTs, an USB and a CAN.

if AOS_BOARD_STM32F103RB_DEMO
# Configurations for board stm32f103rb-demo

endif
```

## platform/board/stm32f103rb-nucleo/Config.in
```kconfig
config AOS_BOARD_STM32F103RB_NUCLEO
    bool "STM32F103RB_Nucleo"
    default y if AOS_CREATE_PROJECT
    select AOS_MCU_STM32F1XX if !AOS_CREATE_PROJECT
    select AOS_COMP_KERNEL_INIT if !AOS_CREATE_PROJECT
    select AOS_COMP_OSAL_AOS if !AOS_CREATE_PROJECT
    select CONFIG_NO_TCPIP
    help
        **The Stm32f103rb-nucleo** performance line microcontroller incorporates the high-performance ARM® Cortex™-M3 32-bit RISC core operating at a 72 MHz frequency, high-speed embedded memories, and an extensive range of enhanced I/Os and peripherals connected to two APB buses. The STM32F103RC offers three 12-bit ADCs, four general-purpose 16- bit timers plus two PWM timers, as well as standard and advanced communication interfaces: up to two I2Cs, three SPIs, two I2Ss, one SDIO, five USARTs, an USB and a CAN.

if AOS_BOARD_STM32F103RB_NUCLEO
# Configurations for board stm32f103rb

endif
```

## platform/board/stm32f429zi-mk/Config.in
```kconfig
config AOS_BOARD_STM32F429ZI_MK
    bool "stm32f429zi-mk"
    select AOS_MCU_STM32F4XX_CUBE
    select AOS_COMP_LWIP if AOS_NETWORK_SAL
    select AOS_COMP_CLI
    select RHINO_CONFIG_USER_SPACE
    select RHINO_CONFIG_URES
    select RHINO_CONFIG_UCLI
    select RHINO_CONFIG_UTCPIP
    #select RHINO_CONFIG_UFS
    select RHINO_CONFIG_UIPC
    #select RHINO_CONFIG_ULINKKIT
    #select RHINO_CONFIG_HAL_ADC_SYSCALL
    #select RHINO_CONFIG_HAL_DAC_SYSCALL
    #select RHINO_CONFIG_HAL_ADC_SYSCALL
    #select RHINO_CONFIG_HAL_FLASH_SYSCALL
    #select RHINO_CONFIG_HAL_GPIO_SYSCALL
    #select RHINO_CONFIG_HAL_I2C_SYSCALL
    #select RHINO_CONFIG_HAL_NAND_SYSCALL
    #select RHINO_CONFIG_HAL_NOR_SYSCALL
    #select RHINO_CONFIG_HAL_RTC_SYSCALL
    #select RHINO_CONFIG_HAL_SD_SYSCALL
    #select RHINO_CONFIG_HAL_SPI_SYSCALL
    select RHINO_CONFIG_HAL_UART_SYSCALL
    #select RHINO_CONFIG_DYN_SYSCALL_TBL

if AOS_BOARD_STM32F429ZI_MK
# Configurations for board stm32f429zi-mk

# Set default value of AOS_NETWORK_SAL
config AOS_NETWORK_SAL
    bool "AOS_NETWORK_SAL"
    default n

config BSP_SUPPORT_UART
    bool "BSP_SUPPORT_UART"
    default y

config BSP_SUPPORT_FLASH
    bool "BSP_SUPPORT_FLASH"
    default y

config BSP_SUPPORT_GPIO
    bool "BSP_SUPPORT_GPIO"
    default y

config BSP_SUPPORT_I2C
    bool "BSP_SUPPORT_I2C"
    default y

config DEBUG_CONFIG_PANIC
    bool "Enable debug panic feature"
    default y
    help
        set to y if you want to enable panic debug feature when system crash happened,
        default y

endif
```

## platform/board/stm32f429zi-nucleo/Config.in
```kconfig
config AOS_BOARD_STM32F429ZI_NUCLEO
    bool "STM32F429ZI_Nucleo"
    select AOS_MCU_STM32F4XX_CUBE  if !AOS_CREATE_PROJECT
    select AOS_COMP_KERNEL_INIT    if !AOS_CREATE_PROJECT
    select AOS_COMP_NETMGR if BSP_SUPPORT_EXTERNAL_MODULE && !AOS_CREATE_PROJECT
    select CONFIG_AOS_TCPIP if !BSP_SUPPORT_EXTERNAL_MODULE
    select CONFIG_NO_TCPIP  if BSP_SUPPORT_EXTERNAL_MODULE
    help
        **Stm32f429zi-nucleo** is hardware board base on [AliOS-Things](https://github.com/alibaba/AliOS-Things), with a variety of peripherals.

if AOS_BOARD_STM32F429ZI_NUCLEO
# Configurations for board stm32f429zi-nucleo

# "BSP SUPPORT FEATURE"
config BSP_SUPPORT_UART
    bool
    default y

config BSP_SUPPORT_FLASH
    bool
    default y

config BSP_SUPPORT_GPIO
    bool
    default y

config BSP_SUPPORT_I2C
    bool
    default y

config BSP_SUPPORT_WIFI
    bool
    default y

config BSP_SUPPORT_EXTERNAL_MODULE
    bool "Support external module"
    default n

endif
```

## platform/board/stm32f769i-discovery/Config.in
```kconfig
config AOS_BOARD_B_F769
    bool "STM32F769I-Discovery"
    select AOS_MCU_STM32F7XX
    select AOS_COMP_KERNEL_INIT
    help

if AOS_BOARD_B_F769
# Configurations for board board_b_f769

# "BSP SUPPORT FEATURE"
config BSP_SUPPORT_UART
    bool
    default y

config BSP_SUPPORT_FLASH
    bool
    default y

config BSP_SUPPORT_WIFI
    bool
    default y

endif
```

## platform/board/stm32l476rg-nucleo/Config.in
```kconfig
config AOS_BOARD_STM32L476RG_NUCLEO
    bool "STM32L476RG_Nucleo"
    select AOS_MCU_STM32L4XX_CUBE
    select AOS_COMP_KERNEL_INIT
    help

if AOS_BOARD_STM32L476RG_NUCLEO
# Configurations for board stm32l476rg-nucleo

# "BSP SUPPORT FEATURE"
config BSP_SUPPORT_UART
    bool
    default y

config BSP_SUPPORT_FLASH
    bool
    default y

config BSP_SUPPORT_GPIO
    bool
    default y

config BSP_SUPPORT_I2C
    bool
    default y

config BSP_SUPPORT_SPI
    bool
    default y

config BSP_SUPPORT_RTC
    bool
    default y

config BSP_SUPPORT_TIMER
    bool
    default y

config BSP_SUPPORT_WIFI
    bool
    default y

config BSP_SUPPORT_EXTERNAL_MODULE
    bool "Support external module"
    default y

endif
```

## platform/mcu/Config.in
```kconfig
menu "MCU Configuration"

## --- Generated Automatically ---
source "platform/mcu/aamcu_demo/Config.in"
source "platform/mcu/atsamd5x_e5x/Config.in"
source "platform/mcu/atsaml21/Config.in"
source "platform/mcu/bk7231/Config.in"
source "platform/mcu/bk7231u/Config.in"
source "platform/mcu/csky/Config.in"
source "platform/mcu/cy8c6347/Config.in"
source "platform/mcu/dahua/Config.in"
source "platform/mcu/efm32gxx/Config.in"
source "platform/mcu/es8p508x/Config.in"
source "platform/mcu/esp32/Config.in"
source "platform/mcu/esp8266/Config.in"
source "platform/mcu/fm33a0xx/Config.in"
source "platform/mcu/freedom-e/e310/Config.in"
source "platform/mcu/gd32f30x/Config.in"
source "platform/mcu/gd32f3x0/Config.in"
source "platform/mcu/gd32f4xx/Config.in"
source "platform/mcu/hc32l136/Config.in"
source "platform/mcu/hk32f103/Config.in"
source "platform/mcu/hr8p2xx/Config.in"
source "platform/mcu/imx6/Config.in"
source "platform/mcu/imx6sl_svc/Config.in"
source "platform/mcu/linux/Config.in"
source "platform/mcu/lpc54018/Config.in"
source "platform/mcu/lpc54102/Config.in"
source "platform/mcu/lpc54114/Config.in"
source "platform/mcu/lpc54608/Config.in"
source "platform/mcu/lpc54628/Config.in"
source "platform/mcu/m487jidae/Config.in"
source "platform/mcu/mimxrt1021/Config.in"
source "platform/mcu/mimxrt1052/Config.in"
source "platform/mcu/mkl26z4/Config.in"
source "platform/mcu/mkl27z644/Config.in"
source "platform/mcu/mkl28z7/Config.in"
source "platform/mcu/mkl43z4/Config.in"
source "platform/mcu/mkl81z7/Config.in"
source "platform/mcu/mkl82z7/Config.in"
source "platform/mcu/moc108/Config.in"
source "platform/mcu/msp432p4xx/Config.in"
source "platform/mcu/mvs_ap80xx/Config.in"
source "platform/mcu/mx1101/Config.in"
source "platform/mcu/nano130ke3bn/Config.in"
source "platform/mcu/nrf52xxx/Config.in"
source "platform/mcu/rda5981x/Config.in"
source "platform/mcu/rda8955/Config.in"
source "platform/mcu/rtl8710bn/Config.in"
source "platform/mcu/sscp131/Config.in"
source "platform/mcu/stm32f1xx/Config.in"
source "platform/mcu/stm32f4xx/Config.in"
source "platform/mcu/stm32f4xx_cube/Config.in"
source "platform/mcu/stm32f4xx_syscall/Config.in"
source "platform/mcu/stm32f7xx/Config.in"
source "platform/mcu/stm32l0xx/stm32l071kb/Config.in"
source "platform/mcu/stm32l475/Config.in"
source "platform/mcu/stm32l4xx_cube/Config.in"
source "platform/mcu/stm32l4xx_syscall/Config.in"
source "platform/mcu/wm_w600/Config.in"
source "platform/mcu/xm510/Config.in"
source "platform/mcu/xr871/Config.in"
## --- End ---

endmenu
```

## platform/mcu/aamcu_demo/Config.in
```kconfig
if AOS_CREATE_PROJECT
config AOS_MCU_AAMCU_DEMO
    bool
    default y
endif

if !AOS_CREATE_PROJECT
config AOS_MCU_AAMCU_DEMO
    bool
    select AOS_ARCH_ARMV7M
    select AOS_COMP_NEWLIB_STUB
    select AOS_COMP_RHINO
    help
      driver & sdk for platform/mcu aamcu_demo
endif

if AOS_MCU_AAMCU_DEMO
# Configurations for mcu aamcu_demo
endif
```

## platform/mcu/asr5501/Config.in
```kconfig
if AOS_CREATE_PROJECT
config AOS_MCU_ASR5501
    bool
    default y
endif

if !AOS_CREATE_PROJECT
config AOS_MCU_ASR5501
    bool
    select AOS_ARCH_ARMV7M
    select AOS_COMP_NEWLIB_STUB
    select AOS_COMP_RHINO
    help
      driver & sdk for platform/mcu asr5501
endif

if AOS_MCU_ASR5501
# Configurations for mcu asr5501
endif
```

## platform/mcu/asr5501mk/Config.in
```kconfig
if AOS_CREATE_PROJECT
config AOS_MCU_ASR5501MK
    bool
    default y
endif

if !AOS_CREATE_PROJECT
config AOS_MCU_ASR5501MK
    bool
    select AOS_ARCH_ARMV7M
    select AOS_COMP_NEWLIB_STUB
    select AOS_COMP_RHINO
    help
      driver & sdk for platform/mcu asr5501mk
endif

if AOS_MCU_ASR5501MK
# Configurations for mcu asr5501mk
endif
```

## platform/mcu/atsamd5x_e5x/Config.in
```kconfig
menuconfig AOS_MCU_ATSAME54
    bool "atsame54"
    default n
    select AOS_COMP_HAL
    select AOS_COMP_NEWLIB_STUB
    select AOS_ARCH_ARMV7M
    select AOS_COMP_HALWIFI
    select AOS_COMP_VFS
    select AOS_COMP_KV
    select AOS_COMP_RHINO
    select AOS_COMP_DIGEST_ALGORITHM
    help

if AOS_MCU_ATSAME54
# Configurations for mcu atsame54
endif
```
