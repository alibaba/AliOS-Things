## platform/mcu/atsaml21/Config.in
```kconfig
if AOS_CREATE_PROJECT
config AOS_MCU_ATSAML21
    bool
    default y
endif

if !AOS_CREATE_PROJECT
config AOS_MCU_ATSAML21
    bool
    select AOS_ARCH_ARMV6M
    select AOS_COMP_RHINO
    help
      driver & sdk for platform/mcu atsaml21
endif

if AOS_MCU_ATSAML21
# Configurations for mcu atsaml21
endif
```

## platform/mcu/bk7231/Config.in
```kconfig
config AOS_MCU_BK7231
    bool "mcu_bk7231"
    select AOS_COMP_LWIP
    select AOS_COMP_NEWLIB_STUB
    select AOS_COMP_ALICRYPTO
    select AOS_COMP_NETMGR
    select AOS_COMP_RHINO
    select AOS_COMP_UMESH
    select AOS_COMP_YLOOP
    select AOS_COMP_LIBPROV
    select AOS_ARCH_ARMV5
    help
      driver & sdk for platform/mcu bk7231

if AOS_MCU_BK7231
# Configurations for mcu bk7231
endif
```

## platform/mcu/bk7231s/Config.in
```kconfig
if AOS_CREATE_PROJECT
config AOS_MCU_BK7231S
    bool
    default y
endif

if !AOS_CREATE_PROJECT
config AOS_MCU_BK7231S
    bool
    select AOS_COMP_NEWLIB_STUB
    select AOS_COMP_ALICRYPTO
    select AOS_COMP_NETMGR
    select AOS_COMP_RHINO
    select AOS_COMP_YLOOP
    select AOS_COMP_LIBPROV
    select AOS_ARCH_ARMV5
    select AOS_COMP_DEBUG
    help
      driver & sdk for platform/mcu bk7231s
endif

if AOS_MCU_BK7231S
# Configurations for mcu bk7231s
endif
```

## platform/mcu/bk7231u/Config.in
```kconfig
if AOS_CREATE_PROJECT
config AOS_MCU_BK7231U
    bool
    default y
endif

if !AOS_CREATE_PROJECT
config AOS_MCU_BK7231U
    bool
    select AOS_COMP_NEWLIB_STUB
    select AOS_COMP_NETMGR
    select AOS_COMP_RHINO
    select AOS_COMP_YLOOP
    select AOS_ARCH_ARMV5
    select AOS_COMP_LIBPROV
    select AOS_COMP_DEBUG
    help
      driver & sdk for platform/mcu bk7231u
endif

if AOS_MCU_BK7231U
# Configurations for mcu bk7231u
endif
```

## platform/mcu/csky/Config.in
```kconfig
if AOS_CREATE_PROJECT
config AOS_MCU_CSKY
    bool
    default y
    select CONFIG_VENDOR_TCPIP
endif

if !AOS_CREATE_PROJECT
config AOS_MCU_CSKY
    bool
    select AOS_COMP_CLI
    select AOS_COMP_NETMGR if MCU_CSKY_CONFIG_LWIP = y
    select CONFIG_VENDOR_TCPIP
    select AOS_COMP_RHINO
    select AOS_ARCH_CSKYV2_L
    help
      driver & sdk for platform/mcu csky
endif

if AOS_MCU_CSKY
# Configurations for mcu csky

config MCU_CSKY_CONFIG_LWIP
    bool
    default n

config BSP_SUPPORT_EXTERNAL_MODULE
    bool
    default y

config BSP_EXTERNAL_WIFI_MODULE
    string
    depends on BSP_SUPPORT_EXTERNAL_MODULE
    default "wifi.esp8266"

endif
```

## platform/mcu/csky/csi/csi_driver/csky/common/Kconfig
```kconfig
menu "Driver options"

config SPU
       bool "spu"
       default n
       help
         select the spu driver

config USI
       bool "usi"
       default n
       help
         select the usi driver
endmenu
```
