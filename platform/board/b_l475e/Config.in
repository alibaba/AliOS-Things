## platform/board/b_l475e/Config.in
```kconfig
config AOS_BOARD_B_L475E
    bool "B_L475E"
    select AOS_MCU_STM32L475
    select AOS_COMP_KERNEL_INIT
    select AOS_COMP_SAL if AOS_NETWORK_SAL
    help
      configuration for board b_l475e

if AOS_BOARD_B_L475E
# Configurations for board board_b_l475e

# "BSP SUPPORT FEATURE"
config BSP_SUPPORT_UART
    bool
    default y

config BSP_SUPPORT_GPIO
    bool
    default y

config BSP_SUPPORT_FLASH
    bool
    default y

config BSP_SUPPORT_TIMER
    bool
    default y

config BSP_SUPPORT_I2C
    bool
    default y

config BSP_SUPPORT_WIFI
    bool
    default y

config BSP_SUPPORT_EXTERNAL_MODULE
    bool "Support external module"
    default y

endif
```

## platform/board/board_legacy/amebaz_dev/Config.in
```kconfig
config AOS_BOARD_AMEBAZ_DEV
    bool "AMEBAZ_DEV"
    select AOS_MCU_RTL8710BN
    select AOS_COMP_KERNEL_INIT
    select CONFIG_AOS_TCPIP
    help
        **Amebaz-dev** is a highly integrated single-chip low power 802.11n Wireless LAN (WLAN) network controller.

if AOS_BOARD_AMEBAZ_DEV
# Configurations for board board_amebaz_dev

# "BSP SUPPORT FEATURE"
config BSP_SUPPORT_UART
    bool
    default y

config BSP_SUPPORT_GPIO
    bool
    default y

config BSP_SUPPORT_FLASH
    bool
    default y

config BSP_SUPPORT_TIMER
    bool
    default y

config BSP_SUPPORT_WDG
    bool
    default y

config BSP_SUPPORT_WIFI
    bool
    default y

endif
```

## platform/board/board_legacy/ap80a0/Config.in
```kconfig
config AOS_BOARD_AP80A0
    bool "AP80A0"
    select AOS_MCU_MVS_AP80XX if !AOS_CREATE_PROJECT
    select AOS_COMP_NEWLIB_STUB if !AOS_CREATE_PROJECT
    select CONFIG_AOS_TCPIP
    help

if AOS_BOARD_AP80A0
# Configurations for board ap80a0
endif
```

## platform/board/board_legacy/asr5501/Config.in
```kconfig
config AOS_BOARD_ASR5501
    bool "ASR5501"
    select AOS_MCU_ASR5501
    select AOS_COMP_KERNEL_INIT
    select AOS_COMP_LWIP
    select AOS_COMP_NETMGR
    help

if AOS_BOARD_ASR5501
# Configurations for board asr5501

# "BSP SUPPORT FEATURE"
config BSP_SUPPORT_UART
    bool
    default y

config BSP_SUPPORT_GPIO
    bool
    default y

config BSP_SUPPORT_FLASH
    bool
    default y

config BSP_SUPPORT_I2C
    bool
    default y

config BSP_SUPPORT_WIFI
    bool
    default y

config BSP_SUPPORT_WIFI_LOWPOWER
    bool
    default y

endif
```

## platform/board/board_legacy/asr6501/Config.in
```kconfig
config AOS_BOARD_ASR6501
    bool "ASR6501"
    select AOS_MCU_CY8C4147 if !AOS_CREATE_PROJECT
    select AOS_COMP_KERNEL_INIT if !AOS_CREATE_PROJECT
    select AOS_COMP_LORAWAN_STACK if !AOS_CREATE_PROJECT
    select CONFIG_NO_TCPIP
    help

if AOS_BOARD_ASR6501
# Configurations for board asr6501

# "BSP SUPPORT FEATURE"
config BSP_SUPPORT_I2C
    bool
    default y

config BSP_SUPPORT_FLASH
    bool
    default y

config BSP_SUPPORT_LORA
    bool
    default y

endif
```

## platform/board/board_legacy/atsame54-xpro/Config.in
```kconfig
config AOS_BOARD_ATSAME54_XPRO
    bool "ATSAME54_XPRO"
    select AOS_MCU_ATSAME54
    select AOS_COMP_KERNEL_INIT
    select CONFIG_AOS_TCPIP if !BSP_SUPPORT_EXTERNAL_MODULE
    select CONFIG_NO_TCPIP  if BSP_SUPPORT_EXTERNAL_MODULE
    help
      configuration for board atsame54-xpro

if AOS_BOARD_ATSAME54_XPRO
# Configurations for board board_atsame54-xpro

# "BSP SUPPORT FEATURE"
config BSP_SUPPORT_UART
    bool
    default y

config BSP_SUPPORT_FLASH
    bool
    default y

config BSP_SUPPORT_TIMER
    bool
    default y

config BSP_SUPPORT_WIFI
    bool
    default y

config BSP_SUPPORT_EXTERNAL_MODULE
    bool "Support external module"
    default y

endif
```

## platform/board/board_legacy/cb2201/Config.in
```kconfig
config AOS_BOARD_CB2201
    bool "CB2201"
    select AOS_MCU_CSKY
    select AOS_COMP_KERNEL_INIT
    select CONFIG_AOS_TCPIP
    help
      configuration for board cb2201

if AOS_BOARD_CB2201
# Configurations for board board_cb2201

# "BSP SUPPORT FEATURE"
config BSP_SUPPORT_UART
    bool
    default y

config BSP_SUPPORT_FLASH
    bool
    default y

config BSP_SUPPORT_I2C
    bool
    default y

config BSP_SUPPORT_WIFI
    bool
    default y

# link security config
config CONFIG_LS_DEBUG
    bool
    default n
config CONFIG_LS_ID2_OTP
    bool
    default y
config CONFIG_LS_KM_SE
    bool
    default n
config CONFIG_LS_KM_TEE
    bool
    default y

endif
#AOS_BOARD_CB2201
```

## platform/board/board_legacy/cy8ckit-062/Config.in
```kconfig
config AOS_BOARD_CY8CKIT_062
    bool "CY8CKit_062"
    select AOS_MCU_CY8C6347
    select AOS_COMP_KERNEL_INIT
    help
      configuration for board cy8ckit-062

if AOS_BOARD_CY8CKIT_062
# Configurations for board board_cy8ckit-062

# "BSP SUPPORT FEATURE"
config BSP_SUPPORT_UART
    bool
    default y

config BSP_SUPPORT_FLASH
    bool
    default y

config BSP_SUPPORT_TIMER
    bool
    default y

config BSP_SUPPORT_WIFI
    bool
    default y

config BSP_SUPPORT_EXTERNAL_MODULE
    bool "Support external module"
    default y

endif
```

## platform/board/board_legacy/developerkit-mk/Config.in
```kconfig
config AOS_BOARD_DEVELOPERKIT_MK
    bool "developerkit-mk"
    select AOS_MCU_STM32L4XX_CUBE
    select RHINO_CONFIG_USER_SPACE
    select RHINO_CONFIG_URES
    select RHINO_CONFIG_UCLI
    #select RHINO_CONFIG_UTCPIP
    #select RHINO_CONFIG_UFS
    select RHINO_CONFIG_UIPC
    #select RHINO_CONFIG_ULINKKIT
    #select RHINO_CONFIG_HAL_ADC_SYSCALL
    #select RHINO_CONFIG_HAL_DAC_SYSCALL
    #select RHINO_CONFIG_HAL_ADC_SYSCALL
    #select RHINO_CONFIG_HAL_FLASH_SYSCALL
    #select RHINO_CONFIG_HAL_GPIO_SYSCALL
    #select RHINO_CONFIG_HAL_I2C_SYSCALL
    #select RHINO_CONFIG_HAL_NAND_SYSCALL
    #select RHINO_CONFIG_HAL_NOR_SYSCALL
    #select RHINO_CONFIG_HAL_RTC_SYSCALL
    #select RHINO_CONFIG_HAL_SD_SYSCALL
    #select RHINO_CONFIG_HAL_SPI_SYSCALL
    select RHINO_CONFIG_HAL_UART_SYSCALL
    #select RHINO_CONFIG_DYN_SYSCALL_TBL
    select CONFIG_AOS_TCPIP if !BSP_SUPPORT_EXTERNAL_MODULE
    select CONFIG_NO_TCPIP  if BSP_SUPPORT_EXTERNAL_MODULE
    help
      Developer Kit is hardware development board base on AliOS-Things

if AOS_BOARD_DEVELOPERKIT_MK
# Configurations for board stm32f429zi-mk

# "BSP SUPPORT FEATURE"
config BSP_SUPPORT_UART
    bool
    default y

config BSP_SUPPORT_GPIO
    bool
    default y

config BSP_SUPPORT_I2C
    bool
    default y

config BSP_SUPPORT_SPI
    bool
    default y

config BSP_SUPPORT_FLASH
    bool
    default y

config BSP_SUPPORT_TIMER
    bool
    default y

config BSP_SUPPORT_RTC
    bool
    default y

config BSP_SUPPORT_WIFI
    bool
    default y

config BSP_SUPPORT_EXTERNAL_MODULE
    bool "Support external module"
    default y

endif
```

## platform/board/board_legacy/developerkit/Config.in
```kconfig
config AOS_BOARD_DEVELOPERKIT
    bool "DeveloperKit"
    select AOS_MCU_STM32L4XX_CUBE if !AOS_CREATE_PROJECT
    select AOS_COMP_KERNEL_INIT if !AOS_CREATE_PROJECT
    select AOS_COMP_SENSOR if !AOS_CREATE_PROJECT
    select CONFIG_AOS_TCPIP if !BSP_SUPPORT_EXTERNAL_MODULE
    select CONFIG_NO_TCPIP  if BSP_SUPPORT_EXTERNAL_MODULE
    help
      Developer Kit is hardware development board base on AliOS-Things

if AOS_BOARD_DEVELOPERKIT
# Configurations for board developerkit

# "BSP SUPPORT FEATURE"
config BSP_SUPPORT_UART
    bool
    default y

config BSP_SUPPORT_GPIO
    bool
    default y

config BSP_SUPPORT_I2C
    bool
    default y

config BSP_SUPPORT_SPI
    bool
    default y

config BSP_SUPPORT_FLASH
    bool
    default y

config BSP_SUPPORT_TIMER
    bool
    default y

config BSP_SUPPORT_RTC
    bool
    default y

config BSP_SUPPORT_WIFI
    bool
    default y

config BSP_SUPPORT_EXTERNAL_MODULE
    bool "Support external module"
    default y

endif
```

## platform/board/board_legacy/dh5021a_evb/Config.in
```kconfig
config AOS_BOARD_DH5021A_EVB
    bool "DH5021A_EVB"
    select AOS_MCU_DAHUA
    select AOS_COMP_KERNEL_INIT
    select CONFIG_AOS_TCPIP
    help

if AOS_BOARD_DH5021A_EVB
# Configurations for board dh5021a_evb

# "BSP SUPPORT FEATURE"
config BSP_SUPPORT_UART
    bool
    default y

config BSP_SUPPORT_FLASH
    bool
    default y

config BSP_SUPPORT_WIFI
    bool
    default y

endif
```

## platform/board/board_legacy/eml3047/Config.in
```kconfig
config AOS_BOARD_EML3047
    bool "EML3047"
    select AOS_MCU_STM32L0XX if !AOS_CREATE_PROJECT
    select AOS_COMP_KERNEL_INIT if !AOS_CREATE_PROJECT
    select AOS_COMP_LORAWAN_STACK if !AOS_CREATE_PROJECT
    select CONFIG_NO_TCPIP
    help

if AOS_BOARD_EML3047
# Configurations for board eml3047
# "BSP SUPPORT FEATURE"
config BSP_SUPPORT_I2C
    bool
    default y

config BSP_SUPPORT_FLASH
    bool
    default y

config BSP_SUPPORT_LORA
    bool
    default y

endif
```

## platform/board/board_legacy/es8p5088fllq/Config.in
```kconfig
config AOS_BOARD_ES8P5088FLLQ
    bool "ES8P5088FLLQ"
    select AOS_MCU_ES8P508X if !AOS_CREATE_PROJECT
    select AOS_COMP_NEWLIB_STUB if !AOS_CREATE_PROJECT
    select CONFIG_NO_TCPIP
    help

if AOS_BOARD_ES8P5088FLLQ
# Configurations for board es8p5088fllq

# "BSP SUPPORT FEATURE"
config BSP_SUPPORT_FLASH
    bool
    default y

endif
```

## platform/board/board_legacy/esp32devkitc/Config.in
```kconfig
config AOS_BOARD_ESP32DEVKITC
    bool "ESP32DevKitc"
    select AOS_MCU_ESP32 if !AOS_CREATE_PROJECT
    select AOS_COMP_KERNEL_INIT if !AOS_CREATE_PROJECT
    select CONFIG_AOS_TCPIP
    help
        **ESP32** is a single 2.4 GHz Wi-Fi-and-Bluetooth combo chip designed with the TSMC ultra-low-power 40 nm technology. It is designed to achieve the best power and RF performance, showing robustness, versatility and reliability in a wide variety of applications and power scenarios.

if AOS_BOARD_ESP32DEVKITC
# Configurations for board esp32devkitc

# "BSP SUPPORT FEATURE"
config BSP_SUPPORT_UART
    bool
    default y

config BSP_SUPPORT_GPIO
    bool
    default y

config BSP_SUPPORT_I2C
    bool
    default y

config BSP_SUPPORT_FLASH
    bool
    default y

config BSP_SUPPORT_ADC
    bool
    default y

config BSP_SUPPORT_DAC
    bool
    default y

config BSP_SUPPORT_PWM
    bool
    default y

config BSP_SUPPORT_RTC
    bool
    default y

config BSP_SUPPORT_WDG
    bool
    default y

endif
```

## platform/board/board_legacy/esp32sram/Config.in
```kconfig
config AOS_BOARD_ESP32SRAM
    bool "ESP32SRAM"
    select AOS_MCU_ESP32 if !AOS_CREATE_PROJECT
    select AOS_COMP_KERNEL_INIT if !AOS_CREATE_PROJECT
    select CONFIG_AOS_TCPIP
    help

if AOS_BOARD_ESP32SRAM
# Configurations for board board_esp32sram

# "BSP SUPPORT FEATURE"
config BSP_SUPPORT_UART
    bool
    default y

config BSP_SUPPORT_GPIO
    bool
    default y

config BSP_SUPPORT_I2C
    bool
    default y

config BSP_SUPPORT_FLASH
    bool
    default y

config BSP_SUPPORT_ADC
    bool
    default y

config BSP_SUPPORT_DAC
    bool
    default y

config BSP_SUPPORT_PWM
    bool
    default y

config BSP_SUPPORT_RTC
    bool
    default y

config BSP_SUPPORT_WDG
    bool
    default y

endif
```

## platform/board/board_legacy/esp8285/Config.in
```kconfig
config AOS_BOARD_ESP8285
    bool "ESP8285"
    select AOS_MCU_ESP8285
    select AOS_COMP_KERNEL_INIT
    select AOS_COMP_NETMGR
    help
        The ESP8285 integrates a Tensilica L106 32-bit RISC processor, which achieves extralow power consumption and reaches a maximum clock speed of 160 MHz. The Real-Time Operating System (RTOS) and Wi-Fi stack allow 80% of the processing power to be available for user application programming and development.

if AOS_BOARD_ESP8285
# Configurations for board esp8285

# "BSP SUPPORT FEATURE"
config BSP_SUPPORT_UART
    bool
    default y

config BSP_SUPPORT_GPIO
    bool
    default y

config BSP_SUPPORT_FLASH
    bool
    default y

config BSP_SUPPORT_BLE
    bool
    default y

endif
```

## platform/board/board_legacy/evkbimxrt1050/Config.in
```kconfig
config AOS_BOARD_EVKBIMXRT1050
    bool "EVKBIMXRT1050"
    select AOS_MCU_MIMXRT1052IMP if !AOS_CREATE_PROJECT
    select AOS_COMP_KERNEL_INIT if !AOS_CREATE_PROJECT
    select CONFIG_NO_TCPIP
    help

if AOS_BOARD_EVKBIMXRT1050
# Configurations for board evkbimxrt1050

# "BSP SUPPORT FEATURE"
config BSP_SUPPORT_UART
    bool
    default y

config BSP_SUPPORT_FLASH
    bool
    default y

endif
```

## platform/board/board_legacy/evkmimxrt1020/Config.in
```kconfig
config AOS_BOARD_EVKMIMXRT1020
    bool "EVKMIMXRT1020"
    select CONFIG_NO_TCPIP
    select AOS_MCU_MIMXRT1021IMPL
    select AOS_COMP_KERNEL_INIT
    help

if AOS_BOARD_EVKMIMXRT1020
# Configurations for board evkmimxrt1020

# "BSP SUPPORT FEATURE"
config BSP_SUPPORT_UART
    bool
    default y

config BSP_SUPPORT_FLASH
    bool
    default y

endif
```

## platform/board/board_legacy/fm33a0xx-discovery/Config.in
```kconfig
config AOS_BOARD_FM33A0XX_DISCOVERY
    bool "FM33A0XX_Discovery"
    select AOS_MCU_FM33A0XX if !AOS_CREATE_PROJECT
    select AOS_COMP_NEWLIB_STUB if !AOS_CREATE_PROJECT
    select AOS_COMP_KERNEL_INIT if !AOS_CREATE_PROJECT
    select CONFIG_NO_TCPIP
    help

if AOS_BOARD_FM33A0XX_DISCOVERY
# Configurations for board fm33a0xx-discovery
endif
```

## platform/board/board_legacy/frdmkl26z/Config.in
```kconfig
config AOS_BOARD_FRDMKL26Z
    bool "FRDMKL26Z"
    select AOS_MCU_MKL26Z4IMPL
    select AOS_COMP_KERNEL_INIT
    select CONFIG_NO_TCPIP
    help

if AOS_BOARD_FRDMKL26Z
# Configurations for board frdmkl26z

# "BSP SUPPORT FEATURE"
config BSP_SUPPORT_UART
    bool
    default y

config BSP_SUPPORT_FLASH
    bool
    default y

endif
```

## platform/board/board_legacy/frdmkl27z/Config.in
```kconfig
config AOS_BOARD_FRDMKL27Z
    bool "FRDMKL27Z"
    select AOS_MCU_MKL27Z644IMPL
    select AOS_COMP_KERNEL_INIT
    select CONFIG_NO_TCPIP
    help

if AOS_BOARD_FRDMKL27Z
# Configurations for board frdmkl27z

# "BSP SUPPORT FEATURE"
config BSP_SUPPORT_UART
    bool
    default y

config BSP_SUPPORT_FLASH
    bool
    default y

endif
```

## platform/board/board_legacy/frdmkl28z/Config.in
```kconfig
config AOS_BOARD_FRDMKL28Z
    bool "FRDMKL28Z"
    select AOS_MCU_MKL28Z7IMPL if !AOS_CREATE_PROJECT
    select AOS_COMP_KERNEL_INIT if !AOS_CREATE_PROJECT
    select CONFIG_NO_TCPIP
    help

if AOS_BOARD_FRDMKL28Z
# Configurations for board frdmkl28z
endif
```

## platform/board/board_legacy/frdmkl43z/Config.in
```kconfig
config AOS_BOARD_FRDMKL43Z
    bool "FRDMKL43Z"
    select AOS_MCU_MKL43Z4IMPL
    select AOS_COMP_KERNEL_INIT
    select CONFIG_NO_TCPIP
    help

if AOS_BOARD_FRDMKL43Z
# Configurations for board frdmkl43z

# "BSP SUPPORT FEATURE"
config BSP_SUPPORT_UART
    bool
    default y

config BSP_SUPPORT_FLASH
    bool
    default y

endif
```

## platform/board/board_legacy/frdmkl81z/Config.in
```kconfig
config AOS_BOARD_FRDMKL81Z
    bool "FRDMKL81Z"
    select AOS_MCU_MKL81Z7IMPL if !AOS_CREATE_PROJECT
    select AOS_COMP_KERNEL_INIT if !AOS_CREATE_PROJECT
    select CONFIG_NO_TCPIP
    help

if AOS_BOARD_FRDMKL81Z
# Configurations for board frdmkl81z

# "BSP SUPPORT FEATURE"
config BSP_SUPPORT_UART
    bool
    default y

config BSP_SUPPORT_FLASH
    bool
    default y

endif
```

## platform/board/board_legacy/frdmkl82z/Config.in
```kconfig
config AOS_BOARD_FRDMKL82Z
    bool "FRDMKL82Z"
    select AOS_MCU_MKL82Z7IMPL if !AOS_CREATE_PROJECT
    select AOS_COMP_KERNEL_INIT if !AOS_CREATE_PROJECT
    select CONFIG_NO_TCPIP
    help

if AOS_BOARD_FRDMKL82Z
# Configurations for board frdmkl82z

# "BSP SUPPORT FEATURE"
config BSP_SUPPORT_UART
    bool
    default y

config BSP_SUPPORT_FLASH
    bool
    default y

endif
```
