/* This file is generated by nds_ldsag (version (2015-08-19) ). */
/* #include "layout_flash_ilm_dlm.lds.S" */

MEMORY
{
    SRAM_ILM    (RWX)   : ORIGIN = 0x00000000, LENGTH = (64K-3K)
    OTA_ILM     (RWX)   : ORIGIN = (0x00010000-3K), LENGTH = 3K
#if defined(FPGAv3) || defined(ASICv2)
    #if defined(NO_ROM)
        SRAM_DLM    (RW)    : ORIGIN = 0x00100000, LENGTH = 128K
    #else
        SRAM_DLM    (RW)    : ORIGIN = 0x00100000, LENGTH = (128K-10K)
    #endif
#else
/*    SRAM        (RWX)   : ORIGIN = 0x000F8000, LENGTH = 32K*/
    #if defined(NO_ROM)
        SRAM_DLM    (RW)    : ORIGIN = 0x000f8000, LENGTH = 64K + 32K
    #else
        SRAM_DLM    (RW)    : ORIGIN = 0x00100000, LENGTH = (64K-10K)
    #endif
#endif
    RENT_SRAM   (RWX)   : ORIGIN = 0x00200000, LENGTH = 8K
#if !defined(LDS_FLASH_SIZE)
#define LDS_FLASH_SIZE     (512K)
#endif
    FLASH       (RX)    : ORIGIN = 0x30000000, LENGTH = SETTING_FLASH_TOTAL_SIZE
}

REGION_ALIAS("REGION_TEXT_FAST" , SRAM_ILM);
REGION_ALIAS("REGION_OTA_FAST" , OTA_ILM);
REGION_ALIAS("REGION_TEXT_SLOW" , FLASH);
REGION_ALIAS("REGION_BURN", FLASH);
REGION_ALIAS("REGION_DATA"      , SRAM_DLM);
#if !defined(FPGAv3) && !defined(ASICv2)
/*REGION_ALIAS("REGION_DATA_SLOW"      , SRAM);*/
#endif
REGION_ALIAS("REGION_DATA_FAST"      , SRAM_DLM);
REGION_ALIAS("REGION_BSS"       , SRAM_DLM);
REGION_ALIAS("REGION_LPRAM"     , RENT_SRAM);

#define M_VMA_AT(section)  AT (ALIGN(LOADADDR(section) + SIZEOF(section), 4) )
#define M_VMA_AT_START(section)  AT (ALIGN(LOADADDR(section) + SIZEOF(section), 4) )
#define M_BOOT_SECTOR_SIZE      16K
#define M_FLASH_SECTOR_SIZE     4K
#define M_RAW_SECTOR_SIZE     	8K
#define M_N10_LOOP              0xD500

/* CONFIG IN FLASH HEADER */
#if !defined(XTAL)
#define XTAL 25
#endif
#if !defined(SYS_BUS_SPEED)
#define SYS_BUS_SPEED 80
#endif
#if !defined(XIP_BIT)
#define XIP_BIT 1
#endif
#if !defined(SETTING_PARTITION_MAIN_SIZE)
#define SETTING_PARTITION_MAIN_SIZE 620K
#endif
#if !defined(SETTING_FLASH_TOTAL_SIZE)
#define SETTING_FLASH_TOTAL_SIZE 2M
#endif
#if !defined(SETTING_PSRAM_HEAP_BASE)
#define SETTING_PSRAM_HEAP_BASE 0x0
#endif
#if !defined(SETTING_PSRAM_HEAP_SIZE)
#define SETTING_PSRAM_HEAP_SIZE 0x0
#endif


ENTRY(_start)
EXTERN(retention_boot)
EXTERN(OTA_BOOT)
EXTERN(g_sa_cfg)
EXTERN(g_wifi_cfg)
EXTERN(g_user_cfg)
SECTIONS
{
	_SDA_BASE_ = 0x00100000;
    PROVIDE (__executable_start = 0x00000000);
    NDS_SAG_LMA_ROM = 0x30000000 ;
    FLASH_BEGIN = NDS_SAG_LMA_ROM;
    . = ORIGIN(REGION_BURN);
    .ota_boot :
    {
         __ota_boot_addr = .;
         KEEP(*(.ota_boot_hdr))
         . = ALIGN(4);
         LONG(XTAL);
         . = ALIGN(4);
         LONG(SYS_BUS_SPEED);
         . = ALIGN(4);
         LONG(XIP_BIT);
         . = ALIGN(4);
         LONG(SETTING_PARTITION_MAIN_SIZE);
         . = ALIGN(4);
         LONG(SETTING_FLASH_TOTAL_SIZE);
         . = ALIGN(4);
         LONG(SETTING_PSRAM_HEAP_BASE);
         . = ALIGN(4);
         LONG(SETTING_PSRAM_HEAP_SIZE);
         . = ALIGN(4);
         KEEP(*(.ota_boot))
         #ifdef CONFIG_OS_RHINO
         KEEP(*bootloader.a:*.o (.text.* .rodata.*))
         #else
         KEEP(*libota_boot.a:*.o (.text.* .rodata.*))
         #endif
         . = ALIGN(4);
    } > REGION_BURN
	__ota_fast_boot_lmastart = LOADADDR (.ota_fast_boot_code);
    __ota_fast_boot_start = ADDR(.ota_fast_boot_code);
    .ota_fast_boot_code : M_VMA_AT(.ota_boot)
    {
    	KEEP(*(.ota_fast_boot_code))
    	KEEP(*(.ota_fast_boot_data))
    } > REGION_OTA_FAST
    . = ALIGN(4);
    __ota_fast_boot_end = .;
    .empty : {
        FILL(0xD500);
        . = ORIGIN(REGION_BURN) + 0x3000;
        __lds_reserved_start = .;
        . = ORIGIN(REGION_BURN) + M_BOOT_SECTOR_SIZE;
    } > REGION_BURN
    .fix_table_section :
    {
         __lds_sa_mp_data_start = .;
         KEEP(*(.sa_mp_data))
         __lds_sa_mp_data_end = .;
         . = ORIGIN(REGION_BURN) + M_BOOT_SECTOR_SIZE + M_FLASH_SECTOR_SIZE;

         __lds_cfg_data_start = .;
         KEEP(*(.cfg_mac_data))
         __lds_cfg_data_end = .;
         . = ORIGIN(REGION_BURN) + M_BOOT_SECTOR_SIZE + M_FLASH_SECTOR_SIZE + M_FLASH_SECTOR_SIZE;

         __lds_user_data_start = .;
         KEEP(*(.user_data))
         __lds_user_data_end = .;
         . = ORIGIN(REGION_BURN) + M_BOOT_SECTOR_SIZE + M_FLASH_SECTOR_SIZE + M_FLASH_SECTOR_SIZE + M_RAW_SECTOR_SIZE;
    } > REGION_BURN
    
    .magic_boot :
    {
        __magic_boot_addr = .;
         KEEP(*(.magic_boot_hdr ))
         KEEP(*(.magic_boot ))
         KEEP(*(.magic_boot_c ))
    } > REGION_BURN

    .text :
    {
        . = ALIGN(4);
        __XIP_TEXT_START = .;
        #if defined(SETTING_THROUGHPUT_HIGH)
			*(.text .stub EXCLUDE_FILE (*libota_boot.a:*.o *libsrm_sys.a:*flash.o *libflashctl.a:*flashctl.o *libfreertos.a:*queue.o *libfreertos.a:*list.o *libfreertos.a:*tasks.o *libfreertos.a:*port.o *libfreertos.a:*portISR.o *osal_freertos.o *heap_5.o *sys_arch.o *api_msg.o *edca.o) .text.* .gnu.linkonce.t.* ) KEEP(*(.text.*personality* )) *(.gnu.warning )
    	#else
			#ifdef CONFIG_OS_RHINO
			*(.text .stub EXCLUDE_FILE (*bootloader.a:*.o *sys.a:*flash.o *sys.a:*xip.o) .text.* .gnu.linkonce.t.* ) KEEP(*(.text.*personality* )) *(.gnu.warning )
			#else
			*(.text .stub EXCLUDE_FILE (*libota_boot.a:*.o *libsrm_sys.a:*flash.o *libflashctl.a:*flashctl.o *sys_arch.o *api_msg.o *edca.o) .text.* .gnu.linkonce.t.* ) KEEP(*(.text.*personality* )) *(.gnu.warning )
			#endif
    	#endif
         . = ALIGN(4);
         __XIP_TEXT_END = .;
    } > REGION_BURN
    . = ALIGN(4);
    PROVIDE (__etext = .);
    PROVIDE (_etext = .);
    PROVIDE (etext = .);
    .rodata :
    {
    	#if defined(SETTING_THROUGHPUT_HIGH)
			#ifdef MBED_RO_TURN			
			*(.rodata EXCLUDE_FILE (*libota_boot.a:*.o *libsrm_sys.a:*flash.o *libflashctl.a:*flashctl.o *libfreertos.a:*queue.o *libfreertos.a:*list.o *libfreertos.a:*tasks.o *libfreertos.a:*port.o *libfreertos.a:*portISR.o *osal_freertos.o *heap_5.o *sys_arch.o *api_msg.o *edca.o *libmbedtls.a:*aes.o *libmbedtls.a:*sha512.o *libmbedtls.a:*bignum.o  *libmbedtls.a:*gcm.o) .rodata.* .gnu.linkonce.r.* )
			#else
			*(.rodata EXCLUDE_FILE (*libota_boot.a:*.o *libsrm_sys.a:*flash.o *libflashctl.a:*flashctl.o *libfreertos.a:*queue.o *libfreertos.a:*list.o *libfreertos.a:*tasks.o *libfreertos.a:*port.o *libfreertos.a:*portISR.o *osal_freertos.o *heap_5.o *sys_arch.o *api_msg.o *edca.o) .rodata.* .gnu.linkonce.r.* )
			#endif
    	#else
			#ifdef CONFIG_OS_RHINO
			*(.rodata EXCLUDE_FILE (*bootloader.a:*.o *sys.a:*flash.o *sys.a:*xip.o) .rodata.* .gnu.linkonce.r.* )
			#else
			*(.rodata EXCLUDE_FILE (*libota_boot.a:*.o *libsrm_sys.a:*flash.o *libflashctl.a:*flashctl.o *sys_arch.o *api_msg.o *edca.o) .rodata.* .gnu.linkonce.r.* )
			#endif
    	#endif
    } > REGION_BURN
    .rodata1 :
    {
         *(.rodata1 ) 
    } > REGION_BURN
    .sdata2 :
    {
         *(.sdata2 .sdata2.* .gnu.linkonce.s2.* ) 
    } > REGION_BURN
    .sbss2 :
    {
         *(.sbss2 .sbss2.* .gnu.linkonce.sb2.* ) 
    } > REGION_BURN
    .ex9.itable : 
    {
         *(.ex9.itable ) 
    } > REGION_BURN
    .eh_frame_hdr :
    {
         *(.eh_frame_hdr ) 
    } > REGION_BURN
    . = 0x00000000;
    SDRAM_BEGIN = .;
    __flash_lmastart = LOADADDR (.vector);
    __flash_start = ADDR(.vector);
    .vector : M_VMA_AT(.eh_frame_hdr)
    {
         KEEP(*(.vector ))
    } > REGION_TEXT_FAST
    .nds32_init : M_VMA_AT(.vector)
    {
         KEEP(*(.nds32_init )) 
    } > REGION_TEXT_FAST
    .fast_boot_code : M_VMA_AT(.nds32_init)
    {
         KEEP(*(.fast_boot_code))
         #ifdef CONFIG_OS_RHINO
         KEEP(*sys.a:*flash.o (.text.* .rodata.*))
         KEEP(*sys.a:*xip.o (.text.* .rodata.*))
         #else
         KEEP(*libsrm_sys.a:*flash.o (.text.* .rodata.*))
         KEEP(*libflashctl.a:*flashctl.o (.text.* .rodata.*))
         #endif
    } > REGION_TEXT_FAST
    .rela.text : M_VMA_AT(.fast_boot_code)
    {
         *(.rela.text .rela.text.* .rela.gnu.linkonce.t.* ) 
    } > REGION_TEXT_FAST
    .rela.dyn : M_VMA_AT(.rela.text)
    {
         *(rela.dyn ) *(.rela__libc_subfreeres ) *(.rela__libc_atexit ) *(.rela__libc_thread_subfreeres ) *(.rela.init_array ) *(.rela.fini_array ) 
    } > REGION_TEXT_FAST
    . = ALIGN(4);
    _fast_code_end = .;
    PROVIDE (_fast_code_end = .);
    __flash_psram_lmastart = LOADADDR(.prog_in_sram);
    __flash_psram_start = ADDR(.prog_in_sram);
    __flash_end = ADDR(.prog_in_sram);
    .prog_in_sram : M_VMA_AT(.rela.dyn)
    {
		KEEP(*sys_arch.o (.text.* .rodata.*))
		KEEP(*api_msg.o (.text.* .rodata.*))*/
		KEEP(*edca.o (.text.* .rodata.*))
#if defined(SETTING_THROUGHPUT_HIGH)
	#ifdef CONFIG_OS_ALIOS
	#else
		KEEP(*libfreertos.a:*queue.o (.text.* .rodata.*))
		KEEP(*libfreertos.a:*list.o (.text.* .rodata.*))
		KEEP(*libfreertos.a:*tasks.o (.text.* .rodata.*))
		KEEP(*libfreertos.a:*port.o (.text.* .rodata.*))
		KEEP(*libfreertos.a:*portISR.o (.text.* .rodata.*))
		KEEP(*osal_freertos.o (.text.* .rodata.*)) 
		KEEP(*heap_5.o (.text.* .rodata.*))
		#ifdef MBED_RO_TURN	
		KEEP(*libmbedtls.a:*aes.o (.rodata.*))
		KEEP(*libmbedtls.a:*sha512.o (.rodata.*))
		KEEP(*libmbedtls.a:*bignum.o (.rodata.*))
		KEEP(*libmbedtls.a:*gcm.o (.rodata.*))
		#endif
	#endif
#endif
/*		KEEP(*netstack.o (.text.* .rodata.*))
		KEEP(*ethernetif.o (.text.* .rodata.*))
		KEEP(*tcpip.o (.text.* .rodata.*))
		KEEP(*ip4.o (.text.* .rodata.*))
		KEEP(*tcp_in.o (.text.* .rodata.*))
		KEEP(*udp.o (.text.* .rodata.*))
		KEEP(*tcp_out.o (.text.* .rodata.*))
		KEEP(*etharp.o (.text.* .rodata.*))
		KEEP(*inet_chksum.o (.text.* .rodata.*))
		KEEP(*sys_arch.o (.text.* .rodata.*))
		KEEP(*netif.o (.text.* .rodata.*))
		KEEP(*def.o (.text.* .rodata.*))
		KEEP(*lwip_pbuf.o (.text.* .rodata.*))*/
		*(.copy_to_sram .copy_to_sram.*)
        *(.prog_in_sram .prog_in_sram.*)
    } > REGION_TEXT_FAST
    _eflash = .;
    PROVIDE (eflash = .);
    ilm_end = ORIGIN(OTA_ILM)+LENGTH(OTA_ILM);
    ilm_remain = ilm_end - _eflash;
    __retention_code_lmastart = LOADADDR(.retention_boot);
    __retention_code_start = ADDR(.retention_boot);
    .retention_boot : M_VMA_AT(.prog_in_sram)
    {
         KEEP(*(.retention_boot ))
    } > REGION_LPRAM
    __retention_code_end = .;
    PROVIDE (retention_code_end = .);
    __data_lmastart =  LOADADDR (.eh_frame);
    __data_start = ADDR(.eh_frame);
    .eh_frame : AT(ALIGN(LOADADDR (.retention_boot) + SIZEOF (.retention_boot), 32))
    {
        KEEP(*(.eh_frame ))
    } > REGION_DATA_FAST
    .gcc_except_table : AT(ALIGN(LOADADDR (.eh_frame) + SIZEOF (.eh_frame), ALIGNOF(.gcc_except_table)))
    {
        KEEP(*(.gcc_except_table )) *(.gcc_except_table.* )
    } > REGION_DATA_FAST
    .tdata : AT(ALIGN(LOADADDR (.gcc_except_table) + SIZEOF (.gcc_except_table), ALIGNOF(.tdata)))
    {
        *(.tdata .tdata.* .gnu.linkonce.td.* )
    } > REGION_DATA_FAST
    . = ALIGN(4);
    PROVIDE (__preinit_array_start = .);
    .preinit_array : AT(ALIGN(ALIGN(LOADADDR (.tdata) + SIZEOF (.tdata), ALIGNOF(.preinit_array)), 4))
    {
        KEEP(*(.preinit_array ))
    } > REGION_DATA_FAST
    PROVIDE (__preinit_array_end = .);
    PROVIDE (__init_array_start = .);
    .init_array : AT(ALIGN(LOADADDR (.preinit_array) + SIZEOF (.preinit_array), ALIGNOF(.init_array)))
    {
        KEEP(*(.init_array ))
    } > REGION_DATA_FAST
    PROVIDE (__init_array_end = .);
    PROVIDE (__fini_array_start = .);
    .fini_array : AT(ALIGN(LOADADDR (.init_array) + SIZEOF (.init_array), ALIGNOF(.fini_array)))
    {
        KEEP(*(.fini_array ))
    } > REGION_DATA_FAST
    PROVIDE (__fini_array_end = .);
    .ctors : AT(ALIGN(LOADADDR (.fini_array) + SIZEOF (.fini_array), ALIGNOF(.ctors)))
    {
        KEEP(*crtbegin*.o(.ctors)) KEEP(*(EXCLUDE_FILE (*crtend*.o) .ctors)) KEEP(*(SORT(.ctors.* ))) KEEP(*(.ctors ))
    } > REGION_DATA_FAST
    .dtors : AT(ALIGN(LOADADDR (.ctors) + SIZEOF (.ctors), ALIGNOF(.dtors)))
    {
        KEEP(*crtbegin*.o(.dtors)) KEEP(*(EXCLUDE_FILE (*crtend*.o) .dtors)) KEEP(*(SORT(.dtors.* ))) KEEP(*(.dtors ))
    } > REGION_DATA_FAST
    .jcr : AT(ALIGN(LOADADDR (.dtors) + SIZEOF (.dtors), ALIGNOF(.jcr)))
    {
        KEEP(*(.jcr ))
    } > REGION_DATA_FAST
    .data.rel.ro : AT(ALIGN(LOADADDR (.jcr) + SIZEOF (.jcr), ALIGNOF(.data.rel.ro)))
    {
        *(.data.rel.ro.local ) *(.data.rel.ro* )
    } > REGION_DATA_FAST
    .dynamic : AT(ALIGN(LOADADDR (.data.rel.ro) + SIZEOF (.data.rel.ro), ALIGNOF(.dynamic)))
    {
        *(.dynamic )
    } > REGION_DATA_FAST
    .data : AT(ALIGN(LOADADDR (.dynamic) + SIZEOF (.dynamic), ALIGNOF(.data)))
    {
        *(.data .data.* .gnu.linkonce.d.* ) KEEP(*(.gnu.linkonce.d.*personality* )) SORT(CONSTRUCTORS) . = ALIGN(8);
    } > REGION_DATA_FAST
    .data1 : AT(ALIGN(LOADADDR (.data) + SIZEOF (.data), ALIGNOF(.data1)))
    {
        *(.data1 ) . = ALIGN(8);
    } > REGION_DATA_FAST
    . = ALIGN(4);
    .got : AT(ALIGN(ALIGN(LOADADDR (.data1) + SIZEOF (.data1), ALIGNOF(.got)), 4))
    {
        *(.got.plt ) *(.got )
    } > REGION_DATA_FAST
    .sdata_d : AT(ALIGN(LOADADDR (.got) + SIZEOF (.got), ALIGNOF(.sdata_d)))
    {
        *(.sdata_d .sdata_d.* )
    } > REGION_DATA_FAST
    .sdata_w : AT(ALIGN(LOADADDR (.sdata_d) + SIZEOF (.sdata_d), ALIGNOF(.sdata_w)))
    {
        *(.sdata_w .sdata_w.* )
    } > REGION_DATA_FAST
    .sdata_h : AT(ALIGN(LOADADDR (.sdata_w) + SIZEOF (.sdata_w), ALIGNOF(.sdata_h)))
    {
        *(.sdata_h .sdata_h.* )
    } > REGION_DATA_FAST
    .sdata_b : AT(ALIGN(LOADADDR (.sdata_h) + SIZEOF (.sdata_h), ALIGNOF(.sdata_b)))
    {
        *(.sdata_b .sdata_b.* )
    } > REGION_DATA_FAST
    .sdata_f : AT(ALIGN(LOADADDR (.sdata_b) + SIZEOF (.sdata_b), ALIGNOF(.sdata_f)))
    {
        *(.sdata_f .sdata_f.* )
    } > REGION_DATA_FAST
    . = ALIGN(4);
    _edata = .;
    PROVIDE (edata = .);
    __check_main_size = LOADADDR(.sdata_f) + SIZEOF(.sdata_f) - ORIGIN(REGION_BURN);
    __bss_start = .;
    PROVIDE (__sbss_start = .);
    PROVIDE (___sbss_start = .);
    .tbss : AT(ALIGN(ALIGN(LOADADDR (.sdata_f) + SIZEOF (.sdata_f), ALIGNOF(.tbss)), 4))
    {
        *(.tbss .tbss.* .gnu.linkonce.tb.* ) *(.tcommon )
    } > REGION_DATA_FAST
    .sbss_f : AT(ALIGN(LOADADDR (.tbss) + SIZEOF (.tbss), ALIGNOF(.sbss_f)))
    {
        *(.sbss_f .sbss_f.* ) *(.scommon_f .scommon_f.* )
    } > REGION_DATA_FAST
    .sbss_b : AT(ALIGN(LOADADDR (.sbss_f) + SIZEOF (.sbss_f), ALIGNOF(.sbss_b)))
    {
        *(.sbss_b .sbss_b.* ) *(.scommon_b .scommon_b.* ) . = ALIGN(2);
    } > REGION_DATA_FAST
    .sbss_h : AT(ALIGN(LOADADDR (.sbss_b) + SIZEOF (.sbss_b), ALIGNOF(.sbss_h)))
    {
        *(.sbss_h .sbss_h.* ) *(.scommon_h .scommon_h.* ) . = ALIGN(4);
    } > REGION_DATA_FAST
    .sbss_w : AT(ALIGN(LOADADDR (.sbss_h) + SIZEOF (.sbss_h), ALIGNOF(.sbss_w)))
    {
        *(.sbss_w .sbss_w.* ) *(.scommon_w .scommon_w.* ) *(.dynsbss ) *(.scommon ) . = ALIGN(8);
    } > REGION_DATA_FAST
    .sbss_d : AT(ALIGN(LOADADDR (.sbss_w) + SIZEOF (.sbss_w), ALIGNOF(.sbss_d)))
    {
        *(.sbss_d .sbss_d.* ) *(.scommon_d .scommon_d.* )
    } > REGION_DATA_FAST
    .bss : AT(ALIGN(LOADADDR (.sbss_d) + SIZEOF (.sbss_d), ALIGNOF(.bss)))
    {
        *(.dynbss ) *(.bss .bss.* .gnu.linkonce.b.* ) *(COMMON ) . = ALIGN(4);
    } > REGION_DATA_FAST
    PROVIDE (__sbss_end = .);
    PROVIDE (___sbss_end = .);
    . = ALIGN(32);
    _end = .;
    PROVIDE (end = .);
    _show_dlm_end = .;
    PROVIDE (_show_dlm_end = .);

#ifndef MINIMAL_STACK_SIZE
#define MINIMAL_STACK_SIZE            (128)
#endif
#define _INT_STACK_SIZE     (2048+256)
#define _EXCEPTION_STACK_SIZE     (768)
    PROVIDE (_stack = ORIGIN(REGION_DATA_FAST)+LENGTH(REGION_DATA_FAST));
	__OS_Exception_Stack = _stack;
    __OS_Int_Stack = __OS_Exception_Stack - (_EXCEPTION_STACK_SIZE);
    __fence__ = __OS_Int_Stack - (_INT_STACK_SIZE);
    dlm_remain = __fence__ - _end;
    SDRAM_SIZE = . - SDRAM_BEGIN;
    FLASH_SIZE = LOADADDR(.tbss) - FLASH_BEGIN;

    .stab 0 :
    {
         *(.stab) 
    }
    .stabstr 0 :
    {
         *(.stabstr) 
    }
    .stab.excl 0 :
    {
         *(.stab.excl) 
    }
    .stab.exclstr 0 :
    {
         *(.stab.exclstr) 
    }
    .stab.index 0 :
    {
         *(.stab.index) 
    }
    .stab.indexstr 0 :
    {
         *(.stab.indexstr) 
    }
    .note.nds32 0 :
    {
         *(.note.nds32) *(.note.nds32.*) 
    }
    .comment 0 :
    {
         *(.comment) 
    }
    .debug 0 :
    {
         *(.debug) 
    }
    .line 0 :
    {
         *(.line) 
    }
    .debug_srcinfo 0 :
    {
         *(.debug_srcinfo) 
    }
    .debug_sfnames 0 :
    {
         *(.debug_sfnames) 
    }
    .debug_aranges 0 :
    {
         *(.debug_aranges) 
    }
    .debug_pubnames 0 :
    {
         *(.debug_pubnames) 
    }
    .debug_info 0 :
    {
         *(.debug_info .gnu.linkonce.wi.*) 
    }
    .debug_abbrev 0 :
    {
         *(.debug_abbrev) 
    }
    .debug_line 0 :
    {
         *(.debug_line) 
    }
    .debug_frame 0 :
    {
         *(.debug_frame) 
    }
    .debug_str 0 :
    {
         *(.debug_str) 
    }
    .debug_loc 0 :
    {
         *(.debug_loc) 
    }
    .debug_macinfo 0 :
    {
         *(.debug_macinfo) 
    }
    .debug_weaknames 0 :
    {
         *(.debug_weaknames) 
    }
    .debug_funcnames 0 :
    {
         *(.debug_funcnames) 
    }
    .debug_typenames 0 :
    {
         *(.debug_typenames) 
    }
    .debug_varnames 0 :
    {
         *(.debug_varnames) 
    }
}

ASSERT(((_fast_code_end - __flash_start) <= 8K), "FASTBOOT OVERFLOW");
ASSERT(((_eflash - __flash_psram_start + _fast_code_end - __flash_start) <= LENGTH(REGION_TEXT_FAST)), "ILM OVERFLOW");
ASSERT(((__ota_fast_boot_end - __ota_fast_boot_start) <= LENGTH(REGION_OTA_FAST)), "OTA FASTBOOT OVERFLOW");
ASSERT(((_edata - __data_start) <= LENGTH(REGION_DATA_FAST)), "DLM OVERFLOW");
ASSERT(((SIZEOF(.ota_fast_boot_code)+SIZEOF(.ota_boot)) <= 16K),"boot sector overflow");
ASSERT(((__lds_sa_mp_data_end - __lds_sa_mp_data_start) <= M_FLASH_SECTOR_SIZE),"sa mp table overflow");
ASSERT(((__lds_cfg_data_end - __lds_cfg_data_start) <= M_FLASH_SECTOR_SIZE),"cfg data table overflow");
ASSERT(((__lds_user_data_end - __lds_user_data_start) <= M_RAW_SECTOR_SIZE),"user data table overflow");

ASSERT((__check_main_size<=SETTING_PARTITION_MAIN_SIZE), "main partition size overflow");

#if !defined(NO_ROM)
#include "rom_symbol.sym"
#endif
