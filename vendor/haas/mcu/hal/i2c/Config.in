## vendor/haas/mcu/hal/i2c/Config.in
```kconfig
config AOS_MCU_V_I2C_DRV
    select AOS_MCU_V_COMMON_DRV
    select AOS_MCU_V_REG_DRV
    select AOS_BOARD_V_PARTITION_DRV
    bool "aos_mci_v_i2c_drv"
    help
        i2c haas1000.
```

## vendor/haas/mcu/hal/pwm/Config.in
```kconfig
config AOS_MCU_V_PWM_DRV
    select AOS_MCU_V_COMMON_DRV
    select AOS_MCU_V_REG_DRV
    select AOS_BOARD_V_PARTITION_DRV
    bool "aos_mcu_v_pwm_drv"
    help
        pwm haas1000.
```

## vendor/haas/mcu/hal/regs/Config.in
```kconfig
config AOS_MCU_V_REG_DRV
    bool "aos_mcu_v_reg_drv"
    help
        register map function on haas1000.
```

## vendor/haas/mcu/hal/sd/Config.in
```kconfig
config AOS_MCU_V_SD_DRV
    bool "aos_mcu_v_sd_drv"
    help
        i2c haas1000.
```

## vendor/haas/mcu/hal/spi/Config.in
```kconfig
config AOS_MCU_V_SPI_DRV
    select AOS_MCU_V_COMMON_DRV
    select AOS_MCU_V_REG_DRV
    select AOS_BOARD_V_PARTITION_DRV
    bool "aos_mcu_v_spi_drv"
    help
        spi haas1000.
```

## vendor/haas/mcu/hal/uart/Config.in
```kconfig
config AOS_MCU_V_UART_DRV
    select AOS_MCU_V_COMMON_DRV
    select AOS_MCU_V_REG_DRV
    select AOS_BOARD_V_PARTITION_DRV
    bool "aos_mcu_v_uart_drv"
    help
        uart haas1000.
```

## vendor/haas/mcu/hal/ubase/Config.in
```kconfig
config AOS_MCU_V_UBASE_DRV
    bool "v_ubase_drv"
    help
        ubase haas1000.
```

## vendor/haas/mcu/hal/wifi/Config.in
```kconfig
config AOS_MCU_V_WIFI_DRV
    bool "aos_mcu_v_wifi_drv"
    select AOS_MCU_V_UBASE_DRV
    select AOS_MCU_V_REG_DRV
    help
        wifi haas1000.
```

## vendor/haas/mcu/ota/Config.in
```kconfig
config AOS_MCU_OTA_ADAPT
    #select AOS_MCU_V_FLASH_DRV
    bool "aos_mcu_ota_adapt"
    help
        ota haas1000.
```
