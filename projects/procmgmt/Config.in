## projects/procmgmt/Config.in
```kconfig
config AOS_APP_PROCMGMT
    bool "process management"
    select AOS_COMP_CPLUSPLUS
    select AOS_COMP_VFS
    select AOS_COMP_CLI
    select AOS_COMP_ULOG
    select AOS_COMP_U_RAMDRV
    select AOS_COMP_U_RAMTEST
    select AOS_COMP_U_FLASH if AOS_BOARD_HAAS100_MK
    select AOS_MCU_V_FLASH_DRV  if AOS_BOARD_HAAS100_MK
    help
        "process management"

if AOS_APP_PROCMGMT
# Configurations for process management

config RHINO_CONFIG_APP_NAME
    string "app name"
    default "procmgmt"
    help
        "set app name, it's also the first task name"

config RHINO_CONFIG_APP_VERSION
    hex "app version"
    default 0x00000001
    help
        "set app version"

config RHINO_CONFIG_APP_ENTRY_TASK_NAME
    string "app first task name"
    default "procmgmt"
    help
        "set app first task name"

config RHINO_CONFIG_APP_ENTRY_TASK_PRIO
    int "app entry task priority"
    default 5
    help
        "set app entry task priority"

config RHINO_CONFIG_APP_ENTRY_TASK_KSTACK_SIZE
    int "app entry task kstack size"
    default 4096
    help
        "set app entry task kstack size, the unit is cpu_stack_t"

config RHINO_CONFIG_APP_ENTRY_TASK_USTACK_SIZE
    int "app entry task ustack size"
    default 4096
    help
        "set app entry task ustack size, the unit is cpu_stack_t"

config RHINO_CONFIG_APP_ULOG_FS_PATH
    string "app ulog fs path"
    default "/data/syslog/uapp_helloworld1"
    help
        "set app ulog to fs path"

config RHINO_CONFIG_APP_ULOG_FS_BACKUP_PATH
    string "app ulog fs backup path"
    default "/data/syslog/backup/uapp_helloworld1"
    help
        "set app ulog to fs backup path"

config LFS_CONFIG_IN_PM
    bool "littlefs in PM"
    select AOS_COMP_LITTLEFS
    select AOS_COMP_IOBOX
    default y
    help
        "set littlefs component in PM process"

source "kernel/core/mk/uspace/Config.in"

endif
```

## projects/uapp_helloworld2/Config.in
```kconfig
config AOS_APP_UAPP_HELLOWORLD2
    bool "uapp_helloworld2_test"
    help
        "user space app"

if AOS_APP_UAPP_HELLOWORLD2
# Configurations for app helloworld2

config RHINO_CONFIG_APP_NAME
    string "app name"
    default "uapp_helloworld_2"
    help
        "set app name, it's also the first task name"

config RHINO_CONFIG_APP_VERSION
    hex "app version"
    default 0x00000001
    help
        "set app version"

config RHINO_CONFIG_APP_ENTRY_TASK_NAME
    string "app first task name"
    default "uapp_helloworld_2"
    help
        "set app first task name"

config RHINO_CONFIG_APP_ENTRY_TASK_PRIO
    int "app entry task priority"
    default 20
    help
        "set app entry task priority"

config RHINO_CONFIG_APP_ENTRY_TASK_KSTACK_SIZE
    int "app entry task kstack size"
    default 4096
    help
        "set app entry task kstack size, the unit is cpu_stack_t"

config RHINO_CONFIG_APP_ENTRY_TASK_USTACK_SIZE
    int "app entry task ustack size"
    default 4096
    help
        "set app entry task ustack size, the unit is cpu_stack_t"

config RHINO_CONFIG_APP_ULOG_FS_PATH
    string "app ulog fs path"
    default "/data/syslog/uapp_helloworld2"
    help
        "set app ulog to fs path"

config RHINO_CONFIG_APP_ULOG_FS_BACKUP_PATH
    string "app ulog fs backup path"
    default "/data/syslog/backup/uapp_helloworld2"
    help
        "set app ulog to fs backup path"

source "kernel/core/mk/uspace/Config.in"

endif
```

## projects/ulwip_service/Config.in
```kconfig
config AOS_APP_ULWIP_SERVICE
    bool "ulwip_service"
    select AOS_COMP_ULOG
    select AOS_COMP_VFS
    select AOS_COMP_CPLUSPLUS
    select AOS_COMP_LWIP
    select AOS_COMP_NETMGR
    select AOS_COMP_NETMGR_RPC
    select AOS_MCU_V_WIFI_DRV if AOS_BOARD_HAAS100_MK
    select AOS_COMP_WIFIDEV
    select AOS_COMP_HTTP
    select CONFIG_NEW_HTTP_API
    select AOS_COMP_USERVICE
    select AOS_COMP_MBEDTLS
    select AOS_COMP_LINK_SDK if AOS_BOARD_HAAS100_MK
    select AOS_COMP_SNTP if AOS_BOARD_HAAS100_MK
    select AOS_COMP_CLI
    select AOS_COMP_ACTIVATION if AOS_BOARD_HAAS100_MK
    select AOS_COMP_USPACE_AOS
    select AOS_COMP_DEVICEVFS
    select AOS_MCU_V_COMMON_DRV if AOS_BOARD_HAAS100_MK
    select AOS_BOARD_V_PARTITION_DRV if AOS_BOARD_HAAS100_MK
    select SOCKET_RPC_SERVER_ENABLED
    select PING_ENABLED
    select AOS_CONFIG_USER_SPACE


    help
        "user space lwip service"

if AOS_APP_ULWIP_SERVICE
# Configurations for app ulwip_service

if AOS_MCU_VEXPRESSA9
# support uspace virtual network device
config AOS_FEATURE_NETWORK_USPACE_VEXPRESS
    bool
    default y
endif

config AOS_KERNEL_MODE
    bool
    default n

config AOS_COMP_LWIP_IN_SERVICE
    bool
    default y

config AOS_COMP_NETMGR_IN_SERVICE
    bool
    default y

config AOS_COMP_ACTIVATION_IN_SERVICE
    bool
    default y

config AOS_COMP_USERVICE_IN_SERVICE
    bool
    default y

config AOS_COMP_SNTP_IN_SERVICE
    bool
    default y

config AOS_COMP_HTTP_IN_SERVICE
    bool
    default y

config AOS_COMP_WIFIDEV_IN_SERVICE
    bool
    default y

config RHINO_CONFIG_APP_NAME
    string "app name"
    default "ulwip_service"
    help
        "set app name, it's also the first task name"

config RHINO_CONFIG_APP_VERSION
    hex "app version"
    default 0x00000001
    help
        "set app version"

config RHINO_CONFIG_APP_ENTRY_TASK_NAME
    string "app first task name"
    default "link_sdk_entry_task"
    help
        "set app first task name"

config RHINO_CONFIG_APP_ENTRY_TASK_PRIO
    int "app entry task priority"
    default 20
    help
        "set app entry task priority"

config RHINO_CONFIG_APP_ENTRY_TASK_KSTACK_SIZE
    int "app entry task kstack size"
    default 4096
    help
        "set app entry task kstack size, the unit is cpu_stack_t"

config RHINO_CONFIG_APP_ENTRY_TASK_USTACK_SIZE
    int "app entry task ustack size"
    default 10000
    help
        "set app entry task ustack size, the unit is cpu_stack_t"

config RHINO_CONFIG_APP_ULOG_FS_PATH
    string "app ulog fs path"
    default "/data/syslog/link_sdk_demo"
    help
        "set app ulog to fs path"

config RHINO_CONFIG_APP_ULOG_FS_BACKUP_PATH
    string "app ulog fs backup path"
    default "/data/syslog/backup/link_sdk_demo"
    help
        "set app ulog to fs backup path"

source "kernel/core/mk/uspace/Config.in"

endif
```

## security/Config.in
```kconfig
menu "Security    Configuration"

## --- Generated Automatically ---
source "security/ls_osa/Config.in"
source "security/ls_hal/Config.in"
source "security/alicrypto/Config.in"
source "security/dpm/Config.in"
source "security/id2/Config.in"
source "security/irot/Config.in"
source "security/irot/km/Config.in"
source "security/irot/se/Config.in"
source "security/irot/tee/Config.in"
source "security/irot/demo/Config.in"
source "security/isst/Config.in"
source "security/itls/Config.in"
source "security/mbedtls/Config.in"
source "security/prov/Config.in"
## --- End ---

endmenu
```

## security/alicrypto/Config.in
```kconfig
menuconfig AOS_COMP_ALICRYPTO
    bool "alicrypto"
    default n
    help

if AOS_COMP_ALICRYPTO
# Configurations for comp alicrypto
endif
```

## security/dpm/Config.in
```kconfig
menuconfig AOS_COMP_DPM
    bool "dpm"
    default n
    select AOS_COMP_ID2
    select AOS_COMP_ALICRYPTO
    help

if AOS_COMP_DPM
# Configurations for comp dpm
endif
```

## security/id2/Config.in
```kconfig
config AOS_COMP_ID2
    bool "Link Security ID2"
    default n
    select AOS_COMP_IROT
    select AOS_COMP_ALICRYPTO
    select AOS_COMP_LS_OSA
    help

if AOS_COMP_ID2
# Configurations for comp id2
endif
```

## security/irot/Config.in
```kconfig
config AOS_COMP_IROT
    bool "Root of Trust - MCU, SE and TEE"
    default n
    select AOS_COMP_LIBKM_SE if CONFIG_LS_KM_SE
    select AOS_COMP_LIBKM_TEE if !CONFIG_LS_KM_SE && CONFIG_LS_KM_TEE
    select AOS_COMP_LIBKM if !CONFIG_LS_KM_SE && !CONFIG_LS_KM_TEE
    help

if AOS_COMP_IROT
# Configurations for comp irot
endif
```

## security/irot/km/Config.in
```kconfig
config AOS_COMP_LIBKM
    bool "libkm"
    default n
    select AOS_COMP_LS_HAL
    select AOS_COMP_ALICRYPTO
    help

if AOS_COMP_LIBKM
# Configurations for comp libkm
endif
```

## security/irot/km/platform/Config.in
```kconfig
menuconfig AOS_COMP_LIBPLAT_GEN
    bool "libplat_gen"
    default n
    select AOS_COMP_ALICRYPTO
    help

if AOS_COMP_LIBPLAT_GEN
# Configurations for comp libplat_gen
endif
```

## security/irot/se/Config.in
```kconfig
config AOS_COMP_LIBKM_SE
    bool "se"
    default n
    help

if AOS_COMP_LIBKM_SE
# Configurations for comp se
endif
```

## security/irot/tee/Config.in
```kconfig
menuconfig AOS_COMP_LIBKM_TEE
    bool "libkm_tee"
    default n
    help

if AOS_COMP_LIBKM_TEE
# Configurations for comp libkm_tee
endif
```

## security/isst/Config.in
```kconfig
config AOS_COMP_LIBSST
    bool "Secure Storage"
    default n
    select AOS_COMP_IROT
    select AOS_COMP_ALICRYPTO
    select AOS_COMP_KV
    select AOS_COMP_LS_HAL
    help

if AOS_COMP_LIBSST
# Configurations for comp libsst
endif
```

## security/itls/Config.in
```kconfig
menuconfig AOS_COMP_ITLS
    bool "itls"
    default n
    select AOS_COMP_ID2
    select AOS_COMP_ALICRYPTO
    help

if AOS_COMP_ITLS
# Configurations for comp itls
endif
```

## security/ls_hal/Config.in
```kconfig
config AOS_COMP_LS_HAL
    bool "Link Security Hardware Interface"
    default n
    help

if AOS_COMP_LS_HAL
# Configurations for comp ls_hal
endif
```

## security/ls_osa/Config.in
```kconfig
config AOS_COMP_LS_OSA
    bool "Link Secuirty OS Interface"
    default n
    help

if AOS_COMP_LS_OSA
# Configurations for comp ls_osa
endif
```

## security/mbedtls/Config.in
```kconfig
config AOS_COMP_IMBEDTLS
    bool "ARM Mbed TLS Support"
    default n
    select AOS_COMP_ALICRYPTO
    help

if AOS_COMP_IMBEDTLS
# Configurations for comp imbedtls
endif
```

## security/prov/Config.in
```kconfig
menuconfig AOS_COMP_LIBPROV
    bool "libprov"
    default n
    select AOS_COMP_IROT
    select AOS_COMP_ALICRYPTO
    help

if AOS_COMP_LIBPROV
# Configurations for comp libprov
endif
```

## test/testcase/3rdparty/experimental/Config.in
```kconfig
menu "3rdparty Testcase Configuration"

source "test/testcase/3rdparty/experimental/fs/spiffs/Config.in"
source "test/testcase/3rdparty/experimental/fs/fatfs/Config.in"

endmenu
```

## test/testcase/3rdparty/experimental/fs/fatfs/Config.in
```kconfig
config AOS_COMP_FATFS_TEST
    bool "FatFS Testcase"
    select AOS_COMP_FATFS
    default n
    help
```

## test/testcase/3rdparty/experimental/fs/spiffs/Config.in
```kconfig
config AOS_COMP_SPIFFS_TEST
    bool "SPIFFS Testcase"
    select AOS_COMP_SPIFFS
    default n
    help
```

## test/testcase/3rdparty/experimental/ramfs_test/Config.in
```kconfig
menuconfig AOS_COMP_RAMFS_TEST
    bool "ramfs_test"
    default n
    select AOS_COMP_RAMFS
    help

if AOS_COMP_RAMFS_TEST
# Configurations for comp ramfs_test
endif
```

## test/testcase/3rdparty/experimental/spiffs_test/Config.in
```kconfig
menuconfig AOS_COMP_SPIFFS_TEST
    bool "spiffs_test"
    default n
    select AOS_COMP_SPIFFS
    help

if AOS_COMP_SPIFFS_TEST
# Configurations for comp spiffs_test
endif
```

## test/testcase/Config.in
```kconfig
menu "Testcase Configuration"

source "test/testcase/kernel/Config.in"
source "test/testcase/middleware/uagent/Config.in"
source "test/testcase/utility/Config.in"
source "test/testcase/osal/Config.in"
source "test/testcase/3rdparty/experimental/Config.in"
source "test/testcase/certificate/Config.in"
source "test/testcase/network/Config.in"

endmenu
```
