## hardware/chip/espressif_esp32/esp-idf/examples/peripherals/secure_element/atecc608_ecdsa/components/esp-cryptoauthlib/Kconfig
```kconfig
menu "esp-cryptoauthlib"

    choice ATECC608A_TYPE
        prompt "Choose the type of ATECC608A chip"
        default ATECC608A_TNG
        help
            There are three types of ATECC608A ( Secure Element) chips, which are
            Trust & GO, TrustFLex and Trust Custom. For more details consult README
            file of esp_cryptoauth_utility which is part of esp-cryptoauthlib component.
        config ATECC608A_TNG
            bool "ATECC608A chip type Trust & GO"
        config ATECC608A_TFLEX
            bool "ATECC608A chip type TrustFlex"
        config ATECC608A_TCUSTOM
            bool "ATECC608A chip type TrustCustom"
    endchoice

    config ATCA_MBEDTLS_ECDSA
        bool "Enable Hardware ECDSA keys for mbedTLS"
        depends on MBEDTLS_ECDSA_C
        help
            Enable Hardware ECDSA

    config ATCA_MBEDTLS_ECDSA_SIGN
        bool "Enable ATECC608A sign operations in mbedTLS"
        depends on ATCA_MBEDTLS_ECDSA
        select MBEDTLS_ATCA_HW_ECDSA_SIGN
        select MBEDTLS_ECP_DP_SECP256R1_ENABLED

    config ATCA_MBEDTLS_ECDSA_VERIFY
        bool "Enable ATECC608A verify operations in mbedTLS"
        depends on ATCA_MBEDTLS_ECDSA
        select MBEDTLS_ATCA_HW_ECDSA_VERIFY
        select MBEDTLS_ECP_DP_SECP256R1_ENABLED

endmenu # cryptoauthlib
```

## hardware/chip/rtl872xd/hal/hal_test/Config.in
```kconfig
menu "HAL(Peripheral) Testcase Configuration"

menuconfig AOS_COMP_HAL_TEST
    bool "hal_test"
    default n
    select AOS_COMP_UART_TEST if ENABLE_UART
    select AOS_COMP_GPIO_TEST if ENABLE_GPIO
    select AOS_COMP_I2C_TEST if ENABLE_I2C
    select AOS_COMP_SPI_TEST if ENABLE_SPI
    select AOS_COMP_FLASH_TEST if ENABLE_FLASH
    select AOS_COMP_ADC_TEST if ENABLE_ADC
    select AOS_COMP_DAC_TEST if ENABLE_DAC
    select AOS_COMP_PWM_TEST if ENABLE_PWM
    select AOS_COMP_RNG_TEST if ENABLE_RNG
    select AOS_COMP_RTC_TEST if ENABLE_RTC
    select AOS_COMP_TIMER_TEST if ENABLE_TIMER
    select AOS_COMP_WDG_TEST if ENABLE_WDG
    help

if AOS_COMP_HAL_TEST
# Configurations for comp hal_test

source "test/testcase/hal/uart/Config.in"
source "test/testcase/hal/flash/Config.in"
source "test/testcase/hal/gpio/Config.in"
source "test/testcase/hal/i2c/Config.in"
source "test/testcase/hal/rng/Config.in"
source "test/testcase/hal/rtc/Config.in"
source "test/testcase/hal/spi/Config.in"
source "test/testcase/hal/timer/Config.in"
source "test/testcase/hal/wdg/Config.in"
source "test/testcase/hal/adc/Config.in"
source "test/testcase/hal/pwm/Config.in"

endif

endmenu
```

## hardware/chip/rtl872xd/hal/hal_test/adc/Config.in
```kconfig
config AOS_COMP_ADC_TEST
    bool "adc_test"
    depends on ENABLE_ADC
    default n
    help

if AOS_COMP_ADC_TEST
# Configurations for comp adc_test
endif
```

## hardware/chip/rtl872xd/hal/hal_test/dac/Config.in
```kconfig
config AOS_COMP_DAC_TEST
    bool "dac_test"
    depends on ENABLE_DAC
    default n
    help

if AOS_COMP_DAC_TEST
# Configurations for comp dac_test
endif
```

## hardware/chip/rtl872xd/hal/hal_test/flash/Config.in
```kconfig
config AOS_COMP_FLASH_TEST
    bool "flash_test"
    depends on ENABLE_FLASH
    default n
    help

if AOS_COMP_FLASH_TEST
# Configurations for comp flash_test
endif
```

## hardware/chip/rtl872xd/hal/hal_test/gpio/Config.in
```kconfig
config AOS_COMP_GPIO_TEST
    bool "gpio_test"
    depends on ENABLE_GPIO
    default n
    help

if AOS_COMP_GPIO_TEST
# Configurations for comp gpio_test
endif
```

## hardware/chip/rtl872xd/hal/hal_test/i2c/Config.in
```kconfig
config AOS_COMP_I2C_TEST
    bool "i2c_test"
    depends on ENABLE_I2C
    default n
    help

if AOS_COMP_I2C_TEST
# Configurations for comp i2c_test
endif
```

## hardware/chip/rtl872xd/hal/hal_test/pwm/Config.in
```kconfig
config AOS_COMP_PWM_TEST
    bool "pwm_test"
    depends on ENABLE_PWM
    default n
    help

if AOS_COMP_PWM_TEST
# Configurations for comp pwm_test
endif
```

## hardware/chip/rtl872xd/hal/hal_test/rng/Config.in
```kconfig
config AOS_COMP_RNG_TEST
    bool "rng_test"
    depends on ENABLE_RNG
    default n
    help

if AOS_COMP_RNG_TEST
# Configurations for comp rng_test
endif
```

## hardware/chip/rtl872xd/hal/hal_test/rtc/Config.in
```kconfig
config AOS_COMP_RTC_TEST
    bool "rtc_test"
    depends on ENABLE_RTC
    default n
    help

if AOS_COMP_RTC_TEST
# Configurations for comp rtc_test
endif
```

## hardware/chip/rtl872xd/hal/hal_test/spi/Config.in
```kconfig
config AOS_COMP_SPI_TEST
    bool "spi_test"
    depends on ENABLE_SPI
    default n
    help

if AOS_COMP_SPI_TEST
# Configurations for comp spi_test
endif
```

## hardware/chip/rtl872xd/hal/hal_test/timer/Config.in
```kconfig
config AOS_COMP_TIMER_TEST
    bool "timer_test"
    depends on ENABLE_TIMER
    default n
    help

if AOS_COMP_TIMER_TEST
# Configurations for comp timer_test
endif
```

## hardware/chip/rtl872xd/hal/hal_test/uart/Config.in
```kconfig
config AOS_COMP_UART_TEST
    bool "uart_test"
    depends on ENABLE_UART
    default n
    help

if AOS_COMP_UART_TEST
# Configurations for comp uart_test
endif
```

## hardware/chip/rtl872xd/hal/hal_test/wdg/Config.in
```kconfig
config AOS_COMP_WDG_TEST
    bool "wdg_test"
    depends on ENABLE_WDG
    default n
    help

if AOS_COMP_WDG_TEST
# Configurations for comp wdg_test
endif
```

## kernel/Config.in
```kconfig
source "kernel/core/rhino/Config.in"
source "kernel/core/mk/kspace/Config.in"
source "kernel/core/init/Config.in"
source "kernel/core/debug/Config.in"
source "kernel/core/pwrmgmt/Config.in"
source "kernel/core/cplusplus/Config.in"
source "kernel/core/cli/Config.in"
source "kernel/core/kv/Config.in"
source "kernel/core/vfs/Config.in"
source "kernel/core/epoll/Config.in"
source "kernel/core/kobj_core/Config.in"
source "kernel/core/osal/kobjs/Config.in"
```

## kernel/arch/arm/armv8m/Config.in
```kconfig
config AOS_ARCH_ARMV8M
    bool
    help
      arch for armv8m

if AOS_ARCH_ARMV8M
# Configurations for arch armv8m
endif
```

## kernel/bus/canopen/Config.in
```kconfig
menuconfig AOS_COMP_CANOPEN
    bool "CANopen"
    default n
    help
      Support CANOPEN protocol stack.

      Switch to "y" leads to support CANOPEN protocol stack.
      Switch to "n" leads to not support CANOPEN protocol stacks.

if AOS_COMP_CANOPEN

config CANFESTIVAL_ENABLED
    bool "canfestival"
    default n
    help
      support canfestival library.

      Switching to "y" leads to support canfestival library.
      Switching to "n" leads to not support canfestival library.

# Configurations for comp canopen
endif
```
