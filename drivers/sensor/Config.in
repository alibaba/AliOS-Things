## example/bluetooth/breezeapp/Config.in
```kconfig
menuconfig AOS_APP_BREEZEAPP
    bool "breezeapp"
    select AOS_COMP_BREEZE
    select AOS_COMP_OTA_BLE if @CONDITION@
    select AOS_COMP_CLI
    help

if AOS_APP_BREEZEAPP
# Configurations for app breezeapp
endif
```

## framework/bluetooth/breeze/hal/ble/Config.in
```kconfig
menuconfig AOS_COMP_BT_BREEZE_HAL
    #bool "bt_breeze_hal"
    default n
    select AOS_COMP_BT
    help

if AOS_COMP_BT_BREEZE_HAL
# Configurations for comp bt_breeze_hal
endif
```

## framework/protocol/linkkit/sdk/iotx-sdk-c_clone/src/protocol/http2/Config.in
```kconfig
config HTTP2_COMM_ENABLED
    bool "FEATURE_HTTP2_COMM_ENABLED"
    default n
    help
        Establish persistent connection with AliCloud via HTTP2-based protocol

menu "HTTP2 Configurations"
    depends on HTTP2_COMM_ENABLED

    config FS_ENABLED
        bool "FEATURE_FS_ENABLED"
        default y
        help
            USE HAL fs api to enable file upload feature 

endmenu
```

## hardware/chip/espressif_adf/esp-adf/components/audio_board/Kconfig.projbuild
```kconfig
menu "Audio HAL"

choice AUDIO_BOARD
    prompt "Audio board"
    default ESP_LYRAT_V4_3_BOARD
    help
        Select an audio board to use with the ESP-ADF
config AUDIO_BOARD_CUSTOM
    bool "Custom audio board"
config ESP_LYRAT_V4_3_BOARD
    bool "ESP32-Lyrat V4.3"
config ESP_LYRAT_V4_2_BOARD
    bool "ESP32-Lyrat V4.2"
config ESP_LYRATD_MSC_V2_1_BOARD
    bool "ESP32-LyraTD-MSC V2.1"
config ESP_LYRATD_MSC_V2_2_BOARD
    bool "ESP32-LyraTD-MSC V2.2"
config ESP_LYRAT_MINI_V1_1_BOARD
    bool "ESP32-Lyrat-Mini V1.1"
config ESP32_KORVO_DU1906_BOARD
    bool "ESP32_KORVO_DU1906"
config ESP32_S2_KALUGA_1_V1_2_BOARD
    bool "ESP32-S2-Kaluga-1 v1.2"
config ESP32_S3_KORVO2_V3_BOARD
    bool "ESP32-S3-Korvo-2 v3.0"

endchoice

choice ESP32_KORVO_DU1906_DAC
    prompt "ESP32 KORVO DU1906 Board DAC chip"
    depends on ESP32_KORVO_DU1906_BOARD
    default ESP32_KORVO_DU1906_DAC_TAS5805M
    help
        Select DAC chip to use on ESP32_KORVO_DU1906 board

config ESP32_KORVO_DU1906_DAC_TAS5805M
    bool "ESP32_KORVO_DU1906_DAC_TAS5805M"
config ESP32_KORVO_DU1906_DAC_ES7148
    bool "ESP32_KORVO_DU1906_DAC_ES7148"

endchoice

choice ESP32_KORVO_DU1906_ADC
    prompt "ESP32 KORVO DU1906 Board ADC chip"
    depends on ESP32_KORVO_DU1906_BOARD
    default ESP32_KORVO_DU1906_ADC_ES7243
    help
        Select ADC chip to use on ESP32_KORVO_DU1906 board

config ESP32_KORVO_DU1906_ADC_ES7243
    bool "ESP32_KORVO_DU1906_ADC_ES7243"
endchoice

endmenu
```

## hardware/chip/espressif_adf/esp-adf/components/esp_dispatcher/Kconfig.projbuild
```kconfig
menu "ADF Features"

    config ESP_DISPATCHER_DELEGATE_TASK_CORE
        int "Delegation task core"
        range 0 1
        default 0
        help
            Pinned delegate task to core 0 or core 1.

    config ESP_DISPATCHER_DELEGATE_TASK_PRIO
        int "Delegate task's prio"
        range 1 20
        default 10
        help
            The delegate task's prio.

    config ESP_DISPATCHER_DELEGATE_STACK_SIZE
        int "Delegate task's stack size"
        range 1024 10240
        default 4096
        help
            The delegate task's stack is located in DRAM, modify this size to make sure all the needed operation can be run success in the it.

endmenu
```

## hardware/chip/espressif_esp32/esp-adf/components/esp-adf-libs/Kconfig.projbuild
```kconfig
menu "Recorder Engine Configuration"


choice RECORD_ENGINE_MODE
    prompt "Choose recorder engine functionality"
    default REC_ENG_ENABLE_VAD_WWE_AMR
    help
        Recorder engine have VAD, WWE and AMR encoding functionality.
        AMR encoding enabled, the binary size increase 144kB.
        WWE enabled, the binary size increase 103kB.

config REC_ENG_ENABLE_VAD_ONLY
    bool "VAD ONLY"

config REC_ENG_ENABLE_VAD_WWE
    bool "VAD and WWE"

config REC_ENG_ENABLE_VAD_WWE_AMR
    bool "VAD, WWE and AMR encoding"

endchoice


endmenu
```
