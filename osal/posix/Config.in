## osal/posix/Config.in
```kconfig
menuconfig AOS_COMP_OSAL_POSIX
    bool "posix"
    default n
    help

if AOS_COMP_OSAL_POSIX
# Configurations for comp posix
endif
```

## platform/arch/Config.in
```kconfig
menu "Arch Configuration"

## --- Generated Automatically ---
source "platform/arch/arm/armv5/Config.in"
source "platform/arch/arm/armv6m/Config.in"
source "platform/arch/arm/armv7a/Config.in"
source "platform/arch/arm/armv7m/Config.in"
source "platform/arch/csky/cskyv2-l/Config.in"
source "platform/arch/linux/Config.in"
source "platform/arch/mips/mips-I/Config.in"
source "platform/arch/mips/mips32/Config.in"
source "platform/arch/risc-v/risc_v32I/Config.in"
source "platform/arch/xtensa/lx106/Config.in"
source "platform/arch/xtensa/lx6/Config.in"
## --- End ---

endmenu
```

## platform/arch/arm/armv5/Config.in
```kconfig
if AOS_CREATE_PROJECT
config AOS_ARCH_ARMV5
    bool
    default y
endif

if !AOS_CREATE_PROJECT
config AOS_ARCH_ARMV5
    bool
    help
      arch for armv5
endif

if AOS_ARCH_ARMV5
# Configurations for arch armv5
endif
```

## platform/arch/arm/armv6m-mk/Config.in
```kconfig
if AOS_CREATE_PROJECT
config AOS_ARCH_ARMV6M-MK
    bool
    default y
endif

if !AOS_CREATE_PROJECT
config AOS_ARCH_ARMV6M-MK
    bool
    help
      arch for armv6m-mk
endif

if AOS_ARCH_ARMV6M
# Configurations for arch armv6m
endif
```

## platform/arch/arm/armv6m/Config.in
```kconfig
if AOS_CREATE_PROJECT
config AOS_ARCH_ARMV6M
    bool
    default y
endif

if !AOS_CREATE_PROJECT
config AOS_ARCH_ARMV6M
    bool
    help
      arch for armv6m
endif

if AOS_ARCH_ARMV6M
# Configurations for arch armv6m
endif
```

## platform/arch/arm/armv7a-mk/Config.in
```kconfig
config AOS_ARCH_ARMV7A_MK
    bool "armv7a-mk"
    help
      arch for armv7a-mk

if AOS_ARCH_ARMV7A_MK
# Configurations for arch armv7a-mk
endif
```

## platform/arch/arm/armv7a-svc/Config.in
```kconfig
config AOS_ARCH_ARMV7A_SVC
    bool "armv7a-svc"
    help
      arch for armv7a-svc

if AOS_ARCH_ARMV7A_SVC
# Configurations for arch armv7a-svc
endif
```

## platform/arch/arm/armv7a/Config.in
```kconfig
if AOS_CREATE_PROJECT
config AOS_ARCH_ARMV7A
    bool
    default y
endif

if !AOS_CREATE_PROJECT
config AOS_ARCH_ARMV7A
    bool
    help
      arch for armv7a
endif

if AOS_ARCH_ARMV7A
# Configurations for arch armv7a
endif
```

## platform/arch/arm/armv7m-mk/Config.in
```kconfig
if AOS_CREATE_PROJECT
config AOS_ARCH_ARMV7M_MK
    bool
    default n
endif

if !AOS_CREATE_PROJECT
config AOS_ARCH_ARMV7M_MK
    bool
    help
      arch for armv7m-mk
endif

if AOS_ARCH_ARMV7M_SVC
# Configurations for arch armv7m-mk
endif
```

## platform/arch/arm/armv7m-svc/Config.in
```kconfig
config AOS_ARCH_ARMV7M_SVC
    bool "armv7m-svc"
    help
      arch for armv7m-svc

if AOS_ARCH_ARMV7M_SVC
# Configurations for arch armv7m-svc
endif
```

## platform/arch/arm/armv7m/Config.in
```kconfig
if AOS_CREATE_PROJECT
config AOS_ARCH_ARMV7M
    bool
    default y
endif

if !AOS_CREATE_PROJECT
config AOS_ARCH_ARMV7M
    bool
    help
      arch for armv7m
endif

if AOS_ARCH_ARMV7M
# Configurations for arch armv7m
endif
```

## platform/arch/csky/cskyv2-l/Config.in
```kconfig
if AOS_CREATE_PROJECT
config AOS_ARCH_CSKYV2_L
    bool
    default y
endif

if !AOS_CREATE_PROJECT
config AOS_ARCH_CSKYV2_L
    bool
    help
      arch for cskyv2-l
endif

if AOS_ARCH_CSKYV2_L
# Configurations for arch cskyv2-l
endif
```

## platform/arch/linux/Config.in
```kconfig
if AOS_CREATE_PROJECT
config AOS_ARCH_LINUX
    bool
    default y
endif

if !AOS_CREATE_PROJECT
config AOS_ARCH_LINUX
    bool
    help
      arch for linux
endif

if AOS_ARCH_LINUX
# Configurations for arch arch_linux
endif
```

## platform/arch/mips/mips-I/Config.in
```kconfig
if AOS_CREATE_PROJECT
config AOS_ARCH_MIPS_I
    bool
    default y
endif

if !AOS_CREATE_PROJECT
config AOS_ARCH_MIPS_I
    bool
    help
      arch for mips-I
endif

if AOS_ARCH_MIPS_I
# Configurations for arch mips-I
endif
```

## platform/arch/mips/mips32/Config.in
```kconfig
if AOS_CREATE_PROJECT
config AOS_ARCH_MIPS32
    bool
    default y
endif

if !AOS_CREATE_PROJECT
config AOS_ARCH_MIPS32
    bool
    help
      arch for mips32
endif

if AOS_ARCH_MIPS32
# Configurations for arch mips32
endif
```

## platform/arch/risc-v/risc_v32I/Config.in
```kconfig
if AOS_CREATE_PROJECT
config AOS_ARCH_RISC_V32I
    bool
    default y
endif

if !AOS_CREATE_PROJECT
config AOS_ARCH_RISC_V32I
    bool
    help
      arch for risc_v32I
endif

if AOS_ARCH_RISC_V32I
# Configurations for arch risc_v32I
endif
```

## platform/arch/xtensa/lx106/Config.in
```kconfig
if AOS_CREATE_PROJECT
config AOS_ARCH_XTENSA_LX106
    bool
    default y
endif

if !AOS_CREATE_PROJECT
config AOS_ARCH_XTENSA_LX106
    bool
    help
      arch for xtensa lx106
endif

if AOS_ARCH_XTENSA_LX106
# Configurations for arch xtensa lx106
endif
```

## platform/arch/xtensa/lx6/Config.in
```kconfig
if AOS_CREATE_PROJECT
config AOS_ARCH_XTENSA_LX6
    bool
    default y
endif

if !AOS_CREATE_PROJECT
config AOS_ARCH_XTENSA_LX6
    bool
    help
      arch for xtensa lx6
endif

if AOS_ARCH_XTENSA_LX6
# Configurations for arch xtensa-lx6
endif
```

## platform/board/Config.in
```kconfig
menu "BSP         Configuration"
choice
    prompt "Board Selection"

source "platform/board/haas100/Config.in"
if AOS_BOARD_HAAS100
    config AOS_BUILD_BOARD
        default "haas100"

    source "platform/mcu/haas1000/Config.in"
    source "platform/arch/arm/armv7m/Config.in"
endif

source "platform/board/haaseduk1/Config.in"
if AOS_BOARD_HAASEDUK1
    config AOS_BUILD_BOARD
        default "haaseduk1"

    source "platform/mcu/haas1000/Config.in"
    source "platform/arch/arm/armv7m/Config.in"
endif

endchoice

endmenu
```

## platform/board/aaboard_demo/Config.in
```kconfig
config AOS_BOARD_AABOARD_DEMO
    bool "AABOARD_DEMO"
    select AOS_MCU_AAMCU_DEMO if !AOS_CREATE_PROJECT
    select AOS_COMP_KERNEL_INIT if !AOS_CREATE_PROJECT
    select CONFIG_AOS_TCPIP
    help

if AOS_BOARD_AABOARD_DEMO
# Configurations for board aaboard_demo

# "BSP SUPPORT FEATURE"
config BSP_SUPPORT_UART
    bool
    default y

config BSP_SUPPORT_GPIO
    bool
    default y

config BSP_SUPPORT_FLASH
    bool
    default y

config BSP_SUPPORT_I2C
    bool
    default y

config BSP_SUPPORT_WIFI
    bool
    default y

endif
```

## platform/board/ap80a0/Config.in
```kconfig
config AOS_BOARD_AP80A0
    bool "AP80A0"
    select AOS_MCU_MVS_AP80XX
    select AOS_COMP_NEWLIB_STUB
    help

if AOS_BOARD_AP80A0
# Configurations for board ap80a0
endif
```

## platform/board/armhflinux/Config.in
```kconfig
config AOS_BOARD_ARMHFLINUX
    bool "ArmHfLinux"
    select AOS_MCU_LINUXIMPL
    select AOS_COMP_KERNEL_INIT
    help
      configuration for board armhflinux

if AOS_BOARD_ARMHFLINUX
# Configurations for board board_armhflinux
endif
```

## platform/board/asr5501-demo/Config.in
```kconfig
config AOS_BOARD_ASR5501_DEMO
    bool "ASR5501"
    select AOS_MCU_ASR5501
    select AOS_COMP_KERNEL_INIT
    select AOS_COMP_NETMGR
    select CONFIG_AOS_TCPIP
    help

if AOS_BOARD_ASR5501_DEMO
# Configurations for board asr5501

# "BSP SUPPORT FEATURE"
config BSP_SUPPORT_UART
    bool
    default y

config BSP_SUPPORT_GPIO
    bool
    default y

config BSP_SUPPORT_FLASH
    bool
    default y

config BSP_SUPPORT_I2C
    bool
    default y

config BSP_SUPPORT_WIFI
    bool
    default y

config BSP_SUPPORT_WIFI_LOWPOWER
    bool
    default y

endif
```

## platform/board/asr5501/Config.in
```kconfig
config AOS_BOARD_ASR5501
    bool "ASR5501"
    select AOS_MCU_ASR5501 if !AOS_CREATE_PROJECT
    select AOS_COMP_KERNEL_INIT if !AOS_CREATE_PROJECT
    select AOS_COMP_NETMGR if !AOS_CREATE_PROJECT
    select CONFIG_AOS_TCPIP
    help
      configuration for board asr5501

if AOS_BOARD_ASR5501
# Configurations for board asr5501

# "BSP SUPPORT FEATURE"
config BSP_SUPPORT_UART
    bool
    default y

config BSP_SUPPORT_GPIO
    bool
    default y

config BSP_SUPPORT_FLASH
    bool
    default y

config BSP_SUPPORT_I2C
    bool
    default y

config BSP_SUPPORT_WIFI
    bool
    default y

config BSP_SUPPORT_WIFI_LOWPOWER
    bool
    default y

endif
```

## platform/board/atsame54-xpro/Config.in
```kconfig
config AOS_BOARD_ATSAME54_XPRO
    bool "ATSAME54_XPRO"
    select AOS_MCU_ATSAME54
    select AOS_COMP_KERNEL_INIT
    select AOS_COMP_SAL if AOS_NETWORK_SAL
    select AOS_COMP_NETMGR if AOS_NETWORK_SAL
    help
      configuration for board atsame54-xpro

if AOS_BOARD_ATSAME54_XPRO
# Configurations for board board_atsame54-xpro

# "BSP SUPPORT FEATURE"
config BSP_SUPPORT_UART
    bool
    default y

config BSP_SUPPORT_FLASH
    bool
    default y

config BSP_SUPPORT_TIMER
    bool
    default y

config BSP_SUPPORT_WIFI
    bool
    default y

config BSP_SUPPORT_EXTERNAL_MODULE
    bool "Support external module"
    default y

endif
```
