## app/example/linkkitapp/Config.in
```kconfig
config AOS_APP_LINKKITAPP
    bool "Linkkit Application"
    select AOS_COMP_CLI if !AOS_BOARD_ESP8266
    select AOS_COMP_NETMGR
    select AOS_COMP_OTA
    select AOS_COMP_CJSON
    select AOS_COMP_SDK_DEVMODEL
    select AOS_COMP_CJSON
    select AOS_COMP_SDK_AWSS
    select AOS_COMP_BREEZE if LINKKITAPP_CONFIG_COMBOAPP
    select AOS_COMP_BREEZE_HAL if LINKKITAPP_CONFIG_COMBOAPP
    help
        linkkitapp

if AOS_APP_LINKKITAPP
# Configurations for app linkkitapp
config LINKKITAPP_CONFIG_COMBOAPP
    bool "Enable Breeze AWSS "
    default n
    help 
        Providing secured ble link for wifi provision.

choice
    prompt "Select Case"
    default LINKKITAPP_CONFIG_CASE_SOLO
    help
        select case to build

    config LINKKITAPP_CONFIG_CASE_SOLO
        bool "SOLO"
        help
            default case, build linkkit_example_solo.c or deprecated/solo.c(when enable deprecated)

    config LINKKITAPP_CONFIG_CASE_SCHED
        bool "Sched"
        help
            case sched, build linkkit_example_sched.c or deprecated/sched.c(when enable deprecated)

    config LINKKITAPP_CONFIG_CASE_CNTDOWN
        bool "Cntdown"
        help
            case countdown, build linkkit_example_cntdown.c or deprecated/cntdown.c(when enable deprecated)
endchoice

config LINKKITAPP_CONFIG_PRINT_HEAP
    bool "Show Free Heap Duration"
    default n
    help
    displays heap space periodically for debug
endif
```

## app/example/linuxapp/Config.in
```kconfig
menuconfig AOS_APP_LINUXAPP
    bool "linuxapp"
    select AOS_COMP_BENCHMARKS if @CONDITION@
    select AOS_COMP_LWIP if @CONDITION@
    select AOS_COMP_CLI
    select AOS_COMP_YLOOP
    help

if AOS_APP_LINUXAPP
# Configurations for app linuxapp
endif
```

## app/example/littlevgl_developerkit/Config.in
```kconfig
menuconfig AOS_APP_LITTLEVGL_DEVELOPERKIT
    bool "littlevgl_developerkit"
    select AOS_COMP_BENCHMARKS if @CONDITION@
    select AOS_COMP_LITTLEVGL
    select AOS_COMP_CLI
    select AOS_COMP_YLOOP
    help

if AOS_APP_LITTLEVGL_DEVELOPERKIT
# Configurations for app littlevgl_developerkit
endif
```

## app/example/littlevgl_simulate/Config.in
```kconfig
menuconfig AOS_APP_LITTLEVGL_SIMULATE
    bool "littlevgl_simulate"
    select AOS_APP_LV_DRIVERS
    select AOS_COMP_LITTLEVGL
    select AOS_COMP_CLI
    select AOS_COMP_YLOOP
    select AOS_APP_LV_EXAMPLES
    help

if AOS_APP_LITTLEVGL_SIMULATE
# Configurations for app littlevgl_simulate
endif
```

## app/example/lorawan/classb/Config.in
```kconfig
menuconfig AOS_APP_CLASSB
    bool "classb"
    select AOS_COMP_LORAWAN_4_4_2
    select AOS_COMP_KV
    help

if AOS_APP_CLASSB
# Configurations for app classb
endif
```

## app/example/lorawan/linkwan/Config.in
```kconfig
menuconfig AOS_APP_LINKWAN
    bool "linkwan"
    select AOS_COMP_LORAWAN_4_4_2
    select AOS_COMP_KV
    help

if AOS_APP_LINKWAN
# Configurations for app linkwan
endif
```

## app/example/lwm2mapp/Config.in
```kconfig
config AOS_APP_LWM2MAPP
    bool "lwm2mapp"
    select AOS_COMP_OSAL_AOS   
    select AOS_COMP_LWM2M 
    help
        lwm2m app

if AOS_APP_LWM2MAPP
# Configurations for app lwm2m client
endif
```

## app/example/meshapp/Config.in
```kconfig
config AOS_APP_MESHAPP
    bool "meshapp"
    select AOS_COMP_UMESH
    select AOS_COMP_NETMGR
    select AOS_COMP_CLI
    select AOS_COMP_ALICRYPTO if MESHAUTH = 1
    select AOS_COMP_ID2 if MESHAUTH = 1
    select AOS_COMP_LWIP if LWIP != 0
    select AOS_COMP_DDA if AOS_BOARD_LINUXHOST || AOS_BOARD_ARMHFLINUX
    help
        uMesh sample application

if AOS_APP_MESHAPP
# Configurations for app meshapp

config MESHAUTH
    int "mesh auth"
    range 0 1
    default 0
    help

config IPV6
    int "use ipv6"
    range 0 1
    default 0
    help

config MESHAPP_CONFIG_HAL_TEST
    int "mesh hal test"
    range 0 1
    default 0
    help

config LWIP
    int "LWIP"
    range 0 1
    default 1 

endif
```

## app/example/modbus_demo/Config.in
```kconfig
menuconfig AOS_APP_MODBUS_TEST
    bool "modbus_demo"
    select AOS_COMP_MBMASTER
    select AOS_COMP_CLI
    select AOS_COMP_YLOOP
    help

if AOS_APP_MODBUS_TEST
# Configurations for app modbus_test
endif
```

## app/example/modbus_test/Config.in
```kconfig
menuconfig AOS_APP_MODBUS_TEST
    bool "modbus_test"
    select AOS_COMP_BENCHMARKS if @CONDITION@
    select AOS_COMP_MBMASTER
    select AOS_COMP_CLI
    select AOS_COMP_YLOOP
    help

if AOS_APP_MODBUS_TEST
# Configurations for app modbus_test
endif
```

## app/example/mqttapp/Config.in
```kconfig
menuconfig AOS_APP_MQTTAPP
    bool "mqttapp"
#    select AOS_COMP_LINKKIT_MQTT
    select AOS_COMP_NETMGR
    select AOS_COMP_CLI
    select AOS_COMP_CJSON
    select AOS_COMP_LWIP if LWIP = 1
    help
        mqtt examples

if AOS_APP_MQTTAPP
# Configurations for app mqttapp

config MQTTAPP_CONFIG_CASE
    string "case option: rrpc/multithread/presstest/blank(default)"
    default ""
    help

config MQTTAPP_CONFIG_TEST_LOOP
    int "test loop"
    range 0 1
    default 1
    help

endif
```

## app/example/nano/Config.in
```kconfig
menuconfig AOS_APP_NANO
    bool "nano"
    select AOS_COMP_BENCHMARKS if @CONDITION@
    help

if AOS_APP_NANO
# Configurations for app nano
endif
```

## app/example/netmgrapp/Config.in
```kconfig
menuconfig AOS_APP_NETMGRAPP
    bool "netmgrapp"
    select AOS_COMP_NETMGR
    select AOS_COMP_CLI
    select AOS_COMP_YLOOP
    help

if AOS_APP_NETMGRAPP
# Configurations for app netmgrapp
endif
```

## app/example/networkapp/Config.in
```kconfig
menuconfig AOS_APP_NETWORKAPP
    bool "networkapp"
    select AOS_COMP_BENCHMARKS if @CONDITION@
    select AOS_COMP_NETMGR
    select AOS_COMP_CLI
    select AOS_COMP_YLOOP
    help

if AOS_APP_NETWORKAPP
# Configurations for app networkapp
endif
```

## app/example/opusapp/Config.in
```kconfig
menuconfig AOS_APP_OPUSAPP
    bool "opusapp"
    select AOS_COMP_CLI
    select AOS_COMP_YLOOP
    help

if AOS_APP_OPUSAPP
# Configurations for app opusapp
endif
```

## app/example/otaapp/Config.in
```kconfig
config AOS_APP_OTAAPP
    bool "OTA Sample"
    select AOS_COMP_NETMGR
    select AOS_COMP_CLI
    select AOS_COMP_OTA
    select AOS_COMP_CJSON
    select AOS_COMP_LWIP if LWIP = 1
    select AOS_COMP_LINKKIT_SDK_C
    select APP_FEATURE_LINKKIT_MQTT
    help
        OTA demo app for developers

if AOS_APP_OTAAPP
# Configurations for app otaapp

config LWIP
    int "LWIP"
    range 0 1
    default 0

config OTAAPP_CONFIG_TEST_LOOP
    int "Test Loop"
    range 0 1
    default 0
    help

endif
```

## app/example/pca_helloworld/Config.in
```kconfig
menuconfig AOS_APP_PCA_HELLOWORLD
    bool "pca_helloworld"
    select AOS_COMP_BENCHMARKS if @CONDITION@
    select AOS_COMP_CLI
    select AOS_COMP_YLOOP
    help

if AOS_APP_PCA_HELLOWORLD
# Configurations for app pca_helloworld
endif
```

## app/example/prov_app/Config.in
```kconfig
config AOS_APP_PROV_APP
    bool "ID2 Provisioning Sample"
    select AOS_COMP_LIBPROV
    select AOS_COMP_CLI
    select AOS_COMP_YLOOP
    select AOS_COMP_LS_HAL
    help
        id2 provisioning sample app

if AOS_APP_PROV_APP
# Configurations for app prov_app

config PROVAPP_CONFIG_ERASE
    int "Erase"
    range 0 1
    default 0
    help

endif
```

## app/example/pwr_test/Config.in
```kconfig
menuconfig AOS_APP_PWR_TEST
    bool "pwr_test"
    select AOS_COMP_BENCHMARKS if @CONDITION@
    select AOS_COMP_CLI
    select AOS_COMP_YLOOP
    select AOS_COMP_PWRMGMT
    help

if AOS_APP_PWR_TEST
# Configurations for app pwr_test
endif
```

## app/example/qr/Config.in
```kconfig
menuconfig AOS_APP_QR
    bool "qr"
    select AOS_COMP_BENCHMARKS if @CONDITION@
    select AOS_COMP_CLI
    select AOS_COMP_YLOOP
    help

if AOS_APP_QR
# Configurations for app qr
endif
```

## app/example/rhinorun/Config.in
```kconfig
menuconfig AOS_APP_RHINORUN
    bool "rhinorun"
    select AOS_COMP_BENCHMARKS if @CONDITION@
    select AOS_COMP_CLI
    select AOS_COMP_YLOOP
    help

if AOS_APP_RHINORUN
# Configurations for app rhinorun
endif
```

## app/example/salserver/Config.in
```kconfig
menuconfig AOS_APP_SALSERVER
    bool "salserver"
    select AOS_COMP_NETMGR
    select AOS_COMP_CLI
    select AOS_COMP_YLOOP
    select AOS_COMP_SAL
    help

if AOS_APP_SALSERVER
# Configurations for app salserver
endif
```

## app/example/sk/sk_gui/Config.in
```kconfig
config AOS_APP_SK_GUI
    bool "StartKit GUI Sample"
    select AOS_COMP_LITTLEVGL
    select AOS_COMP_CLI
    select AOS_COMP_YLOOP
    help
        Starter Kit GUI demo

if AOS_APP_SK_GUI
# Configurations for app sk_gui
endif
```

## app/example/smpapp/Config.in
```kconfig
menuconfig AOS_APP_SMPAPP
    bool "smpapp"
    select AOS_COMP_BENCHMARKS if @CONDITION@
    select AOS_COMP_CLI
    select AOS_COMP_YLOOP
    help

if AOS_APP_SMPAPP
# Configurations for app smpapp
endif
```

## app/example/smpapp_4core/Config.in
```kconfig
menuconfig AOS_APP_SMPAPP_4CORE
    bool "smpapp_4core"
    select AOS_COMP_BENCHMARKS if @CONDITION@
    select AOS_COMP_CLI
    select AOS_COMP_YLOOP
    help

if AOS_APP_SMPAPP_4CORE
# Configurations for app smpapp_4core
endif
```
