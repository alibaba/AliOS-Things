## app/example/coapapp/Config.in
```kconfig
config AOS_APP_COAPAPP
    bool "COAP Sample"
    select AOS_COMP_CJSON
    select AOS_COMP_NETMGR
    select AOS_COMP_CLI
    select COAP_COMM_ENABLED
    select COAP_DTLS_SUPPORT 

    help
        coap cloud example
```

## app/example/comboapp/Config.in
```kconfig
menuconfig AOS_APP_COMBOAPP
    bool "comboapp"
    select AOS_COMP_CLI if @CONDITION@
    select AOS_COMP_BREEZE
    select AOS_COMP_NETMGR
    help

if AOS_APP_COMBOAPP
# Configurations for app comboapp
endif
```

## app/example/cpp_demo/Config.in
```kconfig
menuconfig AOS_APP_CPP_DEMO
    bool "cpp_demo"
    select AOS_COMP_BENCHMARKS if @CONDITION@
    select AOS_COMP_CPLUSPLUS
    select AOS_COMP_CLI
    select AOS_COMP_YLOOP
    help

if AOS_APP_CPP_DEMO
# Configurations for app cpp_demo
endif
```

## app/example/cryptotest/Config.in
```kconfig
menuconfig AOS_APP_CRYPTOTEST
    bool "cryptotest"
    select AOS_COMP_BENCHMARKS if @CONDITION@
    select AOS_COMP_CLI
    select AOS_COMP_YLOOP
    select AOS_COMP_ALICRYPTO
    help

if AOS_APP_CRYPTOTEST
# Configurations for app cryptotest
endif
```

## app/example/das_app/Config.in
```kconfig
config AOS_APP_DAS_CLIENT
    bool "DAS Client Sample"
    select AOS_COMP_DAS
    select AOS_COMP_NETMGR
    select AOS_COMP_CLI
    select AOS_COMP_CJSON
    select AOS_COMP_LWIP if LWIP = 1
    select AOS_COMP_LINKKIT_SDK_C
    select APP_FEATURE_LINKKIT_MQTT
    help
        das(Device Attestation) example

if AOS_APP_DAS_CLIENT

config DAS_CLIENT_CONFIG_TEST_LOOP
    bool "Test Loop"
    default y
    help

endif
```

## app/example/devkit/dk_ld/Config.in
```kconfig
menuconfig AOS_APP_LDAPP
    bool "ldapp"
    select AOS_COMP_COMMON
    select AOS_COMP_LITTLEVGL if @CONDITION@
    select AOS_COMP_CLI
    select AOS_COMP_CJSON
    select AOS_COMP_NETMGR
    select AOS_COMP_OTA
    select AOS_COMP_SENSOR
    help

if AOS_APP_LDAPP
# Configurations for app ldapp
endif
```

## app/example/dk/dk_audio/Config.in
```kconfig
menuconfig AOS_APP_DEVELOPERKITAUDIO
    bool "developerkitaudio"
    select AOS_COMP_BENCHMARKS if @CONDITION@
    select AOS_COMP_CLI
    select AOS_COMP_YLOOP
    help

if AOS_APP_DEVELOPERKITAUDIO
# Configurations for app developerkitaudio
endif
```

## app/example/dk/dk_camera/Config.in
```kconfig
config AOS_APP_DK_CAMERA
    bool "dk_camera"
    select AOS_COMP_FATFS
    select AOS_COMP_CLI
    select AOS_COMP_YLOOP
    help
        developer kit camera demo

if AOS_APP_DK_CAMERA
# Configurations for app dk_camera
endif
```

## app/example/dk/dk_gui/Config.in
```kconfig
config AOS_APP_DK_GUI
    bool "dk_gui"
    select AOS_COMP_LITTLEVGL
    select AOS_COMP_CLI
    select AOS_COMP_YLOOP
    help
        Developer Kit GUI example

if AOS_APP_DK_GUI
# Configurations for app dk_gui
endif
```

## app/example/dk/dk_ld/Config.in
```kconfig
config AOS_APP_DK_LD
    bool "DeveloperKit Link To LinkDevelop Sample"
    select AOS_COMP_CLI
    select AOS_COMP_CJSON
    select AOS_COMP_NETMGR
    select AOS_COMP_OTA
    select AOS_COMP_SENSOR
    select AOS_COMP_LITTLEVGL if AOS_BOARD_DEVELOPERKIT
    select AOS_COMP_LINKKIT_SDK_C
    select APP_FEATURE_LINKKIT_MQTT
    help
        Developer Kit example with link develop

if AOS_APP_DK_LD
# Configurations for app dk_ld
endif
```

## app/example/dk/dk_qr/Config.in
```kconfig
config AOS_APP_DK_QR
    bool "dk_qr"
    select AOS_COMP_CLI
    select AOS_COMP_YLOOP
    help
        Developer Kit QR Code demo

if AOS_APP_DK_QR
# Configurations for app dk_qr
endif
```

## app/example/gpsapp/Config.in
```kconfig
menuconfig AOS_APP_GPSAPP
    bool "gpsapp"
    select AOS_COMP_COMMON
    select AOS_COMP_CLI
    select AOS_COMP_CJSON
    select AOS_COMP_NETMGR
    select AOS_COMP_UDATA
    select AOS_COMP_ATPARSER
    select AOS_COMP_OTA
    help

if AOS_APP_GPSAPP
# Configurations for app gpsapp
endif
```

## app/example/hdlcapp/hdlcclient/Config.in
```kconfig
menuconfig AOS_APP_HDLCCLIENT
    bool "hdlcclient"
    select AOS_COMP_ATPARSER
    select AOS_COMP_NETMGR
    select AOS_COMP_CLI
    select AOS_COMP_YLOOP
    help

if AOS_APP_HDLCCLIENT
# Configurations for app hdlcclient
endif
```

## app/example/hdlcapp/hdlcserver/Config.in
```kconfig
menuconfig AOS_APP_HDLCSERVER
    bool "hdlcserver"
    select AOS_COMP_ATPARSER
    select AOS_COMP_YLOOP
    help

if AOS_APP_HDLCSERVER
# Configurations for app hdlcserver
endif
```

## app/example/helloworld/Config.in
```kconfig
menuconfig AOS_APP_HELLOWORLD
    bool "helloworld"
    select AOS_COMP_BENCHMARKS if @CONDITION@
    select AOS_COMP_CLI
    select AOS_COMP_YLOOP
    help

if AOS_APP_HELLOWORLD
# Configurations for app helloworld
endif
```

## app/example/helloworld_nocli/Config.in
```kconfig
menuconfig AOS_APP_HELLOWORLD_NOCLI
    bool "helloworld_nocli"
    select AOS_COMP_BENCHMARKS if @CONDITION@
    select AOS_COMP_YLOOP
    help

if AOS_APP_HELLOWORLD_NOCLI
# Configurations for app helloworld_nocli
endif
```

## app/example/http2app/Config.in
```kconfig
config AOS_APP_HTTP2APP
    bool "HTTP2 Stream Sample"
    select AOS_COMP_CJSON
    select AOS_COMP_NETMGR
    select AOS_COMP_CLI
    select AOS_COMP_SDK_HTTP2
    help
        http2 stream examples

if AOS_APP_HTTP2APP
# Configurations for app http2app
endif
```

## app/example/httpapp/Config.in
```kconfig
config AOS_APP_HTTPAPP
    bool "HTTP Client Sample"
    select AOS_COMP_HTTP
    select AOS_COMP_NETMGR
    select AOS_COMP_LWIP
    select AOS_COMP_CLI
    help
        HTTP Client app

if AOS_APP_HTTPAPP

endif
```

## app/example/httpcapp/Config.in
```kconfig
config AOS_APP_HTTPCAPP
    bool "HTTP Client Sample"
    select AOS_COMP_HTTPC
    select AOS_COMP_NETMGR
    select AOS_COMP_LWIP
    select AOS_COMP_CLI
    help
        HTTP Client app

if AOS_APP_HTTPCAPP

endif
```

## app/example/i2c_hts221_test/Config.in
```kconfig
menuconfig AOS_APP_I2C_HTS221_TEST
    bool "i2c_hts221_test"
    select AOS_COMP_COMMON
    select AOS_COMP_SENSOR
    select AOS_COMP_CLI
    select AOS_COMP_CJSON
    select AOS_COMP_NETMGR
    select AOS_COMP_UDATA
    select AOS_COMP_BENCHMARKS if @CONDITION@
    select AOS_COMP_YLOOP
    help

if AOS_APP_I2C_HTS221_TEST
# Configurations for app i2c_hts221_test
endif
```

## app/example/id2_app/Config.in
```kconfig
menuconfig AOS_APP_ID2_CLIENT
    bool "id2_client"
    select AOS_COMP_IROT
    select AOS_COMP_ID2
    select AOS_COMP_ALICRYPTO
    help

if AOS_APP_ID2_CLIENT
# Configurations for app id2_client
endif
```

## app/example/itls_app/Config.in
```kconfig
config AOS_APP_ITLS_CLIENT
    bool "ITLS Client Sample"
    select AOS_COMP_CLI
    select AOS_COMP_ALICRYPTO
    select AOS_COMP_NETMGR
    select AOS_COMP_ID2
    select AOS_COMP_ITLS
    select AOS_COMP_LWIP if LWIP = 1
    help
        itls sample app

if AOS_APP_ITLS_CLIENT
# Configurations for app itls_client
endif
```

## app/example/jsengine_app/Config.in
```kconfig
config AOS_APP_JSENGINE_APP
    bool "JSEngine Firmware"
    select AOS_COMP_JSENGINE
    help
        build for JSEngine firmware

if AOS_APP_JSENGINE_APP
# Configurations for app jsengine_app
endif
```

## app/example/kernel_test/Config.in
```kconfig
menuconfig AOS_APP_KERNEL_TEST
    bool "kernel_test"
    select AOS_COMP_CERTIFICATE_TEST
    select AOS_COMP_CLI
    select AOS_COMP_BENCHMARKS if @CONDITION@
    select AOS_COMP_LOG
    help

if AOS_APP_KERNEL_TEST
# Configurations for app kernel_test
endif
```

## app/example/linkkit_gateway/Config.in
```kconfig
config AOS_APP_LINKKIT_GATEWAY
    bool "Linkkit Gateway Application"
    select AOS_COMP_CLI if !AOS_BOARD_ESP8266
    select AOS_COMP_OTA
    select AOS_COMP_CJSON
    select AOS_COMP_NETMGR
    select AOS_COMP_LWIP if LWIP = 1
    select AOS_COMP_LINKKIT_SDK_C
    select APP_FEATURE_LINKKIT_GATEWAY
    help
        linkkit gateway examples

if AOS_APP_LINKKIT_GATEWAY
# Configurations for app linkkit_gateway

config LINKKIT_GATEWAY_CONFIG_DEPRECATED
    bool "Use Deprecated API"
    default n
    help
    use deprecated api,compatible with aos2.0 and earlier, not recommended

config LINKKIT_GATEWAY_CONFIG_PRINT_HEAP
    bool "Show Free Heap Duration"
    default n
    help
    displays heap space periodically for debug

endif
```
