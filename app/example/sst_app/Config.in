## app/example/sst_app/Config.in
```kconfig
menuconfig AOS_APP_SST_TEST
    bool "sst_test"
    select AOS_COMP_LIBSST
    select AOS_COMP_ALICRYPTO
    help

if AOS_APP_SST_TEST
# Configurations for app sst_test
endif
```

## app/example/syscall/Config.in
```kconfig
menuconfig AOS_APP_SYSCALL
    bool "syscall"
    select AOS_COMP_BENCHMARKS if @CONDITION@
    select AOS_COMP_CLI
    select AOS_COMP_YLOOP
    help

if AOS_APP_SYSCALL
# Configurations for app syscall
endif
```

## app/example/tinyengine_app/Config.in
```kconfig
menuconfig AOS_APP_TINYENGINE_APP
    bool "tinyengine_app"
    select AOS_COMP_COMMON
    select AOS_COMP_SPIFFS
    select AOS_COMP_LOG
    select AOS_COMP_CJSON
    select AOS_COMP_NETMGR
    select AOS_COMP_TINY_ENGINE
    select AOS_COMP_YLOOP
    select AOS_COMP_OTA
    select AOS_COMP_CLI
    help

if AOS_APP_TINYENGINE_APP
# Configurations for app tinyengine_app
endif
```

## app/example/tls/Config.in
```kconfig
config AOS_APP_TLS_CLIENT
    bool "Alicrypto TLS Client Sample"
    select AOS_COMP_IMBEDTLS
    select AOS_COMP_NETMGR
    select AOS_COMP_CLI
    select AOS_COMP_ALICRYPTO
    help
        TLS client example for imbedtls

if AOS_APP_TLS_CLIENT
# Configurations for app tls_client

config TLS_CLIENT_CONFIG_DTLS_ENABLED
    bool "Enable DTLS"
    default n
    help

endif
```

## app/example/uai_demo/uai_cifar10_demo/Config.in
```kconfig
config AOS_APP_UAI_CIFAR10_DEMO
    bool "uAI CIFAR10 DEMO"
    select AOS_COMP_UAI
    help
        uAI CIFAR10 DEMO
```

## app/example/uai_demo/uai_kws_demo/Config.in
```kconfig
config AOS_APP_UAI_KWS_DEMO
    bool "uAI KWS DEMO"
    select AOS_COMP_UAI
    help
        uAI KWS DEMO
```

## app/example/uapp1/Config.in
```kconfig
menuconfig AOS_APP_UAPP1
    bool "uapp1"
    help

if AOS_APP_UAPP1
# Configurations for app uapp1
endif
```

## app/example/uapp2/Config.in
```kconfig
menuconfig AOS_APP_UAPP2
    bool "uapp2"
    help

if AOS_APP_UAPP2
# Configurations for app uapp2
endif
```

## app/example/udata_demo/sensor_cloud_demo/Config.in
```kconfig
config AOS_APP_SENSOR_CLOUD_DEMO
    bool "Sensor Cloud Demo"
    select AOS_COMP_CLI
    select AOS_COMP_SENSOR
    select AOS_COMP_NETMGR
    select AOS_COMP_YLOOP
    select AOS_COMP_CJSON
    select AOS_COMP_LINKKIT_SDK_C
    select APP_FEATURE_LINKKIT
    help
        sensor cloud demo

if AOS_APP_SENSOR_CLOUD_DEMO
# Configurations for comp sensor hal

endif
```

## app/example/udata_demo/sensor_local_demo/Config.in
```kconfig
config AOS_APP_SENSOR_LOCAL_DEMO
    bool "Sensor Local Demo"
    select AOS_COMP_CLI
    select AOS_COMP_SENSOR
    help
        sensor local demo

if AOS_APP_SENSOR_LOCAL_DEMO
# Configurations for comp sensor hal
endif
```

## app/example/udata_demo/udata_cloud_demo/Config.in
```kconfig
config AOS_APP_UDATA_CLOUD_DEMO
    bool "uData Cloud Demo"
    select AOS_COMP_CLI
    select AOS_COMP_UDATA
    select AOS_COMP_NETMGR
    select AOS_COMP_YLOOP
    select AOS_COMP_CJSON
    select AOS_COMP_LINKKIT_SDK_C
    select APP_FEATURE_LINKKIT
    help
        uData cloud demo

if AOS_APP_UDATA_CLOUD_DEMO
# Configurations for comp udata


endif
```

## app/example/udataapp/Config.in
```kconfig
config AOS_APP_UDATAAPP
    bool "udataapp"
    select AOS_COMP_CLI
    select AOS_COMP_SENSOR
    select AOS_COMP_UDATA
    select AOS_COMP_NETMGR if AOS_CONFIG_DTC_MQTT || AOS_CONFIG_DTC_LINKKIT
    select AOS_COMP_YLOOP if AOS_CONFIG_DTC_MQTT || AOS_CONFIG_DTC_LINKKIT    
    select AOS_COMP_CJSON if AOS_CONFIG_DTC_LINKKIT
    select AOS_COMP_LWIP if AOS_CONFIG_DTC_LINKKIT && LWIP = 1   
    select AOS_COMP_LINKKIT_SDK_C if AOS_CONFIG_DTC_ENABLE
    select APP_FEATURE_LINKKIT if AOS_CONFIG_DTC_LINKKIT
    select APP_FEATURE_LINKKIT_MQTT if AOS_CONFIG_DTC_MQTT
    help
        uData sensor framework demo

if AOS_APP_UDATAAPP
# Configurations for comp udata

config AOS_CONFIG_DTC_ENABLE
    bool "Data to Cloud"
    default n
    help
 
if AOS_CONFIG_DTC_ENABLE
  choice
      prompt "Data To Cloud list"
      default AOS_CONFIG_DTC_MQTT
      help
          This is 'DTC choice' list sample

      config AOS_CONFIG_DTC_LINKKIT
          bool "linkkit"
          help
              Enable linkkit
      config AOS_CONFIG_DTC_MQTT
          bool "mqtt"
          help
              Enable mqtt

  endchoice
endif

if AOS_CONFIG_DTC_LINKKIT
config LWIP
    int "LWIP"
    range 0 1
    default 1
endif

config AOS_CONFIG_DTC_TYPE
    string
    default "linkkit" if AOS_CONFIG_DTC_LINKKIT
    default "mqtt" if AOS_CONFIG_DTC_MQTT

endif
```

## app/example/udevapp/Config.in
```kconfig
config AOS_APP_UDEVAPP
    bool "uDev Sample"
    select AOS_COMP_CLI
    select AOS_COMP_KV
    select AOS_COMP_UDEV
    select AOS_COMP_NETMGR
    help
        uDev(Developerment Over-The-Air) sample code

if AOS_APP_UDEVAPP
# Configurations for comp udev

endif
```

## app/example/ulocation/qianxunapp/Config.in
```kconfig
config AOS_APP_QIANXUNAPP
    bool "qianxunapp"
    select AOS_COMP_ULOCATION
    select AOS_COMP_CLI
    select AOS_COMP_YLOOP
    select AOS_COMP_NETMGR
    select QXWZ_ENABLED
    help

if AOS_APP_QIANXUNAPP
# Configurations for app qianxunapp
endif
```

## app/example/ulocationapp/Config.in
```kconfig
config AOS_APP_ULOCATIONAPP
    bool "ulocationapp"
    select AOS_COMP_CLI if AOS_BOARD_ESP8266
    select AOS_COMP_NETMGR
    select AOS_COMP_OTA
    select AOS_COMP_CJSON
    select AOS_COMP_ULOCATION
    select AOS_COMP_LINKKIT_SDK_C
    select APP_FEATURE_LINKKIT    
    select AOS_COMP_BREEZE if LINKKITAPP_CONFIG_COMBOAPP
    select AOS_COMP_BT_BREEZE_HAL if LINKKITAPP_CONFIG_COMBOAPP
    select AOS_COMP_BT_PROFILE if LINKKITAPP_CONFIG_COMBOAPP
    help
        ulocationapp

if AOS_APP_ULOCATIONAPP
# Configurations for app ulocationapp

endif
```

## app/example/vflashdemo/Config.in
```kconfig
menuconfig AOS_APP_VFLASHDEMO
    bool "vflashdemo"
    select AOS_COMP_BENCHMARKS if @CONDITION@
    help

if AOS_APP_VFLASHDEMO
# Configurations for app vflashdemo
endif
```

## app/example/wifihalapp/Config.in
```kconfig
menuconfig AOS_APP_WIFIHALAPP
    bool "wifihalapp"
    select AOS_COMP_CLI
    select AOS_COMP_YLOOP
    select AOS_COMP_HALWIFI
    help

if AOS_APP_WIFIHALAPP
# Configurations for app wifihalapp
endif
```

## app/example/wifimonitor/Config.in
```kconfig
menuconfig AOS_APP_WIFIMONITOR
    bool "wifimonitor"
    select AOS_COMP_UMESH
    select AOS_COMP_NETMGR
    select AOS_COMP_LWIP if @CONDITION@
    select AOS_COMP_LOG
    select AOS_COMP_CLI
    help

if AOS_APP_WIFIMONITOR
# Configurations for app wifimonitor
endif
```

## app/example/yts/Config.in
```kconfig
config AOS_APP_YTS
    bool "Test Suite"
    select AOS_COMP_ULOG
    select AOS_COMP_LWIP if AOS_BOARD_LINUXHOST || AOS_BOARD_ARMHFLINUX
    select AOS_COMP_CLI if !AOS_BOARD_LINUXHOST && !AOS_BOARD_ARMHFLINUX
    select AOS_COMP_NETMGR if AOS_BOARD_LINUXHOST || AOS_BOARD_ARMHFLINUX
    select AOS_COMP_TESTCASE
    select AOS_COMP_UMESH if AOS_BOARD_LINUXHOST || AOS_BOARD_ARMHFLINUX
    select AOS_COMP_FATFS if AOS_BOARD_LINUXHOST || AOS_BOARD_ARMHFLINUX
    select AOS_COMP_YLOOP
    select AOS_COMP_DDA if AOS_BOARD_LINUXHOST || AOS_BOARD_ARMHFLINUX
    select AOS_COMP_VFS
    help
      AliOS Things test suite


if AOS_APP_YTS
# Configurations for app yts
endif
```

## app/profile/Config.in
```kconfig
menuconfig AOS_APP_PROFILE
    bool "Builtin Profiles"
    default n
if AOS_APP_PROFILE
choice
    prompt "Select profile"

config AOS_app_gatewayapp
    bool "gatewayapp"
    select AOS_APP_GATEWAYAPP

endchoice

if AOS_app_gatewayapp
    config AOS_BUILD_APP
        default "gatewayapp"

    source "app/profile/gatewayapp/Config.in"
endif

endif
```

## app/profile/gatewayapp/Config.in
```kconfig
config AOS_APP_GATEWAYAPP
    bool "Gateway Profile"
    select AOS_COMP_SENSOR
    select AOS_COMP_CJSON
    select AOS_COMP_NETMGR
    select AOS_COMP_UDATA
    select AOS_COMP_MBMASTER
    select AOS_COMP_LINKKIT_SDK_C
    select APP_FEATURE_LINKKIT_NOAWSS if APP_GATEWAYAPP_CONFIG_DTC
    select AOS_COMP_LWIP if LWIP = 1 && APP_GATEWAYAPP_CONFIG_DTC
    select AOS_COMP_CLI if AOS_BOARD_ESP8266 && APP_GATEWAYAPP_CONFIG_DTC
#    select AOS_UNKNOWN_WEBSOCKETS if APP_GATEWAYAPP_CONFIG_GW_LINKED && APP_GATEWAYAPP_CONFIG_DT 
    help
      gateway profile

if AOS_APP_GATEWAYAPP
# Configurations for app gatewayapp

config LWIP
    int "LWIP"
    range 0 1
    default 0

config APP_GATEWAYAPP_CONFIG_PT_SCANNER
    int "Device model: scanner"
    range 0 1
    default 1
    help

config APP_GATEWAYAPP_CONFIG_PT_SENSOR
    int "Device model: MODBUS/CAN sensors"
    range 0 1
    default 0
    help

config AOS_CONFIG_DTC_ENABLE
    bool "data to cloud"
    default n
    help

endif
```

## application/example/BLENetConfig_demo/Config.in
```kconfig
config AOS_APP_BLENETCONFIG_DEMO
    bool "BLE NetConfig Demo"
    select AOS_COMP_OSAL_AOS if !AOS_CREATE_PROJECT
    help
        BLE NetConfig demo

if AOS_APP_BLENETCONFIG_DEMO
	# Configurations for app BLENetConfig_demo
	config SYSINFO_APP_VERSION
		string "Firmware Version"
		default "app-1.0.0-20200214.140831"
		help
			application main firmware version
		
	config AOS_NETMGR_WITH_CLASSIC
        bool "NETMGR_WITH_CLASSIC"
		default y
        help
            default case
	
	config AOS_NET_WITH_WIFI
			bool "NETMGR_WITH_WIFI"
			default y
			help
				default case	
	
endif
```

## application/example/BLE_demo/Config.in
```kconfig
config AOS_APP_BLE_DEMO
    bool "BLE Demo"
    select AOS_COMP_OSAL_AOS if !AOS_CREATE_PROJECT
    help
        BLE demo

if AOS_APP_BLE_DEMO
# Configurations for app BLE_demo
config SYSINFO_APP_VERSION
    string "Firmware Version"
    default "app-1.0.0-20200214.140831"
    help
        application main firmware version
endif
```
