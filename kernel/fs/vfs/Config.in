## kernel/fs/vfs/Config.in
```kconfig
menuconfig AOS_COMP_VFS
    bool "vfs"
    default y
    help

if AOS_COMP_VFS
# Configurations for component vfs
endif
```

## kernel/fs/vfs/device/Config.in
```kconfig
menuconfig AOS_COMP_VFS_DEVICE
    bool "vfs_device"
    default n
    help

if AOS_COMP_VFS_DEVICE
# Configurations for component vfs_device
endif
```

## kernel/fs/vfs/posix/Config.in
```kconfig
menuconfig AOS_COMP_VFS_POSIX
    bool "vfs_posix"
    default n
    help

if AOS_COMP_VFS_POSIX
# Configurations for component vfs_posix
endif
```

## kernel/init/Config.in
```kconfig
config AOS_COMP_KERNEL_INIT
    bool "AliOS Things Init Funciton"
    default n
    select AOS_COMP_ULOG
    help
       AliOS Things initialization function
```

## kernel/init/mbins_entry/Config.in
```kconfig
menuconfig AOS_COMP_MBINS_ENTRY
    bool "mbins_entry"
    default n
    help

if AOS_COMP_MBINS_ENTRY
# Configurations for component mbins_entry
endif
```

## kernel/mbins/kmbins/Config.in
```kconfig
config AOS_COMP_KMBINS
    bool "kmbins"
    default n
    help

if AOS_COMP_KMBINS
# Configurations for component kmbins
endif
```

## kernel/mbins/umbins/Config.in
```kconfig
config AOS_COMP_UMBINS
    bool "umbins"
    default n
    help

if AOS_COMP_UMBINS
# Configurations for component umbins
endif
```

## kernel/mm/Config.in
```kconfig
config AOS_COMP_MM
    bool "Memory Management Algorithm"
    default y
    help
        AliOS Things Memory Management Algorithm

if AOS_COMP_MM
# Configurations for component mm
endif
```

## kernel/posix/Config.in
```kconfig
menuconfig AOS_COMP_POSIX
    bool "posix"
    default n
    select AOS_COMP_RHINO
    help

if AOS_COMP_POSIX
# Configurations for component posix
endif
```

## kernel/pwrmgmt/Config.in
```kconfig
menuconfig AOS_COMP_PWRMGMT
    bool "Power Management"
    default n
    help
        power management

if AOS_COMP_PWRMGMT
# Configurations for component pwrmgmt
config PWRMGMT_CONFIG_SHOW
    bool "PWRMGMT_CONFIG_SHOW"
        default n
        help
            excludes this feature if you want to call state show function:enable cpu_pwr_c_support_print,
            cpu_pwr_info_show,cpu_pwr_state_show.
            default n

config PWRMGMT_CONFIG_DEBUG
    bool "PWRMGMT_CONFIG_DEBUG"
        default n
        help
            excludes this feature if you want to show debug infomation.
            default n
endif
```

## kernel/rhino/Config.in
```kconfig
config AOS_COMP_RHINO
    bool "Kernel Core(rhino)"
    default y
    help
        AliOS things kernel core(rhino)

#if AOS_COMP_RHINO
if 0
# Configurations for component rhino

config RHINO_CONFIG_SEM
    int "RHINO_CONFIG_SEM"
    range 0 1
    default 1
    help
       set to 1 if you want to enable sem, set to 0 to disable sem,
       default 1

config RHINO_CONFIG_QUEUE
    int "RHINO_CONFIG_QUEUE"
    range 0 1
    default 1
    help
       set to 1 if you want to enable queue, set to 0 to disable queue,
       default 1

config RHINO_CONFIG_BUF_QUEUE
    int "RHINO_CONFIG_BUF_QUEUE"
    range 0 1
    default 1
    help
       set to 1 if you want to enable buf_queue, set to 0 to disable buf_queue,
       default 1

config RHINO_CONFIG_WORKQUEUE
    int "RHINO_CONFIG_WORKQUEUE"
    range 0 1
    default 0
    help
       set to 1 if you want to enable workqueue, set to 0 to disable workqueue,
       default 0

if RHINO_CONFIG_WORKQUEUE = 1

config RHINO_CONFIG_WORKQUEUE_STACK_SIZE
    int "RHINO_CONFIG_WORKQUEUE_STACK_SIZE"
    default 512
    help
       setting the task stack size of the workqueue task, default 512 * 4 bytes

config RHINO_CONFIG_WORKQUEUE_TASK_PRIO
    int "RHINO_CONFIG_WORKQUEUE_TASK_PRIO"
    range 0 256
    default 20
    help
       setting the task pri of the workqueue task, default 20

endif

config RHINO_CONFIG_TIMER
    int "RHINO_CONFIG_TIMER"
    range 0 1
    default 1
    help
       set to 1 if you want to enable timer, set to 0 to disable timer, default 1

if RHINO_CONFIG_TIMER = 1

config RHINO_CONFIG_TIMER_TASK_STACK_SIZE
    int "RHINO_CONFIG_TIMER_TASK_STACK_SIZE"
    default 200
    help
       setting the task stack size of the timer task, default 200 * 4 bytes
       (depend on the stack size of the timer hook function)

config RHINO_CONFIG_TIMER_TASK_PRI
    int "RHINO_CONFIG_TIMER_TASK_PRI"
    range 0 256
    default 5
    help
       setting the task pri of the timer task, default 5

endif

config RHINO_CONFIG_MM_TLF
    int "RHINO_CONFIG_MM_TLF"
    range 0 1
    default 1
    help
       set to 1 if you want to enable mm tlf, set to 0 to disable mm tlf,
       default 1

if RHINO_CONFIG_MM_TLF = 1

config RHINO_CONFIG_MM_DEBUG
    int "RHINO_CONFIG_MM_DEBUG"
    range 0 1
    default 0
    help
       set to 1 if you want to enable mm debug, set to 0 to disable debug,
       default 0

endif

config RHINO_CONFIG_SCHED_RR
    int "RHINO_CONFIG_SCHED_RR"
    range 0 1
    default 1
    help
       set to 1 if you want to enable round robin, set to 0 to disable round robin,
       default 1

if RHINO_CONFIG_SCHED_RR = 1

config RHINO_CONFIG_TIME_SLICE_DEFAULT
    int "RHINO_CONFIG_TIME_SLICE_DEFAULT"
    default 50
    help
       setting the value of time slice, default 50ms

endif

config RHINO_CONFIG_TICKS_PER_SECOND
    int "RHINO_CONFIG_TICKS_PER_SECOND"
    default 100
    help
       setting the value of ticks/s, default 100

config RHINO_CONFIG_PRI_MAX
    int "RHINO_CONFIG_PRI_MAX"
    range 0 256
    default 62
    help
       setting the max value of task pri, default 62, max=256,
       the higher of the value, the lower of the priority

config RHINO_CONFIG_TASK_STACK_OVF_CHECK
    int "RHINO_CONFIG_TASK_STACK_OVF_CHECK"
    range 0 1
    default 1
    help
       set to 1 if you want to enable stack overflow check,
       set to 0 to disable stack overflow check, default 1

config RHINO_CONFIG_IDLE_TASK_STACK_SIZE
    int "RHINO_CONFIG_IDLE_TASK_STACK_SIZE"
    default 100
    help
       setting the task stack size of the idle task, default 100 * 4 bytes
       (depend on the stack size of the idle hook function)

endif
```

## kernel/rhino/bus/usb/usb_device/Config.in
```kconfig
menuconfig AOS_COMP_USB_DEVICE
    bool "usb_device"
    default n
    help

if AOS_COMP_USB_DEVICE
# Configurations for component usb_device
endif
```

## kernel/rhino/bus/usb/usb_host/Config.in
```kconfig
menuconfig AOS_COMP_USB_HOST
    bool "usb_host"
    default n
    help

if AOS_COMP_USB_HOST
# Configurations for component usb_host
endif
```

## kernel/rhino/core/Config.in
```kconfig
menuconfig RHINO_ENABLED
    bool "FEATURE_RHINO_ENABLE"
    default y
    help
        AliOS things kernel core

if RHINO_ENABLED
menu "RHINO Configurations"

endmenu
endif
```

## kernel/rhino/mm/Config.in
```kconfig
menuconfig MM_ENABLED
#    depends on RHINO_ENABLED
    bool "FEATURE_MM_ENABLE"
    default y
    help
        AliOS things Memory Management

if MM_ENABLED
menu "MM Configurations"

endmenu
endif
```

## kernel/rhino/pwrmgmt/Config.in
```kconfig
menuconfig AOS_COMP_PWRMGMT
    bool "pwrmgmt"
    default n
    help

if AOS_COMP_PWRMGMT
# Configurations for component pwrmgmt
endif
```

## kernel/rhino/test/Config.in
```kconfig
menuconfig AOS_COMP_TEST
    bool "test"
    default n
    help

if AOS_COMP_TEST
# Configurations for component test
endif
```

## kernel/rhino/test/realtime/Config.in
```kconfig
menuconfig AOS_COMP_REALTIME
    bool "realtime"
    default n
    select AOS_COMP_RHINO
    help

if AOS_COMP_REALTIME
# Configurations for component realtime
endif
```

## kernel/rhino/uspace/Config.in
```kconfig
menuconfig AOS_COMP_USPACE
    bool "uspace"
    default n
    help

if AOS_COMP_USPACE
# Configurations for component uspace
endif
```

## kernel/uspace/Config.in
```kconfig
config AOS_COMP_USPACE
    bool "user space"
    default n
    help
        set to y if you want to enable user space feature in kernel,
        set to n to disable user space feature.

if AOS_COMP_USPACE
# Configurations for component uspace

endif
```

## kernel/vcall/espos/Kconfig
```kconfig
menu "ESPOS"

config ESPOS
    bool "Enable Espressif RTOS abstract API"
    default y
    help
        If this feature is enabled, system will use Espressif RTOS abstract APIs instead of RTOS real APIs.

        This option is not currently used anywhere.

endmenu
```

## middleware/jsengine/Config.in
```kconfig
menuconfig AOS_COMP_JSENGINE
    bool "JSEngine"
    select AOS_COMP_MBEDTLS
    select AOS_COMP_SPIFFS
    select AOS_COMP_CLI
    select MBEDTLS_CONFIG_CRYPTO_MD5 if AOS_COMP_MBEDTLS
    select AOS_COMP_CJSON
    select AOS_COMP_SDK_MQTT
    select AOS_COMP_HTTP
    select AOS_COMP_YLOOP
    select AOS_COMP_OTA
    select AOS_COMP_LINKKIT_SDK_C
    select APP_FEATURE_LINKKIT_MQTT
    select AOS_COMP_LOG
    select AOS_COMP_NETMGR
    default n
    help

if AOS_COMP_JSENGINE
# Configurations for comp JSEngine

choice
    prompt "Choose Engine Type: "
    default JSE_ENGINE_MINI
    help
      Choose Engine Type. (Default: LiteJSE).

    config JSE_ENGINE_MINI
        bool "MiniJSE"
        help
            LiteEngine is independent develop by Alibaba.

    config JSE_ENGINE_DUKTAPE
        bool "DuktapeJSE"
        help
            Duktape is an OpenSource embeddable Javascript engine, with a focus on portability
            and compact footprint. (check https://github.com/svaarala/duktape).
endchoice

# addons configuration
source "middleware/jsengine/src/engine/Config.in"
source "middleware/jsengine/src/services/Config.in"

endif
```

## middleware/jsengine/src/jse/Config.in
```kconfig
menu "JSEngine Addon Modules"

menu "Core Addon Modules"

config JSE_CORE_ADDON_BUILDIN
    bool "BuildIn Module"
    default y
    help 
        JSEngine js core addon of BuildIn module support

config JSE_CORE_ADDON_TIMER
    bool "TIMER"
    default y
    help 
        JSEngine js core addon of timer support

config JSE_CORE_ADDON_PROCESS
    bool "PROCESS"
    default y
    help 
        JSEngine js core addon of process support

config JSE_CORE_ADDON_FS
    bool "FileSystem"
    default n
    help 
        JSEngine js  addon of FileSystem,File.open,File.write

endmenu  #endmenu of JSE Core Addon Modules

menu "Protocol & Network & System Addon Modules"

config JSE_NET_ADDON_MQTT
    bool "MQTT"
    default n
    help 
        JSEngine js addon of mqtt

config JSE_NET_ADDON_NET
    bool "NET"
    default n
    help 
        JSEngine js addon of TCP 

config JSE_NET_ADDON_UDP
    bool "UDP"
    default n
    help 
        JSEngine js hardware addon of UDP

config JSE_NET_ADDON_HTTP
    bool "HTTP"
    default n
    help 
        JSEngine js addon of HTTP

config JSE_NET_ADDON_MIIO
    bool "Miio Device"
    default n
    help 
        JSEngine js device addon of miio protocol

endmenu # endmenu of JSE Protocol and Network Addon Modules

menu "Hardware Addon Modules"

config JSE_HW_ADDON_GPIO
    bool "GPIO"
    default n
    help 
        JSEngine js hardware addon of GPIO control


config JSE_HW_ADDON_UART
    bool "UART"
    default n
    help 
        JSEngine js hardware addon of uart 

config JSE_HW_ADDON_ADC
    bool "ADC"
    default n
    help 
        JSEngine js hardware addon of ADC

config JSE_HW_ADDON_DAC
    bool "DAC"
    default n
    help 
        JSEngine js hardware addon of DAC


config JSE_HW_ADDON_I2C
    bool "I2c"
    default n
    help 
        JSEngine js hardware addon of I2c

config JSE_HW_ADDON_IR
    bool "IR"
    default n
    help 
        JSEngine js hardware addon of IR

config JSE_HW_ADDON_LCD
    bool "LCD"
    default n
    help 
        JSEngine js hardware addon of LCD

config JSE_HW_ADDON_PWM
    bool "PWM"
    default n
    help 
        JSEngine js hardware addon of PWM

config JSE_HW_ADDON_WIFI
    bool "WIFI"
    default n
    help 
        JSEngine js hardware addon of WIFI

config JSE_HW_ADDON_RTC
    bool "RTC"
    default n
    help 
        JSEngine js hardware addon of rtc

config JSE_HW_ADDON_WDG
    bool "WatchDog"
    default n
    help 
        JSEngine js hardware addon of watchdog

endmenu
endmenu  # JS Addon Modules
```

## middleware/jsengine/src/services/Config.in
```kconfig
menu "JSEngine Service Support"

config JSE_IDE_DEBUG
    bool "IDE Debug Support"
    default "y"
    help
        Support Local IDE or LinkDevelop Console connect to tinyengine device 

config JSE_CLI_DEBUG
    bool "Command line Interface Debug"
    default "y"
    help 
        Command line Interface Debug

endmenu  # JSEngine Service Support
```

## middleware/linkkit/Config.in
```kconfig
    config SRCPATH
        string
        default "middleware/linkkit"

menu "Link Kit Configurations"

source "$SRCPATH/mqtt/Config.in"
source "$SRCPATH/dev_model/Config.in"
source "$SRCPATH/dev_bind/Config.in"
source "$SRCPATH/wifi_provision/Config.in"
source "$SRCPATH/http2/Config.in"
source "$SRCPATH/iot_http/Config.in"
source "$SRCPATH/iot_coap/Config.in"
source "$SRCPATH/dev_sign/Config.in"
source "$SRCPATH/dev_reset/Config.in"
source "$SRCPATH/dynamic_register/Config.in"
source "$SRCPATH/infra/Config.in"
source "$SRCPATH/wrappers/Config.in"
source "$SRCPATH/certs/Config.in"
endmenu
```
