## kernel/bus/mbmaster/Config.in
```kconfig
menuconfig AOS_COMP_MBMASTER
    bool "Modbus Master Support"
    default n
    help
        modbus master library support

if AOS_COMP_MBMASTER

config MBMASTER_CONFIG_RTU_ENABLED
    bool "MBMASTER_CONFIG_RTU_ENABLED"
        default y
        help
            excludes this feature if you want to use modbus master with rtu.
            default y

config MBMASTER_CONFIG_READ_HOLDING
    bool "MBMASTER_CONFIG_READ_HOLDING"
        default y
        help
            excludes this feature if you want to use the read holding register function of modbus master.
            default y

config MBMASTER_CONFIG_HANDLER_MAX
    int "MBMASTER_CONFIG_HANDLER_MAX"
        range 0 10
        default 1
        help
            config the number of handler resources. The task which want to communication with modbus master stack
            must call mb_alloc_handler to alloc a handler.
            default 1

config MBMASTER_CONFIG_LOG_LEVEL
    int "MBMASTER_CONFIG_LOG_LEVEL"
        range 0 1
        default 0
        help
            set 0 to show information only when error happend. set 1 to show more information(error and debug).
            default 0

endif
```

## kernel/bus/usb/Config.in
```kconfig
config AOS_COMP_USB
    bool "USB Support"
    default n
    help
        usb host library and usb device library support
```

## kernel/cli/Config.in
```kconfig
menuconfig AOS_COMP_CLI
    bool "Command-Line Interface"
    select AOS_COMP_DEBUG
    select AOS_COMP_ULOG
    default n
    help
      command-line interface

if AOS_COMP_CLI

config CLI_CONFIG_MINIMUM_MODE
    int "Minimum Working Mode Support"
    range 0 1
    default 0
    help
        This option enables the cli minimum working mode support.
        saying "1" here is enabled the feature.
        saying "0" here is disabled.
        the default is "0"

config CLI_CONFIG_INBUF_SIZE
    int "Input buffer size (bytes)"
    default 256
    help
        This option sets the input buffer size.
        the value could be 32, 64, 128, 256, 512, 1024 ...
        the default is 256.

config CLI_CONFIG_OUTBUF_SIZE
    int "Output buffer size (bytes)"
    default 512
    help
        This option sets the output buffer size.
        the value could be 128, 256, 512, 1024, 2048 ...
        the default is 512.

config CLI_CONFIG_MAX_COMMANDS
    int "The maximum number of commands"
    default 64
    help
        This option sets the maximum number of CLI commands.
        the value could be 16, 32, ... 64, 88 ...
        the default is 64.

config CLI_CONFIG_MAX_ARG_NUM
    int "The maximum number of command arguments"
    default 16
    help
        This option sets the maximum number of command arguments.
        the value could be 4, 6, 8, 16, 20 ...
        the default is 16.

config CLI_CONFIG_MAX_ONCECMD_NUM
    int "The maximum number of commands in one line"
    default 4
    help
        This option sets the maximum number of commands in one line.
        the value could be 1, 2, 3, 4, 5 ...
        the default is 4.

config CLI_CONFIG_TASK_PRIORITY
    int "The CLI task priority"
    range 0 256
    default 60
    help
        This option sets the CLI task priority.
        the higher of the value, the lowest of the priority.
        the default is 60.

config CLI_CONFIG_TELNET_SUPPORT
    int "Telnet Support"
    range 0 1
    default 0
    help
        This option enable the telnel support for Command-Line Interface module.
        saying "1" here enables the feature.
        saying "0" is disabled.
        the default is "0"

endif
```

## kernel/core/debug/Config.in
```kconfig
menuconfig AOS_COMP_DEBUG
    bool "Coredump and debug Support"
    depends on AOS_COMP_RHINO
    default n
    help
        coredump and support debug cmd

if AOS_COMP_DEBUG
# Configurations for component debug


config DEBUG_CONFIG_CPUUSAGE_MAX_TASK
    int "The count of tasks recorded to file about cpuusage"
        default 80
        help
            default is 80
            enbaled only "-f" is used in cpuusage cli cmd

config DEBUG_CONFIG_CPUUSAGE_FILE_NAME
    string "file path of cpuusage recorded to"
    default "/data/cpuusage"
    help
        "set path of cpuusage recorded file, enbaled only "-f" is used in cpuusage cli cmd"

endif
```

## kernel/core/epoll/Config.in
```kconfig
if AOS_CREATE_PROJECT
config AOS_COMP_EPOLL
    bool
    select AOS_COMP_VFS
    select AOS_COMP_LIB_RBTREE
    select RHINO_CONFIG_EPOLL_SYSCALL
    default y
    help
        epoll implementation
endif

# Backward compatibility
if !AOS_CREATE_PROJECT
config AOS_COMP_EPOLL
    bool "epoll"
    default n
    select AOS_COMP_VFS
    select AOS_COMP_LIB_RBTREE
    select RHINO_CONFIG_EPOLL_SYSCALL
    help
        epoll implementation
endif

if AOS_COMP_EPOLL
config EPOLL_SUPPORT_LWIP
    bool
    default y
    help
        support lwip socket
endif

###################################################################
# Component configuration items
```

## kernel/core/init/Config.in
```kconfig
config AOS_COMP_KERNEL_INIT
    bool "Initialize Function"
    default n
    help
       AliOS Things initialize function
```

## kernel/core/kobj_core/Config.in
```kconfig
config AOS_COMP_KOBJ_CORE
    bool
    default n
    help
      kernel object framework. Kernel is used to manage kernel resource.
      For example, task, process, IPC, memory etc. User code should call
      kernel function though system object mechanism.
```

## kernel/core/kv/Config.in
```kconfig
menuconfig AOS_COMP_KV
    bool "Key-value Storage"
    select AOS_COMP_NAND_KV if KV_CONFIG_USE_NAND
    select AOS_COMP_NOR_KV if KV_CONFIG_USE_NOR
    default n
    help
      lightweight key-value storage module.

if AOS_COMP_KV
# Configurations for component kv

choice
    prompt "Choose storage Type"
    default KV_CONFIG_USE_NAND if AOS_PLATFORM_CONFIG_USE_NAND
    default KV_CONFIG_USE_NOR
    help
        Select the type of the storage type used (NAND or NOR Flash).

    config KV_CONFIG_USE_NOR
        bool "NOR"

    config KV_CONFIG_USE_NAND
        bool "NAND"
endchoice

if KV_CONFIG_USE_NOR
source "kernel/core/kv/nor_kv/Config.in"
endif

if KV_CONFIG_USE_NAND
source "kernel/core/kv/nand_kv/Config.in"
endif

endif
```

## kernel/core/kv/nand_kv/Config.in
```kconfig
menuconfig AOS_COMP_NAND_KV
    bool "Key-value Storage for NAND"
    default n
    help
      lightweight key-value storage module for NAND Flash

if AOS_COMP_NAND_KV
# Configurations for component kv

config KV_CONFIG_MAX_KEY_LEN
    int "The maximum length of key buffer (bytes)"
    default 128
    help
        This option sets the maximum length of key buffer.
        the value could be 32, 64, 128, 256 ...
        the default is 128.

config KV_CONFIG_MAX_VAL_LEN
    int "The maximum length of value buffer (bytes)"
    default 512
    help
        This options sets the maximum length of value buffer.
        the value could be 32, 64, 128, 256, 512, 1024 ...
        the default is 512.

config KV_CONFIG_PAGE_SIZE
    int "The size of a flash page (bytes)"
    default 4096
    help
        The size of a flash page, in byte unit.

config KV_CONFIG_BLOCK_SIZE
    int "The size of a flash block (bytes, spare area excluded)"
    default 262144
    help
        The size of a flash block, in byte unit. Spare area not included.

endif
```

## kernel/core/mk/kspace/Config.in
```kconfig
config AOS_CONFIG_USER_SPACE
    bool "aos micro kernel"
    select AOS_COMP_KSYSCALL
    select RHINO_CONFIG_USER_SPACE
    default y
    help
        "enable micro kernel feature for AliOS Things"


menu "micro kernel Configuration"
    depends on AOS_CONFIG_USER_SPACE

config RHINO_CONFIG_USER_SPACE
    bool "rhino micro kernel"
    default y
    help
        "enable kernel feature for rhino"

config RHINO_CONFIG_UCLI
    bool "UCLI"
    default y
    help
        "enable user space application uses CLI"

config RHINO_CONFIG_URES
    bool "URES"
    default y
    help
        "support kernel uses user space memory"

config RHINO_CONFIG_USIGNAL
    bool "USIGNAL"
    default y
    help
        "support signal for aos micro kernel."

config RHINO_CONFIG_UIPC
    bool "UIPC"
    default n
    help
        "support user space IPC"

config RHINO_CONFIG_UCALLBACK
    bool "UCALLBACK"
    default n
    help
        "support user space callback"

config RHINO_CONFIG_UFS
    bool "UFS"
    select RHINO_CONFIG_VFS_SYSCALL
    default n
    help
        "support user space VFS"

config RHINO_CONFIG_UTCPIP
    bool "UTCPIP"
    select CONFIG_AOS_TCPIP
    select RHINO_CONFIG_LWIP_SYSCALL
    help
        "support user space TCPIP"

config CONFIG_ASH_SCRIPT_FILE_NAME
    string "ash script file name"
    default "/system/aos.d"

source "kernel/core/mk/syscall/ksyscall/Config.in"

endmenu

source "kernel/core/mk/kspace/core_ipc/Config.in"
```

## kernel/core/mk/kspace/core_ipc/Config.in
```kconfig
config RHINO_CONFIG_IPC
    bool "Inter-Proccess Communication"
    default y
    help
        "enable inter-process communication"
```

## kernel/core/mk/syscall/ksyscall/Config.in
```kconfig
config AOS_COMP_KSYSCALL
    bool "Kernel Syscall"
    default n
    help
        "Kernel mode system call implementation"

if AOS_COMP_KSYSCALL
    menu "Ksyscall Configurations"

    config RHINO_CONFIG_DYN_SYSCALL_TBL
        bool "DYN syscall tbl"
        default n
        help
            "to support dynamically register and unregister syscall,
            if set to no, the syscall table will be placed at constant,
            data section to save RAM"
    endmenu
endif
```

## kernel/core/mk/syscall/usyscall/Config.in
```kconfig
config AOS_COMP_USYSCALL
    bool "Userspace Syscall"
    default n
    help
        "User mode system call implementation"

if AOS_COMP_USYSCALL

    config CONFIG_HAL_FLASH_SYSCALL
        bool "HAL Flash Syscall"
        default n
        help
            "enalbe hal flash syscall"

endif
```

## kernel/core/mk/uspace/Config.in
```kconfig
config RHINO_CONFIG_URES_TASK
    bool "ures task support"
    default y
    help
        "create ures task for the app"

if RHINO_CONFIG_URES_TASK
config RHINO_CONFIG_URES_TASK_PRIO
    int "ures task priority"
    default 15
    help
        "set ures task priority"

config RHINO_CONFIG_URES_TASK_KSTACK_SIZE
    int "ures task kstack size"
    default 512
    help
        "set ures taks kstack size, the unit is cpu_stack_t"

config RHINO_CONFIG_URES_TASK_USTACK_SIZE
    int "ures task ustack size"
    default 512
    help
        "set ures task ustack size, the unit is cpu_stack_t"
endif

config RHINO_CONFIG_UCLI_TASK
    bool "ucli task support"
    depends on RHINO_CONFIG_UCLI
    default y
    help
        "create ucli task to support user space CLI function"

if RHINO_CONFIG_UCLI_TASK
config RHINO_CONFIG_UCLI_TASK_PRIO
    int "ucli task priority"
    default 25
    help
        "set ucli task priority"

config RHINO_CONFIG_UCLI_TASK_KSTACK_SIZE
    int "ucli task kstack size"
    default 2048
    help
        "set ucli taks kstack size, the unit is cpu_stack_t"

config RHINO_CONFIG_UCLI_TASK_USTACK_SIZE
    int "ucli task ustack size"
    default 1024
    help
        "set ucli task ustack size, the unit is cpu_stack_t"
endif

config RHINO_CONFIG_UCALLBACK_TASK
    bool "ucallback task support"
    depends on RHINO_CONFIG_UCALLBACK
    default y
    help
        "create ucallback task to support user space callback function"

if RHINO_CONFIG_UCALLBACK_TASK
config RHINO_CONFIG_UCALLBACK_TASK_PRIO
    int "ucli task priority"
    default 4
    help
        "set ucallback task priority"

config RHINO_CONFIG_UCALLBACK_TASK_KSTACK_SIZE
    int "ucallback task kstack size"
    default 2048
    help
        "set ucallback taks kstack size, the unit is cpu_stack_t"

config RHINO_CONFIG_UCLI_TASK_USTACK_SIZE
    int "ucallback task ustack size"
    default 512
    help
        "set ucallback task ustack size, the unit is cpu_stack_t"

endif

config RHINO_CONFIG_UTIMER_TASK
    bool "utimer task support"
    default n
    help
        "create utimer task to support user space software timer"

if RHINO_CONFIG_UTIMER_TASK
config RHINO_CONFIG_UTIMER_TASK_PRIO
    int "utimer task priority"
    default 6
    help
        "set utimer task priority"

config RHINO_CONFIG_UTIMER_TASK_KSTACK_SIZE
    int "utimer task kstack size"
    default 512
    help
        "set utimer taks kstack size, the unit is cpu_stack_t"

config RHINO_CONFIG_UTIMER_TASK_USTACK_SIZE
    int "utimer task ustack size"
    default 512
    help
        "set utimer task ustack size, the unit is cpu_stack_t"

config RHINO_CONFIG_UTIMER_MSG_NUM
    int "utimer task max message number"
    default 6
    help
        "set the max message nubmer of utimer"
endif

config AOS_KERNEL_STACK_SIZE
    int "aos task kstack size"
    default 4096
    help
        "set task kstack size which is created by aos_task_new or aos_task_new_ext"

source "./kernel/core/mk/syscall/usyscall/Config.in"
```

## kernel/core/mk/uspace_lib/Config.in
```kconfig
menu "User space Configuration"

source "kernel/core/mk/uspace_lib/parcel/Config.in"
source "kernel/core/mk/uspace_lib/rpc/Config.in"
source "kernel/core/mk/uspace_lib/lwip/Config.in"
source "kernel/core/mk/uspace_lib/pm/Config.in"

endmenu
```

## kernel/core/mk/uspace_lib/lwip/Config.in
```kconfig
config AOS_COMP_USPACE_LWIP
    bool "User Space lwip API Support (obsolete)"
    default n
    help
        User Space lwip API is suppled by syscall
```

## kernel/core/mk/uspace_lib/parcel/Config.in
```kconfig
config AOS_COMP_USPACE_PARCEL
    bool "User Space Parcel API Support"
    default y
    help
        User space Parcel API support.
```

## kernel/core/mk/uspace_lib/pm/Config.in
```kconfig
config AOS_COMP_USPACE_PM
    bool "User Space PM API Support"
    default y
    help
        User space PM (Process load) API support.
```

## kernel/core/mk/uspace_lib/rpc/Config.in
```kconfig
config AOS_COMP_USPACE_RPC
    bool "User Space RPC API Support"
    default y
    help
        User space RPC (Remote Procedure Call) API support.
```

## kernel/core/osal/kobjs/Config.in
```kconfig
config AOS_COMP_KOBJS
    bool "kernel object layer"
    select AOS_COMP_KOBJ_CORE
    select CONFIG_KERNEL_OBJECT_SYSCALL
    default y
    help
      kernel object adapter layer.

if AOS_COMP_KOBJS

config AOS_KERNEL_OBJECT
    bool
    default y

config AOS_KOBJ_EVENT
    bool
    default y

config AOS_KOBJ_MUTEX
    bool
    default y

config AOS_KOBJ_QUEUE
    bool
    default y

config AOS_KOBJ_SEM
    bool
    default y

config AOS_KOBJ_WORKQUEUE
    bool
    default n

config AOS_KOBJ_TIMER
    bool
    default n

endif
```

## kernel/core/osal/posix/Config.in
```kconfig
config AOS_COMP_OSAL_POSIX_OBSOLETE
    bool "POSIX API Support in kernel"
    default n
    help
    	Kernel space POSIX API support. POSIX defines the application programming interface (API),
        for software compatibility with variants of Unix and other operating systems.
```

## kernel/cplusplus/Config.in
```kconfig
menuconfig AOS_COMP_CPLUSPLUS
    bool "cplusplus"
    default n
    help

if AOS_COMP_CPLUSPLUS
# Configurations for component cplusplus
endif
```
