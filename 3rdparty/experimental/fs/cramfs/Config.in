## 3rdparty/experimental/fs/cramfs/Config.in
```kconfig
menuconfig AOS_COMP_CRAMFS
    bool "cramfs"
    default n
    help

if AOS_COMP_CRAMFS
# Configurations for component cramfs
endif
```

## 3rdparty/experimental/fs/fatfs/Config.in
```kconfig
menuconfig AOS_COMP_FATFS
    bool "fatfs"
    default n
    help

if AOS_COMP_FATFS
# Configurations for component fatfs
endif
```

## 3rdparty/experimental/fs/jffs2/Config.in
```kconfig
menuconfig AOS_COMP_JFFS2
    bool "jffs2"
    default n
    help

if AOS_COMP_JFFS2
# Configurations for component jffs2
endif
```

## 3rdparty/experimental/fs/uffs/Config.in
```kconfig
menuconfig AOS_COMP_UFFS
    bool "uffs"
    default n
    help

if AOS_COMP_UFFS
# Configurations for component uffs
endif
```

## 3rdparty/experimental/fs/yaffs2/Config.in
```kconfig
menuconfig AOS_COMP_YAFFS2
    bool "yaffs2"
    default n
    help

if AOS_COMP_YAFFS2
# Configurations for component yaffs2
endif
```

## 3rdparty/experimental/gui/Config.in
```kconfig
menuconfig AOS_COMP_LITTLEVGL
    bool "littlevgl"
    default y
    help
      lightweight GUI lib

if AOS_COMP_LITTLEVGL
# Configurations for component littlevgl
endif
```

## 3rdparty/experimental/micropython/Config.in
```kconfig
menuconfig AOS_COMP_MICROPYTHON
    bool "micropython"
    default n
    select AOS_COMP_HAL
    select AOS_COMP_RHINO
    help
      micropython support

if AOS_COMP_MICROPYTHON
# Configurations for component micropython
endif
```

## app/Config.in
```kconfig
config AOS_APP_LOCALAPP
    bool "Local Applications"

if AOS_APP_LOCALAPP
choice
    prompt "Select application"

#
## Sample for user application:
#
# source "app/myapp/Config.in"
# if AOS_APP_MYAPP
#     config AOS_BUILD_APP
#         default "myapp"
# endif
#

endchoice
endif
```

## app/example/Config.in
```kconfig
menuconfig AOS_APP_EXAMPLE
    bool "Builtin Examples"
    default n
    help

if AOS_APP_EXAMPLE

choice
    prompt "Select Builtin Example"

## --- Generated Automatically ---
source "app/example/athostapp/Config.in"
source "app/example/blink/Config.in"
source "app/example/bluetooth/bleadv/Config.in"
source "app/example/bluetooth/blemesh_cmds/Config.in"
source "app/example/bluetooth/blemesh_tmall/Config.in"
source "app/example/bluetooth/bleperipheral/Config.in"
source "app/example/bluetooth/breezeapp/Config.in"
source "app/example/coapapp/Config.in"
source "app/example/dk/dk_audio/Config.in"
source "app/example/dk/dk_camera/Config.in"
source "app/example/dk/dk_gui/Config.in"
source "app/example/dk/dk_ld/Config.in"
source "app/example/dk/dk_qr/Config.in"
source "app/example/helloworld/Config.in"
source "app/example/http2app/Config.in"
source "app/example/linkkit_gateway/Config.in"
source "app/example/linkkitapp/Config.in"
source "app/example/lorawan/linkwan/Config.in"
source "app/example/meshapp/Config.in"
source "app/example/mqttapp/Config.in"
source "app/example/otaapp/Config.in"
source "app/example/sk/sk_gui/Config.in"
source "app/example/tinyengine_app/Config.in"
source "app/example/tls/Config.in"
source "app/example/udataapp/Config.in"
source "app/example/yts/Config.in"
source "app/example/yts/publish/Config.in"
## --- End ---

endchoice
endif
```

## app/example/acapp/Config.in
```kconfig
menuconfig AOS_APP_ACAPP
    bool "acapp"
    select AOS_COMP_ACTIVATION
    select AOS_COMP_CLI
    select AOS_COMP_YLOOP
    help

if AOS_APP_ACAPP
# Configurations for app acapp
endif
```

## app/example/atapp/Config.in
```kconfig
menuconfig AOS_APP_ATAPP
    bool "atapp"
    select AOS_COMP_ATPARSER
    select AOS_COMP_NETMGR
    select AOS_COMP_CLI
    help

if AOS_APP_ATAPP
# Configurations for app atapp
endif
```

## app/example/athostapp/Config.in
```kconfig
menuconfig AOS_APP_ATHOSTAPP
    bool "athostapp"
    select AOS_COMP_NETMGR
    select AOS_COMP_ATPARSER if ATHOSTAPP_CONFIG_NO_ATPARSER
    select AOS_COMP_ATHOST
    select AOS_COMP_CLI
    select AOS_COMP_YLOOP
    help
        An example for receiving and processing AT command sets.

if AOS_APP_ATHOSTAPP
# Configurations for app athostapp

config ATHOSTAPP_CONFIG_NO_ATPARSER
    bool "no atparser"
    default n

config ATHOSTAPP_CONFIG_NO_MQTTREPORT
    bool "no mqtt report"
    default n

endif
```

## app/example/benchmark/footprint_test/Config.in
```kconfig
menuconfig AOS_APP_FOOTPRINT_TEST
    bool "footprint_test"
    select AOS_COMP_CLI
    help

if AOS_APP_FOOTPRINT_TEST
# Configurations for app footprint_test
endif
```

## app/example/benchmark/realtime_test/Config.in
```kconfig
menuconfig AOS_APP_REALTIME_TEST
    bool "realtime_test"
    select AOS_COMP_REALTIME
    select AOS_COMP_CLI
    help

if AOS_APP_REALTIME_TEST
# Configurations for app realtime_test
endif
```

## app/example/blink/Config.in
```kconfig
config AOS_APP_BLINK
    bool "Blink Sample"
    select AOS_COMP_OSAL_AOS
    help
        blink sample

if AOS_APP_BLINK
# Configurations for app blink
endif
```

## app/example/bluetooth/ble_bqb/Config.in
```kconfig
menuconfig AOS_APP_BLE_BQB
    bool "ble_bqb"
    select AOS_COMP_PROFILE
    select AOS_COMP_BT
    select AOS_COMP_CLI
    select AOS_COMP_YLOOP
    help

if AOS_APP_BLE_BQB
# Configurations for app ble_bqb
endif
```

## app/example/bluetooth/bleadv/Config.in
```kconfig
config AOS_APP_BLEADV
    bool "BLE Broadcaster Role Sample"
    select AOS_COMP_BT_HOST
    select AOS_COMP_CLI
    select AOS_COMP_YLOOP
    help
        Ble adv example.

if AOS_APP_BLEADV
# Configurations for app bleadv
endif
```

## app/example/bluetooth/blemesh/Config.in
```kconfig
menuconfig AOS_APP_BLEMESH
    bool "blemesh"
    select AOS_COMP_BT
    select AOS_COMP_CLI
    select AOS_COMP_YLOOP
    help

if AOS_APP_BLEMESH
# Configurations for app blemesh
endif
```

## app/example/bluetooth/blemesh_cli/Config.in
```kconfig
menuconfig AOS_APP_BLEMESH_CLI
    bool "blemesh_cli"
    select AOS_COMP_BT
    select AOS_COMP_CLI
    select AOS_COMP_YLOOP
    help

if AOS_APP_BLEMESH_CLI
# Configurations for app blemesh_cli
endif
```

## app/example/bluetooth/blemesh_cmds/Config.in
```kconfig
menuconfig AOS_APP_BLEMESH_CMDS
    bool "blemesh_cmds"
    select AOS_COMP_BT
    select AOS_COMP_CLI
    select AOS_COMP_YLOOP
    help

if AOS_APP_BLEMESH_CMDS
# Configurations for app blemesh_cmds
endif
```

## app/example/bluetooth/blemesh_srv/Config.in
```kconfig
menuconfig AOS_APP_BLEMESH_SRV
    bool "blemesh_srv"
    select AOS_COMP_BT
    select AOS_COMP_CLI
    select AOS_COMP_YLOOP
    help

if AOS_APP_BLEMESH_SRV
# Configurations for app blemesh_srv
endif
```

## app/example/bluetooth/blemesh_tmall/Config.in
```kconfig
menuconfig AOS_APP_BLEMESH_TMALL
    bool "blemesh_tmall"
    select AOS_COMP_BT_HOST
    select AOS_COMP_BT_TMALL_MODEL
    select AOS_COMP_CLI
    select AOS_COMP_YLOOP
    help
        Sample code to demenstrate how to join AliGenie BLE Mesh network.

if AOS_APP_BLEMESH_TMALL
# Configurations for app blemesh_tmall
endif
```

## app/example/bluetooth/bleperipheral/Config.in
```kconfig
config AOS_APP_BLEPERIPHERAL
    bool "bleperipheral"
    select AOS_COMP_BT_HOST
    select AOS_COMP_BT_PROFILE
    select AOS_COMP_CLI
    help
        bleperipheral

if AOS_APP_BLEPERIPHERAL
# Configurations for app bleperipheral
endif
```

## app/example/bluetooth/breezeapp/Config.in
```kconfig
config AOS_APP_BREEZEAPP
    bool " Breeze Application Sample"
    select AOS_COMP_BREEZE
    select AOS_COMP_OTA if CONFIG_COMP_BZ_OTA = y
    select AOS_COMP_OTA_BLE if CONFIG_COMP_BZ_OTA = y
    select AOS_COMP_CLI
    help
        Breeze application demo, prioviding secure BLE link to Alibaba IoT cloud and service.

if AOS_APP_BREEZEAPP
# Configurations for app breezeapp

config CONFIG_COMP_BZ_OTA
    bool "Enable OTA With Breeze Link."
    default n
    help

endif
```

## app/example/cameraapp/Config.in
```kconfig
menuconfig AOS_APP_CAMERAAPP
    bool "cameraapp"
    select AOS_COMP_BENCHMARKS if @CONDITION@
    select AOS_COMP_FATFS
    select AOS_COMP_CLI
    select AOS_COMP_YLOOP
    help

if AOS_APP_CAMERAAPP
# Configurations for app cameraapp
endif
```
