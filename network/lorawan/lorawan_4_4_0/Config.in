## network/lorawan/lorawan_4_4_0/Config.in
```kconfig
config AOS_COMP_LORAWAN_4_4_0
    bool "v4.4.0"
    select AOS_COMP_OSAL_AOS
    help

if AOS_COMP_LORAWAN_4_4_0
# Configurations for comp lorawan
endif
```

## network/lorawan/lorawan_4_4_0/lorachip_4_4_0/Config.in
```kconfig
menuconfig AOS_COMP_LORACHIP_4_4_0
    bool "lorachip_4_4_0"
    default n
    help

if AOS_COMP_LORACHIP_4_4_0
# Configurations for comp lorachip
endif
```

## network/lorawan/lorawan_4_4_2/Config.in
```kconfig
config AOS_COMP_LORAWAN_4_4_2
    bool "v4.4.2"
    select AOS_COMP_OSAL_AOS
    help

if AOS_COMP_LORAWAN_4_4_2
# Configurations for comp lorawan_4_4_2
config AOS_CONFIG_ENABLE_CLASS_B
    bool "Enable Class B"
    default n

config AOS_CONFIG_LORAWAN_VERSION_110
    bool "Enable Specification Version 1.1.0"
    default n

endif
```

## network/lorawan/lorawan_4_4_2/lorachip_4_4_2/Config.in
```kconfig
menuconfig AOS_COMP_LORACHIP_4_4_2
    bool "lorachip_4_4_2"
    default n
    help

if AOS_COMP_LORACHIP
# Configurations for comp lorachip_4_4_2
endif
```

## network/lorawan_4_4_2/Config.in
```kconfig
menu "LoRaWAN Support"

config AOS_CONFIG_LORAWAN
	bool "enable LoRaWAN"
	default n

comment "select to support LoRaWAN"

config AOS_CONFIG_ENABLE_CLASS_B
	bool "This is config for LoRaWAN Class B feature"
	depends on AOS_CONFIG_LORAWAN
	default n

config AOS_CONFIG_LORAWAN_VERSION_110
	bool "This is config for LoRaWAN Specification Version 1.1.0"
	depends on AOS_CONFIG_LORAWAN
	default n

endmenu
```

## network/lorawan_4_4_2/lorachip/Config.in
```kconfig
menuconfig AOS_COMP_LORACHIP
    bool "lorachip"
    default n
    help

if AOS_COMP_LORACHIP
# Configurations for comp lorachip
endif
```

## network/lwip/Config.in
```kconfig
menuconfig AOS_COMP_LWIP
    bool "LwIP"
    default y
    help
      Support LWIP protocol stack.

      Switch to "y" leads to support LWIP protocol stack.
      Switch to "n" leads to not support LWIP protocol stacks.

if AOS_COMP_LWIP
# Configurations for comp lwip

config AOS_LWIP_ENABLED
    bool "FEATURE_AOS_LWIP_ENABLED"
    default y
    help
      Select aos lwip module or select other platform lwip or tcpip module.

      Switching to "y" leads to select aos lwip module
      Switching to "n" leads to select other platform lwip or tcpip module.

config AF_PACKET_ENABLED
    depends on AOS_LWIP_ENABLED
    bool "FEATURE_AF_PACKET_ENABLED"
    default n
    help
      support AF_PACKET socket.

      Switching to "y" leads to support AF_PACKET socket.
      Switching to "n" leads to not support AF_PACKET socket.
   
menu "LWIP App Configurations"
    depends on AOS_LWIP_ENABLED

    config SNMP_ENABLED
        bool "FEATURE_SNMP_ENABLED"
        default n
        help
          Support SNMP module

          Switching to "y" leads to support SNMP module
          Switching to "n" leads to not support SNMP module

    config HTTPD_ENABLED
        bool "FEATURE_HTTPD_ENABLED"
        default n
        help
          Support HTTPD module

          Switching to "y" leads to support HTTPD module
          Switching to "n" leads to not support HTTPD module

    config LWIPERF_ENABLED
        bool "FEATURE_LWIPERF_ENABLED"
        default n
        help
          Support LWIPERF module

          Switching to "y" leads to support LWIPERF module
          Switching to "n" leads to not support LWIPERF module

    config SNTP_ENABLED
        bool "FEATURE_SNTP_ENABLED"
        default n
        help
          Support SNTP module

          Switching to "y" leads to support SNTP module
          Switching to "n" leads to not support SNTP module

    config MDNS_ENABLED
        bool "FEATURE_MDNS_ENABLED"
        default n
        help
          Support MDNS module

          Switching to "y" leads to use MDNS module.
          Switching to "n" leads to not use MDNS module.

    config NETBIOSNS
        bool "FEATURE_NETBIOSNS_ENABLED"
        default n
        help
          Support NETBIOSNS module

          Switching to "y" leads to support NETBIOSNS module
          Switching to "n" leads to not support NETBIOSNS module

     config TFTP_ENABLED
        bool "FEATURE_TFTP_ENABLED"
        default y
        help
          Support TFTP module

          Switching to "y" leads to support TFTP module
          Switching to "n" leads to not support TFTP module

     config TELNETD_ENABLED
        bool "FEATURE_TELNETD_ENABLED"
        default y
        help
          Support TELNETD module

          Switching to "y" leads to support TELNETD module
          Switching to "n" leads to not support TELNETD module

     config DHCPD_ENABLED
        bool "FEATURE_DHCPD_ENABLED"
        default y
        help
          Support SNMP module

          Switching to "y" leads to support DHCPD module
          Switching to "n" leads to not support DHCPD module

endmenu
endif
```

## network/lwm2m/Config.in
```kconfig
config AOS_COMP_LWM2M
    bool "LwM2M Client"
    default n
    select AOS_COMP_COAP
    help
        AliOS Things lwm2m component

if AOS_COMP_LWM2M
# Configurations for comp lwm2m client component

config LWM2M_BOOTSTRAP_CLIENT_SUPPORT
    bool "LwM2M Bootstrap Client"
    default n
    help
      
config LWM2M_WITH_DTLS
    bool "LwM2M WITH DTLS"
    select MBEDTLS_CONFIG_CRYPTO_AES
    select MBEDTLS_CONFIG_CRYPTO_MODE_CCM
    default y
    help

endif
```

## network/nal/athost/Config.in
```kconfig
config AOS_COMP_ATHOST
    bool
    default n
    select AOS_COMP_LINKKIT_SDK_C if ATHOST_CONFIG_MQTT || ATHOST_CONFIG_COAP
    select APP_FEATURE_LINKKIT_MQTT if ATHOST_CONFIG_MQTT
    select APP_FEATURE_LINKKIT_COAP if ATHOST_CONFIG_COAP
    help
      athost for communicaiton module

if AOS_COMP_ATHOST
# Configurations for comp athost
config ATHOST_CONFIG_WIFI_MGMT
    bool "ATHOST_CONFIG_WIFI_MGMT"
    default y

config ATHOST_CONFIG_CIP
    bool "ATHOST_CONFIG_CIP"
    default y

config ATHOST_CONFIG_MQTT
    bool "ATHOST_CONFIG_MQTT"
    default y

config ATHOST_CONFIG_COAP
    bool "ATHOST_CONFIG_COAP"
    depends on !ATHOST_CONFIG_MQTT
    default n

endif
```

## network/nal/hal/Config.in
```kconfig
source "network/nal/hal/gprs/sim800/Config.in"
source "network/nal/hal/wifi/bk7231/Config.in"
source "network/nal/hal/wifi/mk3060/Config.in"
source "network/nal/hal/wifi/gt202/Config.in"
source "network/nal/hal/wifi/athost/Config.in"
source "network/nal/hal/wifi/esp8266/Config.in"
```

## network/nal/hal/gprs/sim800/Config.in
```kconfig
menuconfig AOS_COMP_DEVICE_SAL_SIM800
    bool "device_sal_sim800"
    default n
    select AOS_COMP_ATPARSER if @CONDITION@
    select AOS_COMP_YLOOP
    help

if AOS_COMP_DEVICE_SAL_SIM800
# Configurations for comp device_sal_sim800
endif
```

## network/nal/sal-hal/Config.in
```kconfig
source "network/nal/sal-hal/gprs/sim800/Config.in"
source "network/nal/sal-hal/wifi/bk7231/Config.in"
source "network/nal/sal-hal/wifi/mk3060/Config.in"
source "network/nal/sal-hal/wifi/gt202/Config.in"
source "network/nal/sal-hal/wifi/athost/Config.in"
source "network/nal/sal-hal/wifi/esp8266/Config.in"
```

## network/nal/sal-hal/wifi/athost/Config.in
```kconfig
menuconfig AOS_COMP_DEVICE_SAL_ATHOST
    bool "device_sal_athost"
    default n
    select AOS_COMP_ATPARSER if @CONDITION@
    select AOS_COMP_YLOOP
    help

if AOS_COMP_DEVICE_SAL_ATHOST
# Configurations for comp device_sal_athost
endif
```

## network/netmgr/Config.in
```kconfig
menuconfig AOS_COMP_NETMGR
    bool "network manager"
    default n
    select AOS_COMP_OSAL_AOS
    select AOS_COMP_KV
    select AOS_COMP_YLOOP
    help
      AliOS things NETMGR -- smart config support component

if AOS_COMP_NETMGR
# Configurations for comp netmgr

    config AOS_CONFIG_NET
        string "Config network: wifi/cellular/blank"
        default "wifi"

    config AOS_CONFIG_WIFI_SSID
        bool "If use ssid in wifi network"
        default n
        depends on AOS_CONFIG_NET = "wifi"

endif
```

## network/sal/athost/Config.in
```kconfig
config ATHOST_ENABLED
    bool "FEATURE_ATHOST_ENABLED"
    default n

menu "AThost Configurations"
    depends on ATHOST_ENABLED

    config ATHOST_WIFI_MGMT
        bool "FEATURE_ATHOST_WIFI_MGMT"
        default y
        help
            Provides AT command for wifi configuration 

            Switching to "y" leads to wifi configuration AT enabled.
            Switching to "n" leads to wifi configuration AT disabled.

    config ATHOST_CIP
        bool "FEATURE_ATHOST_CIP"
        default y
        help
            Provides AT command for tcp/udp client

            Switching to "y" leads to tcp/udp client AT enabled.
            Switching to "n" leads to tcp/udp client AT disabled.

    config ATHOST_MQTT
        bool "FEATURE_ATHOST_MQTT"
        default y
        help
            Provides AT command for MQTT

            Switching to "y" leads to MQTT AT enabled.
            Switching to "n" leads to MQTT AT disabled.

    config ATHOST_COAP
        bool "FEATURE_ATHOST_COAP"
        depends on !ATHOST_MQTT
        default n
        help
            Provides AT command for COAP

            Switching to "y" leads to COAP AT enabled.
            Switching to "n" leads to COAP AT disabled.

endmenu
```

## network/sal/atparser/Config.in
```kconfig
menuconfig AOS_COMP_ATPARSER
    bool "atparser"
    default n
    help

if AOS_COMP_ATPARSER
# Configurations for comp atparser

config HDLC_UART
    bool "FEATURE_HDLC_UART"
    default n
    help
      Provides HDLC over uart

      Switching to "y" leads to HDLC over uart enabled.
      Switching to "n" leads to HDLC over uart disabled.
endif
```

## network/sal/hal/Config.in
```kconfig
source "network/sal/hal/gprs/sim800/Config.in"
source "network/sal/hal/wifi/bk7231/Config.in"
source "network/sal/hal/wifi/mk3060/Config.in"
source "network/sal/hal/wifi/gt202/Config.in"
source "network/sal/hal/wifi/athost/Config.in"
source "network/sal/hal/wifi/esp8266/Config.in"
```

## network/sal/wifi/gt202/Config.in
```kconfig
menuconfig AOS_COMP_SAL_MODULUE_GT202
    bool "sal_modulue_gt202"
    default n
    help

if AOS_COMP_SAL_MODULUE_GT202
# Configurations for comp sal_modulue_gt202
endif
```

## network/sal/wifi/mk3060/Config.in
```kconfig
menuconfig AOS_COMP_DEVICE_SAL_MK3060
    bool "device_sal_mk3060"
    default n
    select AOS_COMP_ATPARSER if @CONDITION@
    select AOS_COMP_YLOOP
    help

if AOS_COMP_DEVICE_SAL_MK3060
# Configurations for comp device_sal_mk3060
endif
```

## network/umesh/Config.in
```kconfig
config AOS_COMP_UMESH
    bool "uMesh"
    default n
    select AOS_COMP_YLOOP
    help
        AliOS Things uMesh network protocol
```

## network/und/Config.in
```kconfig
config AOS_COMP_UND
    bool "Network Diagnosis"
    default n
    select AOS_COMP_OSAL_AOS
    select AOS_COMP_KV
    select AOS_COMP_YLOOP
    select AOS_COMP_UAGENT if AOS_UND_USE_UAGENT
    help
      AliOS things uND -- Nework Diagnosis

if AOS_COMP_UND
# Configurations for comp uND
menu "Config Network Diagnosis Connection:"
    config AOS_UND_USE_MQTT
        bool "MQTT-Direct"
        default y
        help
            use mqtt connection.

    config AOS_UND_USE_UAGENT
        bool "uAgent"
        default n
        help
            use uagent.
endmenu

choice
    prompt "Config Network Diagnosis Wireless:"
    default AOS_UND_WITH_WIFI
    help
      Choose right Network

    config AOS_UND_WITH_WIFI
        bool "Wi-Fi"
        help
          support net with Wi-Fi.

    config AOS_UND_WITH_BLE
        bool "BLE"
        help
          support net with BLE.
endchoice

endif
```

## network/yloop/Config.in
```kconfig
config AOS_COMP_YLOOP
    bool
    default n
    select AOS_COMP_VFS
    help
      AliOS things yloop -- event notifications

if AOS_COMP_YLOOP
# Configurations for comp yloop
endif
```

## osal/Config.in
```kconfig
menuconfig OSAL_ENABLED
    bool "FEATURE_OSAL_ENABLE"
    default y
    help
        AliOS things OSAL -- interface adaptation layer

if OSAL_ENABLED
menu "OSAL Configurations"

endmenu
endif
```

## osal/aos/Config.in
```kconfig
menuconfig AOS_COMP_OSAL_AOS
    bool "AOS API Supported by other OS"
    default y
    help
        AliOS Things API supported by other OS.

if AOS_COMP_OSAL_AOS

choice
    prompt "OSAL Selection"
    default MCU_STM32F429ZI

    config OSAL_RHINO
        bool "RHINO"
        select AOS_COMP_DEBUG
        select AOS_COMP_RHINO

    config OSAL_FREERTOS
        bool "FREERTOS"

endchoice

config OSAL_CONFIG
    string
    default "rhino"    if OSAL_RHINO
    default "freertos" if OSAL_FREERTOS
    help

endif
```

## osal/cmsis/Config.in
```kconfig
menuconfig AOS_COMP_OSAL_CMSIS
    bool "cmsis"
    default n
    help

if AOS_COMP_OSAL_CMSIS
# Configurations for comp cmsis
endif
```
