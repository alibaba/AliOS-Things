## application/example/example_legacy/dk/dk_gui/Config.in
```kconfig
config AOS_APP_DK_GUI
    bool "DeveloperKit GUI Sample"
    select AOS_COMP_LITTLEVGL if !AOS_CREATE_PROJECT
    select AOS_COMP_CLI if !AOS_CREATE_PROJECT
    select AOS_COMP_YLOOP if !AOS_CREATE_PROJECT
    help
        Developer Kit GUI example

if AOS_APP_DK_GUI
# Configurations for app dk_gui
config SYSINFO_APP_VERSION
    string "Firmware Version"
    default "app-1.0.0-20200214.140831"
    help
        application main firmware version
endif
```

## application/example/example_legacy/dk/dk_qr/Config.in
```kconfig
config AOS_APP_DK_QR
    bool "DeveloperKit QR Code Sample"
    select AOS_COMP_CLI
    select AOS_COMP_YLOOP
    help
        Developer Kit QR Code demo

if AOS_APP_DK_QR
# Configurations for app dk_qr
config SYSINFO_APP_VERSION
    string "Firmware Version"
    default "app-1.0.0-20200214.140831"
    help
        application main firmware version
endif
```

## application/example/example_legacy/halapp/Config.in
```kconfig
config AOS_APP_HALAPP
    bool "HalApp"
    select AOS_COMP_OSAL_AOS
    help
        Hal App Demo

if AOS_APP_HALAPP
# Configurations for app halapp
config SYSINFO_APP_VERSION
    string "Firmware Version"
    default "app-1.0.0-20200214.140831"
    help
        application main firmware version
endif
```

## application/example/example_legacy/helloworld/Config.in
```kconfig
config AOS_APP_HELLOWORLD
    bool "HelloWorld"
    select AOS_COMP_OSAL_AOS
    help
        Hello World

if AOS_APP_HELLOWORLD
# Configurations for app helloworld
config SYSINFO_APP_VERSION
    string "Firmware Version"
    default "app-1.0.0-20200214.140831"
    help
        application main firmware version
endif
```

## application/example/example_legacy/http2app/Config.in
```kconfig
config AOS_APP_HTTP2APP
    bool "HTTP2 Stream Sample"
    select AOS_COMP_CJSON if !AOS_CREATE_PROJECT
    select AOS_COMP_NETMGR if !AOS_CREATE_PROJECT
    select AOS_COMP_CLI if !AOS_CREATE_PROJECT
    select AOS_COMP_SDK_HTTP2 if !AOS_CREATE_PROJECT
    help
        http2 stream examples

if AOS_APP_HTTP2APP
# Configurations for app http2app
config SYSINFO_APP_VERSION
    string "Firmware Version"
    default "app-1.0.0-20200214.140831"
    help
        application main firmware version
endif
```

## application/example/example_legacy/httpapp/Config.in
```kconfig
config AOS_APP_HTTPAPP
    bool "HTTP App "
    select AOS_COMP_HTTP
    select AOS_COMP_SDK_HTTP
    select AOS_COMP_NETMGR
    select AOS_COMP_LWIP
    select AOS_COMP_CLI
    help
        HTTP client app

if AOS_APP_HTTPAPP
config CONFIG_HTTP_SECURE
    bool "Support HTTP Secure"
    default n
    select AOS_COMP_MBEDTLS
endif
```

## application/example/example_legacy/httpclient_app/Config.in
```kconfig
config AOS_APP_HTTPCLIENT_APP
    bool "HTTP Client App"
# the selection of dependencies are to be removed soon
    select AOS_COMP_HTTP if !AOS_CREATE_PROJECT
    select CONFIG_NEW_HTTP_API
    select AOS_COMP_NETMGR if !AOS_CREATE_PROJECT
    select AOS_COMP_CLI if !AOS_CREATE_PROJECT
    help
        HTTP client app

if AOS_APP_HTTPCLIENT_APP
config SYSINFO_APP_VERSION
    string "Firmware Version"
    default "app-1.0.0-20200214.140831"
    help
        application main firmware version
endif
```

## application/example/example_legacy/httpdns_app/Config.in
```kconfig
config AOS_APP_HTTPDNS_APP
    bool "httpdns app"
# the selection of dependencies are to be removed soon
    select AOS_COMP_NETMGR if !AOS_CREATE_PROJECT
    select AOS_COMP_CLI if !AOS_CREATE_PROJECT
    select AOS_COMP_YLOOP if !AOS_CREATE_PROJECT
    select AOS_COMP_HTTPDNS if !AOS_CREATE_PROJECT
    help
        httpdns app

if AOS_APP_HTTPDNS_APP
# Configurations for httpdns app
config SYSINFO_APP_VERSION
    string "Firmware Version"
    default "app-1.0.0-20200214.140831"
    help
        application main firmware version
endif
```

## application/example/example_legacy/id2_app/Config.in
```kconfig
config AOS_APP_ID2_APP
    bool "ID2 Client Sample"
    select AOS_COMP_IROT if !AOS_CREATE_PROJECT
    select AOS_COMP_ID2 if !AOS_CREATE_PROJECT
    select AOS_COMP_ALICRYPTO if !AOS_CREATE_PROJECT
    help
        ID2 Sample and Local Test.

if AOS_APP_ID2_APP
# Configurations for app id2_client
config SYSINFO_APP_VERSION
    string "Firmware Version"
    default "app-1.0.0-20200214.140831"
    help
        application main firmware version
endif
```

## application/example/example_legacy/itls_app/Config.in
```kconfig
config AOS_APP_ITLS_APP
    bool "ITLS Client Sample"
    select AOS_COMP_CLI if !AOS_CREATE_PROJECT
    select AOS_COMP_ALICRYPTO if !AOS_CREATE_PROJECT
    select AOS_COMP_NETMGR if !AOS_CREATE_PROJECT
    select AOS_COMP_ID2 if !AOS_CREATE_PROJECT
    select AOS_COMP_ITLS if !AOS_CREATE_PROJECT
    help
        itls sample app

if AOS_APP_ITLS_APP
# Configurations for app itls_client
config SYSINFO_APP_VERSION
    string "Firmware Version"
    default "app-1.0.0-20200214.140831"
    help
        application main firmware version
endif
```

## application/example/example_legacy/jsengine_app/Config.in
```kconfig
config AOS_APP_JSENGINE_APP
    bool "JSEngine Firmware"
    select AOS_COMP_JSENGINE
    help
        build for JSEngine firmware

if AOS_APP_JSENGINE_APP
# Configurations for app jsengine_app
config SYSINFO_APP_VERSION
    string "Firmware Version"
    default "app-1.0.0-20200214.140831"
    help
        application main firmware version
endif
```

## application/example/example_legacy/linkkit_gateway/Config.in
```kconfig
config AOS_APP_LINKKIT_GATEWAY
    bool "Linkkit Gateway Application"
    select AOS_COMP_CLI if !AOS_BOARD_ESP8266
   # select AOS_COMP_OTA
    select AOS_COMP_CJSON
    select AOS_COMP_NETMGR
    select AOS_COMP_SDK_DEVMODEL
    select AOS_COMP_SDK_AWSS
    select AOS_COMP_UND
    select DEVICE_MODEL_GATEWAY
    help
        linkkit gateway examples

if AOS_APP_LINKKIT_GATEWAY
# Configurations for app linkkit_gateway

config LINKKIT_GATEWAY_CONFIG_PRINT_HEAP
    bool "Show Free Heap Duration"
    default n
    help
    displays heap space periodically for debug

endif
```

## application/example/example_legacy/linkkitapp/Config.in
```kconfig
config AOS_APP_LINKKITAPP
    bool "Linkkit Application"
    select AOS_COMP_CLI if !AOS_BOARD_ESP8266
    select AOS_COMP_NETMGR
    select AOS_COMP_CJSON
    select AOS_COMP_SDK_DEVMODEL
    select AOS_COMP_CJSON
    select AOS_COMP_SDK_AWSS
    select AOS_COMP_UND
    help
        linkkitapp

if AOS_APP_LINKKITAPP
# Configurations for app linkkitapp

config ENABLE_OTA
    bool "Enable OTA"
    default y
    select AOS_COMP_OTA
    help
        enable feature OTA.

choice
    prompt "Select Case"
    default LINKKITAPP_CONFIG_CASE_SOLO
    help
        select case to build

    config LINKKITAPP_CONFIG_CASE_SOLO
        bool "SOLO"
        help
            default case, build linkkit_example_solo.c or deprecated/solo.c(when enable deprecated)

    config LINKKITAPP_CONFIG_CASE_SCHED
        bool "Sched"
        help
            case sched, build linkkit_example_sched.c or deprecated/sched.c(when enable deprecated)

    config LINKKITAPP_CONFIG_CASE_CNTDOWN
        bool "Cntdown"
        help
            case countdown, build linkkit_example_cntdown.c or deprecated/cntdown.c(when enable deprecated)
endchoice

config LINKKITAPP_CONFIG_PRINT_HEAP
    bool "Show Free Heap Duration"
    default n
    help
        displays heap space periodically for debug

config SYSINFO_APP_VERSION
    string "Firmware Version"
    default "app-1.0.0-20200214.140831"
    help
        application main firmware version

endif
```

## application/example/example_legacy/lorawan/linkwan/Config.in
```kconfig
config AOS_APP_LINKWAN
    bool "LinkWAN Sample"
    select AOS_COMP_LORAWAN_STACK
    help
        linkwan

if AOS_APP_LINKWAN
# Configurations for app linkwan
config SYSINFO_APP_VERSION
    string "Firmware Version"
    default "app-1.0.0-20200214.140831"
    help
        application main firmware version
endif
```

## application/example/example_legacy/lwm2m_app/Config.in
```kconfig
config AOS_APP_LWM2M_APP
    bool "lwm2mapp"
    select AOS_COMP_LWM2M 
    help
        lwm2m app

if AOS_APP_LWM2M_APP
config LWM2M_WITH_DTLS
    bool "LwM2M WITH DTLS"
    select MBEDTLS_CONFIG_CRYPTO_AES
    select MBEDTLS_CONFIG_CRYPTO_MODE_CCM
    select MBEDTLS_CONFIG_TLS_DEBUG
    default y
    help
        LwM2M WITH DTLS

if LWM2M_WITH_DTLS
config USE_EXTERNAL_MEBDTLS
    bool "USE EXTERNAL MEBDTLS"
    default y
    help
        USE EXTERNAL MEBDTLS

config WITH_MBEDTLS
    bool "WITH MBEDTLS"
    default y
    help
        WITH MBEDTLS

config LWM2M_WITH_MBEDTLS
    bool "LWM2M WITH MBEDTLS"
    default y
    help
        LWM2M WITH MBEDTLS

endif
endif
```

## application/example/example_legacy/mal_app/Config.in
```kconfig
config AOS_APP_MAL_APP
    bool "mal app"
# the selection of dependencies are to be removed soon
    select AOS_COMP_MAL
    select AOS_COMP_SDK_SIGN
    help
        MQTT Adapter layer app

if AOS_APP_MAL_APP
# Configurations for MAL app
endif
```

## application/example/example_legacy/modbus_app/Config.in
```kconfig
config AOS_APP_MODBUS_APP
    bool "MODBUS Master Sample"
    select AOS_COMP_CLI
    select AOS_COMP_YLOOP
    select AOS_COMP_MBMASTER
    help
        This example is an demo of using modbus master stack

if AOS_APP_MODBUS_APP
# Configurations for modbus app
config SYSINFO_APP_VERSION
    string "Firmware Version"
    default "app-1.0.0-20200214.140831"
    help
        application main firmware version
endif
```

## application/example/example_legacy/otaapp/Config.in
```kconfig
config AOS_APP_OTAAPP
    bool "OTA Sample"
    select AOS_COMP_NETMGR if !AOS_CREATE_PROJECT
    select AOS_COMP_CLI if !AOS_CREATE_PROJECT
    select AOS_COMP_OTA if !AOS_CREATE_PROJECT
    select AOS_COMP_CJSON if !AOS_CREATE_PROJECT
    select CONFIG_AOS_TCPIP if OTAAPP_CONFIG_USE_LWIP && !AOS_CREATE_PROJECT
    select AOS_COMP_SDK_MQTT if !AOS_CREATE_PROJECT
    help
        OTA demo app for developers

if AOS_APP_OTAAPP
# Configurations for app otaapp

config OTAAPP_CONFIG_USE_LWIP
    bool "Use lwip"
    default n
    help

config OTAAPP_CONFIG_TEST_LOOP
    bool "Test Loop"
    default n
    help

config SYSINFO_APP_VERSION
    string "Firmware Version"
    default "app-1.0.0-20200214.140831"
    help
        application main firmware version
        
endif
```

## application/example/example_legacy/prov_app/Config.in
```kconfig
config AOS_APP_PROV_APP
    bool "ID2 Provisioning Sample"
    select AOS_COMP_LIBPROV
    select AOS_COMP_CLI
    select AOS_COMP_YLOOP
    select AOS_COMP_LS_HAL
    help
        id2 provisioning sample app

if AOS_APP_PROV_APP
# Configurations for app prov_app

config PROVAPP_CONFIG_ERASE
    bool "Erase"
    default n
    help

config SYSINFO_APP_VERSION
    string "Firmware Version"
    default "app-1.0.0-20200214.140831"
    help
        application main firmware version
endif
```

## application/example/example_legacy/sal_app/Config.in
```kconfig
config AOS_APP_SAL_APP
    bool "sal app test"
# the selection of dependencies are to be removed soon
    select AOS_COMP_NETMGR if !AOS_CREATE_PROJECT
    select AOS_COMP_CLI if !AOS_CREATE_PROJECT
    select AOS_COMP_YLOOP if !AOS_CREATE_PROJECT
    help

if AOS_APP_SAL_APP
# Configurations for sal app
config SYSINFO_APP_VERSION
    string "Firmware Version"
    default "app-1.0.0-20200214.140831"
    help
        application main firmware version
endif
```

## application/example/example_legacy/sk/sk_gui/Config.in
```kconfig
config AOS_APP_SK_GUI
    bool "StartKit GUI Sample"
    select AOS_COMP_LITTLEVGL if !AOS_CREATE_PROJECT
    select AOS_COMP_CLI if !AOS_CREATE_PROJECT
    select AOS_COMP_YLOOP if !AOS_CREATE_PROJECT
    help
        Starter Kit GUI demo

if AOS_APP_SK_GUI
# Configurations for app sk_gui
config SYSINFO_APP_VERSION
    string "Firmware Version"
    default "app-1.0.0-20200214.140831"
    help
        application main firmware version
endif
```

## application/example/example_legacy/uai_demo/uai_cifar10_demo/Config.in
```kconfig
config AOS_APP_UAI_CIFAR10_DEMO
    bool "uAI CIFAR10 DEMO"
    select AOS_COMP_UAI
    help
        uAI CIFAR10 DEMO

if AOS_APP_UAI_CIFAR10_DEMO
config SYSINFO_APP_VERSION
    string "Firmware Version"
    default "app-1.0.0-20200214.140831"
    help
        application main firmware version
endif
```

## application/example/example_legacy/uai_demo/uai_kws_demo/Config.in
```kconfig
config AOS_APP_UAI_KWS_DEMO
    bool "uAI KWS DEMO"
    select AOS_COMP_UAI
    help
        uAI KWS DEMO

if AOS_APP_UAI_KWS_DEMO
config SYSINFO_APP_VERSION
    string "Firmware Version"
    default "app-1.0.0-20200214.140831"
    help
        application main firmware version
endif
```

## application/example/example_legacy/uapp1/Config.in
```kconfig
config AOS_APP_UAPP1
    bool "uapp1_test"
    help
        "user space app"

if AOS_APP_UAPP1
# Configurations for app uapp1

config RHINO_CONFIG_APP_NAME
    string "app name"
    default "uapp1"
    help
        "set app name, it's also the first task name"

config RHINO_CONFIG_APP_VERSION
    hex "app version"
    default 0x00000001
    help
        "set app version"

config RHINO_CONFIG_APP_ENTRY_TASK_PRIO
    int "app entry task priority"
    default 20
    help
        "set app entry task priority"

config RHINO_CONFIG_APP_ENTRY_TASK_KSTACK_SIZE
    int "app entry task kstack size"
    default 256
    help
        "set app entry task kstack size, the unit is cpu_stack_t"

config RHINO_CONFIG_APP_ENTRY_TASK_USTACK_SIZE
    int "app entry task ustack size"
    default 256
    help
        "set app entry task ustack size, the unit is cpu_stack_t"

config SYSINFO_APP_VERSION
    string "Firmware Version"
    default "app-1.0.0-20200214.140831"
    help
        application main firmware version
source "core/mk/uspace/Config.in"

endif
```

## application/example/example_legacy/uapp2/Config.in
```kconfig
config AOS_APP_UAPP2
    bool "uapp2_test"
    help
        "user space app"

if AOS_APP_UAPP2
# Configurations for app uapp1

config RHINO_CONFIG_APP_NAME
    string "app name"
    default "uapp2"
    help
        "set app name, it's also the first task name"

config RHINO_CONFIG_APP_VERSION
    hex "app version"
    default 0x00000001
    help
        "set app version"

config RHINO_CONFIG_APP_ENTRY_TASK_PRIO
    int "app entry task priority"
    default 20
    help
        "set app entry task priority"

config RHINO_CONFIG_APP_ENTRY_TASK_KSTACK_SIZE
    int "app entry task kstack size"
    default 256
    help
        "set app entry task kstack size, the unit is cpu_stack_t"

config RHINO_CONFIG_APP_ENTRY_TASK_USTACK_SIZE
    int "app entry task ustack size"
    default 256
    help
        "set app entry task ustack size, the unit is cpu_stack_t"


source "core/mk/uspace/Config.in"

endif
```
