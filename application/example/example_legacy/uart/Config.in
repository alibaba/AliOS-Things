## application/example/example_legacy/uart/Config.in
```kconfig
config AOS_APP_UART
    bool "Uart Sample"
    help
        this is a uart sample form hal uart.h

if AOS_APP_UART
# Configurations for app uart
config SYSINFO_APP_VERSION
    string "Firmware Version"
    default "app-1.0.0-20200214.140831"
    help
        application main firmware version
endif
```

## application/example/example_legacy/udata_demo/sensor_cloud_demo/Config.in
```kconfig
config AOS_APP_SENSOR_CLOUD_DEMO
    bool "Sensor Cloud Demo"
    select AOS_COMP_CLI
    select AOS_COMP_SENSOR
    select AOS_COMP_NETMGR
    select AOS_COMP_YLOOP
    select AOS_COMP_CJSON
    select AOS_COMP_SDK_DEVMODEL
    help
        sensor cloud demo

if AOS_APP_SENSOR_CLOUD_DEMO
# Configurations for comp sensor hal
config SYSINFO_APP_VERSION
    string "Firmware Version"
    default "app-1.0.0-20200214.140831"
    help
        application main firmware version
        
endif
```

## application/example/example_legacy/udata_demo/sensor_local_demo/Config.in
```kconfig
config AOS_APP_SENSOR_LOCAL_DEMO
    bool "Sensor Local Demo"
    select AOS_COMP_CLI if !AOS_CREATE_PROJECT
    select AOS_COMP_SENSOR if !AOS_CREATE_PROJECT
    help
        sensor local demo

if AOS_APP_SENSOR_LOCAL_DEMO
# Configurations for comp sensor hal
config SYSINFO_APP_VERSION
    string "Firmware Version"
    default "app-1.0.0-20200214.140831"
    help
        application main firmware version
endif
```

## application/example/example_legacy/udata_demo/udata_cloud_demo/Config.in
```kconfig
config AOS_APP_UDATA_CLOUD_DEMO
    bool "uData Cloud Demo"
    select AOS_COMP_CLI
    select AOS_COMP_UDATA
    select AOS_COMP_NETMGR
    select AOS_COMP_YLOOP
    select AOS_COMP_CJSON
    select AOS_COMP_SDK_DEVMODEL
    help
        uData cloud demo

if AOS_APP_UDATA_CLOUD_DEMO
# Configurations for comp udata
config SYSINFO_APP_VERSION
    string "Firmware Version"
    default "app-1.0.0-20200214.140831"
    help
        application main firmware version

endif
```

## application/example/example_legacy/udata_demo/udata_local_demo/Config.in
```kconfig
config AOS_APP_UDATA_LOCAL_DEMO
    bool "uData Local Demo"
    select AOS_COMP_CLI if !AOS_CREATE_PROJECT
    select AOS_COMP_UDATA if !AOS_CREATE_PROJECT
    help
        uData local demo

if AOS_APP_UDATA_LOCAL_DEMO
# Configurations for comp udata
config SYSINFO_APP_VERSION
    string "Firmware Version"
    default "app-1.0.0-20200214.140831"
    help
        application main firmware version
endif
```

## application/example/example_legacy/udataapp/Config.in
```kconfig
config AOS_APP_UDATAAPP
    bool "uData Sensor Framework Sample"
    select AOS_COMP_CLI
    select AOS_COMP_SENSOR
    select AOS_COMP_UDATA
    select AOS_COMP_NETMGR if AOS_CONFIG_DTC_MQTT || AOS_CONFIG_DTC_LINKKIT
    select AOS_COMP_YLOOP if AOS_CONFIG_DTC_MQTT || AOS_CONFIG_DTC_LINKKIT
    select AOS_COMP_CJSON if AOS_CONFIG_DTC_LINKKIT
    select AOS_COMP_LWIP if AOS_CONFIG_DTC_LINKKIT && AOS_CONFIG_DTC_USE_LWIP
#    select AOS_COMP_LINKKIT_SDK_C if AOS_CONFIG_DTC_ENABLE
    select AOS_COMP_SDK_DEVMODEL if AOS_CONFIG_DTC_LINKKIT
    select AOS_COMP_SDK_AWSS if AOS_CONFIG_DTC_LINKKIT    
    select AOS_COMP_SDK_MQTT if AOS_CONFIG_DTC_MQTT
    help
        uData sensor framework demo

if AOS_APP_UDATAAPP
# Configurations for comp udata

config AOS_CONFIG_DTC_ENABLE
    bool "Data to Cloud"
    default n
    help
 
if AOS_CONFIG_DTC_ENABLE
  choice
      prompt "Data To Cloud list"
      default AOS_CONFIG_DTC_MQTT
      help
          This is 'DTC choice' list sample

      config AOS_CONFIG_DTC_LINKKIT
          bool "linkkit"
          help
              Enable linkkit
      config AOS_CONFIG_DTC_MQTT
          bool "mqtt"
          help
              Enable mqtt

  endchoice
endif

if AOS_CONFIG_DTC_LINKKIT
config AOS_CONFIG_DTC_USE_LWIP
    bool "Use lwip"
    default n
endif

config AOS_CONFIG_DTC_TYPE
    string
    default "linkkit" if AOS_CONFIG_DTC_LINKKIT
    default "mqtt" if AOS_CONFIG_DTC_MQTT
    
config SYSINFO_APP_VERSION
    string "Firmware Version"
    default "app-1.0.0-20200214.140831"
    help
        application main firmware version

endif
```

## application/example/example_legacy/ulocation/baseapp/Config.in
```kconfig
config AOS_APP_BASEAPP
    bool "uLocation base sample app"
    select AOS_COMP_NETMGR
    select AOS_COMP_CJSON
    select AOS_COMP_ULOCATION
    select AOS_COMP_SDK_DEVMODEL
    help
        ulocation base sample app

if AOS_APP_BASEAPP
# Configurations for app baseapp
config SYSINFO_APP_VERSION
    string "Firmware Version"
    default "app-1.0.0-20200214.140831"
    help
        application main firmware version
endif
```

## application/example/example_legacy/ulocation/qianxunapp/Config.in
```kconfig
config AOS_APP_QIANXUNAPP
    bool "qianxunapp"
    select AOS_COMP_ULOCATION
    select AOS_COMP_CLI
    select AOS_COMP_YLOOP
    select AOS_COMP_NETMGR
    select QXWZ_ENABLED
    help

if AOS_APP_QIANXUNAPP
# Configurations for app qianxunapp
config SYSINFO_APP_VERSION
    string "Firmware Version"
    default "app-1.0.0-20200214.140831"
    help
        application main firmware version
endif
```

## application/example/example_legacy/ulog_app/Config.in
```kconfig
config AOS_APP_ULOG_APP
    bool "ulog_app"
    help

if AOS_APP_ULOG_APP
# Configurations for app ulog_app


config ULOGAPP_CONFIG_UDP
    bool "enable test ulog pop out via udp"
    default n
    help
        enable ulog pop out via udp

config ULOGAPP_CONFIG_SPIFFS
    bool "enable test ulog pop out via file system spiffs"
    default n
    help
        enable ulog pop out via file system(spiffs)

config ULOGAPP_CONFIG_FATFS
    bool "enable test ulog pop out via file system fatfs"
    default n
    help
        enable ulog pop out via file system(fatfs)

if ULOGAPP_CONFIG_FATFS
config ULOG_APP_CONFIG_SD_CARD
    bool "active function that pop out log files via SD CARD"
    default n
    help
        active function pop out log files via SD card
endif

config SYSINFO_APP_VERSION
    string "Firmware Version"
    default "app-1.0.0-20200214.140831"
    help
        application main firmware version
        
endif
```

## application/example/example_legacy/websoc_app/Config.in
```kconfig
config AOS_APP_WEBSOC_APP
    bool "websoc app"
    select AOS_COMP_NETMGR if !AOS_CREATE_PROJECT
    select AOS_COMP_CLI if !AOS_CREATE_PROJECT
    select AOS_COMP_YLOOP if !AOS_CREATE_PROJECT
    select AOS_COMP_WEBSOC if !AOS_CREATE_PROJECT
    help
        websoc app

if AOS_APP_WEBSOC_APP
# Configurations for websoc app
config SYSINFO_APP_VERSION
    string "Firmware Version"
    default "app-1.0.0-20200214.140831"
    help
        application main firmware version
endif
```

## application/example/example_legacy/wifi_at/Config.in
```kconfig
config AOS_APP_WIFI_AT_APP
    bool "wifi_at_app"
    help
        wifi at sample

if AOS_APP_WIFI_AT_APP
config SYSINFO_APP_VERSION
    string "Firmware Version"
    default "app-1.0.0-20200214.140831"
    help
        application main firmware version
endif
```

## application/example/example_legacy/yloop_app/Config.in
```kconfig
config AOS_APP_YLOOP_APP
    bool "yloop app"
    select AOS_COMP_NETMGR
    select AOS_COMP_CLI
    select AOS_COMP_YLOOP
    help

if AOS_APP_YLOOP_APP
# Configurations for yloop app
config SYSINFO_APP_VERSION
    string "Firmware Version"
    default "app-1.0.0-20200214.140831"
    help
        application main firmware version
endif
```

## application/example/example_legacy/yts/Config.in
```kconfig
config AOS_APP_YTS
    bool "Test Suite"
    select AOS_COMP_ULOG
    select CONFIG_AOS_TCPIP if AOS_BOARD_LINUXHOST || AOS_BOARD_ARMHFLINUX
    select AOS_COMP_CLI if !AOS_BOARD_LINUXHOST && !AOS_BOARD_ARMHFLINUX
    select AOS_COMP_NETMGR if AOS_BOARD_LINUXHOST || AOS_BOARD_ARMHFLINUX
    select AOS_COMP_TESTCASE
    select AOS_COMP_UMESH if AOS_BOARD_LINUXHOST || AOS_BOARD_ARMHFLINUX
    select AOS_COMP_FATFS if AOS_BOARD_LINUXHOST || AOS_BOARD_ARMHFLINUX
    select AOS_COMP_YLOOP
    select AOS_COMP_DDA if AOS_BOARD_LINUXHOST || AOS_BOARD_ARMHFLINUX
    select AOS_COMP_VFS
    select AOS_COMP_YUNIT
    help
      AliOS Things test suite


if AOS_APP_YTS
# Configurations for app yts

config YTS_CONFIG_TEST_SUITE_DETACHED
    bool "Yts Test Suite running in Standalone Task"
    default n
    help
        switch on this option will make enough stack for yts unit test suite

if YTS_CONFIG_TEST_SUITE_DETACHED
config YTS_CONFIG_TASK_DEPTH
    int "Task Depth of Yts Routine"
    range 2048 32768
    default 8192
    help
        modify this value follow with count of test case
endif

config YTS_CONFIG_NET_CONNECT
    bool "Net Connect Related Running Enviroment"
    select AOS_COMP_NETMGR
    select YTS_CONFIG_TEST_SUITE_DETACHED
    default n
    help
        this option is must for test net related test case

config SYSINFO_APP_VERSION
    string "Firmware Version"
    default "app-1.0.0-20200214.140831"
    help
        application main firmware version

endif
```

## application/example/fs_demo/Config.in
```kconfig
config AOS_APP_FS_DEMO
    bool "fs Demo"
    select AOS_COMP_OSAL_AOS if !AOS_CREATE_PROJECT
    help
        filesystem demo

if AOS_APP_FS_DEMO
# Configurations for app fs_demo
config SYSINFO_APP_VERSION
    string "Firmware Version"
    default "app-1.0.0-20200214.140831"
    help
        application main firmware version
endif
```

## application/example/game_demo/Config.in
```kconfig
config AOS_APP_GAME_DEMO
    bool "Game Demo"
    select AOS_COMP_NETMGR if !AOS_CREATE_PROJECT
    select AOS_COMP_CLI if !AOS_CREATE_PROJECT
    select AOS_COMP_OSAL_AOS if !AOS_CREATE_PROJECT
    select AOS_COMP_SDL2
    help
        helloworld demo

if AOS_APP_GAME_DEMO
# Configurations for app game_demo
config SYSINFO_APP_VERSION
    string "Firmware Version"
    default "app-1.0.0-20200214.140831"
    help
        application main firmware version
endif
```

## application/example/hal_demo/Config.in
```kconfig
config AOS_APP_HAL_DEMO
    bool "Hal_Demo"
    select AOS_COMP_OSAL_AOS
    help
        Hal Demo

if AOS_APP_HAL_DEMO
# Configurations for app halappdemo
config SYSINFO_APP_VERSION
    string "Firmware Version"
    default "app-1.0.0-20200214.140831"
    help
        application main firmware version
endif
```

## application/example/halapp/Config.in
```kconfig
config AOS_APP_HALAPP
    bool "HalApp"
    select AOS_COMP_OSAL_AOS
    help
        Hal App Demo

if AOS_APP_HALAPP
# Configurations for app hal demo
endif
```

## application/example/halappdemo/Config.in
```kconfig
config AOS_APP_HALAPPDEMO
    bool "HalAppDemo"
    select AOS_COMP_OSAL_AOS
    help
        Hal App Demo

if AOS_APP_HALAPPDEMO
# Configurations for app halappdemo
endif
```

## application/example/helloworld/Config.in
```kconfig
config AOS_APP_HELLOWORLD
    bool "HelloWorld"
    select AOS_COMP_OSAL_AOS
    help
        Hello World

if AOS_APP_HELLOWORLD
# Configurations for app helloworld
endif
```

## application/example/helloworld_demo/Config.in
```kconfig
config AOS_APP_HELLOWORLD_DEMO
    bool "HelloworldDemo"
    select AOS_COMP_OSAL_AOS
    help
        helloworld demo

if AOS_APP_HELLOWORLD_DEMO
# Configurations for app helloworl_demo
config SYSINFO_APP_VERSION
    string "Firmware Version"
    default "app-1.0.0-20200214.140831"
    help
        application main firmware version
endif
```

## application/example/http2_demo/Config.in
```kconfig
config AOS_APP_HTTP2_DEMO
    bool "HTTP2 Stream Sample"
    select AOS_COMP_CJSON if !AOS_CREATE_PROJECT
    select AOS_COMP_NETMGR if !AOS_CREATE_PROJECT
    select AOS_COMP_CLI if !AOS_CREATE_PROJECT
    select AOS_COMP_SDK_HTTP2 if !AOS_CREATE_PROJECT
    help
        http2 stream examples

if AOS_APP_HTTP2_DEMO
# Configurations for app http2_demo
config SYSINFO_APP_VERSION
    string "Firmware Version"
    default "app-1.0.0-20200214.140831"
    help
        application main firmware version
endif
```

## application/example/httpapp/Config.in
```kconfig
config AOS_APP_HTTPAPP
    bool "httpapp"
    select AOS_COMP_NETMGR
    select AOS_COMP_YLOOP
    select AOS_COMP_HTTP
    select AOS_COMP_LWIP
    select AOS_COMP_CLI
    help
        HTTP Client app

if AOS_APP_HTTPAPP
config CONFIG_HTTP_SECURE
    bool "Support HTTP Secure"
    default n
    select AOS_COMP_MBEDTLS
endif
```

## application/example/httpc_demo/Config.in
```kconfig
config AOS_APP_HTTPC_DEMO
    bool "HTTP App "
    select AOS_COMP_SDK_HTTP if !AOS_CREATE_PROJECT
    select AOS_COMP_NETMGR if !AOS_CREATE_PROJECT
    select AOS_COMP_CLI if !AOS_CREATE_PROJECT
    help
        HTTP client app

if AOS_APP_HTTPC_DEMO
config CONFIG_HTTP_SECURE
    bool "Support HTTP Secure"
    default n
    select AOS_COMP_MBEDTLS

config SYSINFO_APP_VERSION
    string "Firmware Version"
    default "app-1.0.0-20200214.140831"
    help
        application main firmware version
endif
```

## application/example/httpclient_app/Config.in
```kconfig
config AOS_APP_HTTPCLIENT_APP
    bool "HTTP Client App"
    select AOS_COMP_HTTP
    select AOS_COMP_NETMGR
    select AOS_COMP_LWIP
    select AOS_COMP_CLI
    help
        HTTP client app

if AOS_APP_HTTPCLIENT_APP
config CONFIG_HTTP_SECURE
    bool "Support HTTP Secure"
    default n
    select AOS_COMP_MBEDTLS
endif
```

## application/example/id2_app/Config.in
```kconfig
config AOS_APP_ID2_CLIENT
    bool "ID2 Client Sample"
    select AOS_COMP_IROT
    select AOS_COMP_ID2
    select AOS_COMP_ALICRYPTO
    help
        ID2 Sample and Local Test.

if AOS_APP_ID2_CLIENT
# Configurations for app id2_client
endif
```
