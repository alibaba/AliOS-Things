#include <stdio.h>
#include <aos/kernel.h>
#include "aos/hal/gpio.h"
#include "ulog/ulog.h"
#include "hal_iomux_haas1000.h"
#include "k_api.h"
#include "aos/cli.h"

//#define OLED_MODE_0_96 //0.96'
#define OLED_MODE_1_3   //1.3'

#if (RHINO_CONFIG_HW_COUNT > 0)
#define CONFIG_FAST_SYSTICK_HZ      (hal_cmu_get_crystal_freq() / 4)
#define FAST_TICKS_TO_US(tick)      ((uint32_t)(tick) * 10 / (CONFIG_FAST_SYSTICK_HZ / 1000 / 100))
void _udelay(unsigned long x) {
	unsigned long now,t;

	t = FAST_TICKS_TO_US(hal_fast_sys_timer_get());
	now = t;
	while ((now - t) < x) {
		now = FAST_TICKS_TO_US(hal_fast_sys_timer_get());
	}
}

void _msdelay(unsigned long x) {
	_udelay(x * 1000);
}
#else
#error "RHINO_CONFIG_HW_COUNT should be configured to get us level delay"
#endif

static gpio_dev_t oled_gpio;
/*
	oled start
*/

//oled pin
#define CLK_PORT	0
#define SDA_PORT	1
#define RES_PORT	2
#define DC_PORT		3
#define OLED_CLK_PIN	HAL_IOMUX_PIN_P0_5
#define OLED_SDA_PIN	HAL_IOMUX_PIN_P4_0
#define OLED_RES_PIN	HAL_IOMUX_PIN_P4_1
#define OLED_DC_PIN		HAL_IOMUX_PIN_P2_7

static gpio_dev_t ultra_gpio;
#define ULTRASONIC_PIN	HAL_IOMUX_PIN_P4_7

#ifdef OLED_MODE_0_96
	#define OLED_PAGE_SIZES		128
#endif
#ifdef OLED_MODE_1_3
	#define OLED_PAGE_SIZES		132
#endif


uint8_t OLED_GRAM[OLED_PAGE_SIZES][8];

//12*6 ASCII
const unsigned char asc2_1206[95][12]={
{0x00,0x00,0x00,0x00,0x00,0x00,0x00,0x00,0x00,0x00,0x00,0x00},/*" ",0*/
{0x00,0x00,0x00,0x00,0x3F,0x40,0x00,0x00,0x00,0x00,0x00,0x00},/*"!",1*/
{0x00,0x00,0x30,0x00,0x40,0x00,0x30,0x00,0x40,0x00,0x00,0x00},/*""",2*/
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{0x40,0x00,0x80,0x00,0x40,0x00,0x20,0x00,0x20,0x00,0x40,0x00},/*"~",94*/
};  

static void OLED_GPIO_Set(unsigned char port,unsigned char leve)
{
	switch(port){
		case CLK_PORT:
			oled_gpio.port = OLED_CLK_PIN;
		break;

		case SDA_PORT:
			oled_gpio.port = OLED_SDA_PIN;
		break;

		case RES_PORT:
			oled_gpio.port = OLED_RES_PIN;
		break;

		case DC_PORT:
			oled_gpio.port = OLED_DC_PIN;
		break;

		default:
		break;
	}
	if(leve == 1){
		hal_gpio_output_high(&oled_gpio);
	}
	else if(leve == 0){
		hal_gpio_output_low(&oled_gpio);
	}
}

void OLED_SCLK( uint8_t x )
{
	if( x==1 ){
		OLED_GPIO_Set( CLK_PORT, 1 );
	}
	else if( x==0 ){
		OLED_GPIO_Set( CLK_PORT, 0);
	}		
}

void OLED_SDIN( uint8_t x )
{
	oled_gpio.port = OLED_SDA_PIN;
	if( x==0x80 ){
		hal_gpio_output_high(&oled_gpio);
	}
	else if( x==0 ){
		hal_gpio_output_low(&oled_gpio);
	}	
}

void OLED_RES( uint8_t x )
{
	if( x==1 ){
		OLED_GPIO_Set( RES_PORT, 1 );
	}
	else if( x==0 ){
		OLED_GPIO_Set( RES_PORT, 0);
	}		
}

void OLED_DC( uint8_t x )
{
	if( x==1 ){
		OLED_GPIO_Set( DC_PORT, 1 );
	}
	else if( x==0 ){
		OLED_GPIO_Set( DC_PORT, 0);
	}		
}

void OLED_WR_Cmd( uint8_t cmd )
{
	uint8_t i,k;

	OLED_DC(0);
	for( i=0;i<8;i++ )
	{
		OLED_SCLK(0);		
		k=cmd&(0x80);
		OLED_SDIN(k);
		OLED_SCLK(1);//high valid
		cmd<<=1;
	}
	OLED_DC(1);	
}

void OLED_WR_Data( uint8_t data )
{
	uint8_t i,k;

	OLED_DC(1);
	for( i=0;i<8;i++ )
	{
		OLED_SCLK(0);
		k=data&(0x80);
		OLED_SDIN(k);
		OLED_SCLK(1);
		data<<=1;
	}
	OLED_DC(1);
}
/* refresh */
void OLED_Refresh_GRAM( void )
{
	uint8_t i,j;
	for( i=0;i<8;i++ )
	{
		OLED_WR_Cmd(0xB0+i);
		OLED_WR_Cmd(0x00);
		OLED_WR_Cmd(0x10);
		for( j=0;j<OLED_PAGE_SIZES;j++ )
		{
			OLED_WR_Data(OLED_GRAM[j][i]);
		}
	}
}

/* clear */
void OLED_Clear( void )
{
	uint8_t i,j;
	for( i=0;i<8;i++ )
		for( j=0;j<OLED_PAGE_SIZES;j++ )
			OLED_GRAM[j][i]=0x0;
	OLED_Refresh_GRAM();
}

/* full */
void OLED_Full( void )
{
	uint8_t i,j;
	for( i=0;i<8;i++ )
		for( j=0;j<OLED_PAGE_SIZES;j++ )
			OLED_GRAM[j][i]=0xff;
	OLED_Refresh_GRAM();
}

//mode：0是反显，1是正常显示
void OLED_DrawPoint( uint8_t x,uint8_t y,uint8_t mode )
{
	uint8_t i,j,temp;
	if((x > (OLED_PAGE_SIZES-1)) || (y > 63))return;
	
	i=7-y/8;
	j=y%8;
	temp=0x01<<(7-j);
	if(mode==0)
		OLED_GRAM[x][i]&=~temp;
	else
		OLED_GRAM[x][i]|=temp;
}

void OLED_Show_Char( uint8_t x,uint8_t y,uint8_t chr,uint8_t size,uint8_t mode )
{
	uint8_t temp,t,t1;
	uint8_t y0=y;

	uint8_t csize=(size/8+((size%8)?1:0))*(size/2);

	LOGI("APP", "++++ char=%c size=%d\n",chr,csize);
	chr=chr-' ';
	for( t=0;t<csize;t++ )
	{	
		switch( size )
		{
			case 12:temp=asc2_1206[chr][t];break;//12x6
			//case 16:temp=asc2_1608[chr][t];break;//16x8
			//case 24:temp=asc2_2412[chr][t];break;//24x12
			default:return;
		}
		LOGI("APP", " new char x= %d,y=%d,t =%d %d\n",x,y,t,temp);
		for( t1=0;t1<8;t1++ )
		{
			if( temp&0x80 )
				OLED_DrawPoint( x,y,mode );
			else
				OLED_DrawPoint( x,y,!mode );
			
			temp<<=1;
			y++;
			LOGI("APP", "x= %d,y=%d\n",x,y);
			if(( y-y0 )==size )
			{
				LOGI("APP", "new line\n");
				y=y0;
				x++;
				break;
			}
		}
	}
}

void OLED_Show_String( uint8_t x, uint8_t y, const uint8_t *p, uint8_t size, uint8_t mode )
{
	while( (*p<='~')&&(*p>=' ') )
	{
		if( x>(OLED_PAGE_SIZES-(size/2)) )
		{
			x=0;
			y=y+size;
		}
		if( y>(64-size) )
		{
			x=y=0;
			OLED_Clear();
		}
		
		OLED_Show_Char( x,y,*p,size,mode );
		x=x+size/2;
		p++;
	}
	OLED_Refresh_GRAM();
}

/* OLED init */
void OLED_Init( void )
{	
	//OLED_CS(1);
	OLED_DC(1);
	
	/* reset */
	OLED_RES(0);
	_msdelay(1000);
	OLED_RES(1);
	
	OLED_WR_Cmd(0xAE);//关闭显示
	OLED_WR_Cmd(0xD5);//设置时钟分频因子
	OLED_WR_Cmd(80);
	
	OLED_WR_Cmd(0xA8);//设置驱动路数
	OLED_WR_Cmd(0x3F);//路数默认0x3F（1/64）
	
	OLED_WR_Cmd(0xD3);//设置显示偏移
	OLED_WR_Cmd(0x00);//偏移默认为0
	
	OLED_WR_Cmd(0x40);//设置显示开始行[5:0]
	
	OLED_WR_Cmd(0x8D);//电荷泵设置
	OLED_WR_Cmd(0x14);//bit2，开启/关闭
	
	OLED_WR_Cmd(0x20);//设置内存地址模式
	OLED_WR_Cmd(0x02);//[1:0],00，列地址模式;01，行地址模式;10,页地址模式;默认10;
	
	OLED_WR_Cmd(0xA1);//段重定义设置,bit0:0,0->0;1,0->127;
	OLED_WR_Cmd(0xC0);//设置COM扫描方向;bit3:0,普通模式;1,重定义模式 COM[N-1]->COM0;N:驱动路数
	OLED_WR_Cmd(0xDA);//设置COM硬件引脚配置
	OLED_WR_Cmd(0x12);//[5:4]配置
	
	OLED_WR_Cmd(0x81);//对比度设置
	OLED_WR_Cmd(0xEF);//默认0x7F（范围1~255，越大越亮）
	
	OLED_WR_Cmd(0xD9);//设置预充电周期
	OLED_WR_Cmd(0xF1);//[3:0],PHASE 1;[7:4],PHASE 2;
	
	OLED_WR_Cmd(0xDB);//设置VCOMH 电压倍率
	OLED_WR_Cmd(0x30);//[6:4] 000,0.65*vcc;001,0.77*vcc;011,0.83*vcc;
	
	OLED_WR_Cmd(0xA4);//全局显示开启;bit0:1,开启;0,关闭;(白屏/黑屏)
	OLED_WR_Cmd(0xA6);//设置显示方式;bit0:1,反相显示;0,正常显示
	
	OLED_WR_Cmd(0xAF);//开启显示
	
	/* 清屏函数 */
	OLED_Clear();
	_msdelay(2000);
	OLED_Show_String(6,12*0,"Welcome to Alibaba!",12,1);
	OLED_Show_String(24,(12+4)*1,"This is Haas!",12,1);
	OLED_Show_String(24,(12+4)*2,"2000-01-01 00:00",12,1);
	OLED_Show_String(24,(12+4)*3,"T:30^C H:70%",12,1);
}
/*  oled end  */

void Utral_ctrl(void)
{
	hal_gpio_output_high(&ultra_gpio);
	_udelay(15);
	hal_gpio_output_low(&ultra_gpio);
}

extern uint8_t dis_flag;
static void handle_haas_cmd(char *pwbuf, int blen, int argc, char **argv)
{
	if(0 == strcmp(argv[1],"0")){
		OLED_Show_String(24,12*0,"AliOS Things4.0",12,1);
		OLED_Show_String(24,(12+4)*1,"This is Haas!",12,1);
		OLED_Show_String(24,(12+4)*2,"2000-01-01 00:00",12,1);
		OLED_Show_String(24,(12+4)*3,"T:30^C H:70%",12,1);
		dis_flag = 1;
	}
	else if(0 == strcmp(argv[1],"1")){
		dis_flag = 2;
		OLED_Clear();
		LOGI("APP", "oled clear\n");
	}
	else if(0 == strcmp(argv[1],"2")){
		dis_flag = 2;
		OLED_Full();
		LOGI("APP", "oled full\n");
	}

	else if(0 == strcmp(argv[1],"3")){
		Utral_ctrl();
		LOGI("APP", "utral ctrl!\n");
	}
}
static struct cli_command haas_cmd = {
    .name     = "haas",
    .help     = "haas [read]",
    .function = handle_haas_cmd
};

void ultrasonic_gpio_init(void)
{	
	ultra_gpio.port = ULTRASONIC_PIN;
    ultra_gpio.config = OUTPUT_PUSH_PULL;
    hal_gpio_init(&ultra_gpio);
	hal_gpio_output_low(&ultra_gpio);
}

/* oled gpio init */
int oled_gpio_init(void)
{
	int ret = 0;

	oled_gpio.port = OLED_CLK_PIN;
    oled_gpio.config = OUTPUT_PUSH_PULL;
    hal_gpio_init(&oled_gpio);
	oled_gpio.port = OLED_SDA_PIN;
    oled_gpio.config = OUTPUT_PUSH_PULL;
    hal_gpio_init(&oled_gpio);
	oled_gpio.port = OLED_RES_PIN;
    oled_gpio.config = OUTPUT_PUSH_PULL;
    hal_gpio_init(&oled_gpio);
	oled_gpio.port = OLED_DC_PIN;
    oled_gpio.config = OUTPUT_PUSH_PULL;
    hal_gpio_init(&oled_gpio);
	OLED_Init();
	ultrasonic_gpio_init();
	aos_cli_register_command(&haas_cmd);
    return ret;
}