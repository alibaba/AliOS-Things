## application/example/ulocation/qianxun_demo/Config.in
```kconfig
config AOS_APP_QIANXUN_DEMO
    bool "qianxun_demo"
    select AOS_COMP_ULOCATION
    select AOS_COMP_CLI
    select AOS_COMP_YLOOP
    select AOS_COMP_NETMGR
    help
        uLocation qianxun service app

if AOS_APP_QIANXUN_DEMO
# Configurations for app qianxun_demo
config CONFIG_QXWZ_ENABLED
    bool "support QXWZ service"
    default y
    help
        Press <Y> here to add support for the QXSI high accuracy service.

config SYSINFO_APP_VERSION
    string "Firmware Version"
    default "app-1.0.0-20200214.140831"
    help
        application main firmware version
endif
```

## application/example/ulog_demo/Config.in
```kconfig
config AOS_APP_ULOG_DEMO
    bool "ulog_demo"
    help
        demo for ulog, show syslog udp pop out and save in file system.

# Configurations for app ulog_demo

if AOS_APP_ULOG_DEMO
config ULOGAPP_CONFIG_UDP
    bool "enable test ulog pop out via udp"
    default n
    help
        enable ulog pop out via udp
	
config ULOGAPP_CONFIG_LOG_FILE
    bool "enable test ulog pop out via file system"
    default n
    help
        enable ulog pop out via file system

if ULOGAPP_CONFIG_LOG_FILE	
choice
    prompt "Choose Type of File System"
    default ULOGDEMO_CONFIG_SPIFFS
    help
        Select the type for file system  

    config ULOGDEMO_CONFIG_SPIFFS
    select ULOG_CONFIG_POP_FS
    select ULOG_CONFIG_FS_SPIFFS
    bool "enable test ulog pop out via file system spiffs"

    config ULOGDEMO_CONFIG_LINUXHOST
    select ULOG_CONFIG_POP_FS
    select ULOG_CONFIG_FS_SPIFFS
    bool "enable test ulog pop out via unix file system"

    config ULOGDEMO_CONFIG_RAW_FATFS
    select ULOG_CONFIG_POP_FS
    select ULOG_CONFIG_FS_FATFS_SD
    bool "enable test ulog pop out via raw fatfs"

    config ULOGDEMO_CONFIG_SD_CARD
    select ULOG_CONFIG_POP_FS
    select ULOG_CONFIG_FS_FATFS_FLASH
    bool "enable test ulog pop out via sd card"

endchoice

endif

config SYSINFO_APP_VERSION
    string "Firmware Version"
    default "app-1.0.0-20200214.140831"
    help
        application main firmware version
        
endif
```

## application/example/umesh2_demo/Config.in
```kconfig
config AOS_APP_UMESH2_DEMO
    bool "umesh2_demo"
    select AOS_COMP_UMESH2  if !AOS_CREATE_PROJECT
    select AOS_COMP_NETMGR if !AOS_CREATE_PROJECT
    select AOS_COMP_CLI if !AOS_CREATE_PROJECT
    select AOS_COMP_ULOG  if !AOS_CREATE_PROJECT
    select AOS_COMP_LWIP if !AOS_CREATE_PROJECT
    help
        uMesh2 sample application

if AOS_APP_UMESH2_DEMO
    menu "umesh2app Configurations"
        config ENABLE_PRINT_HEAP
            bool "print heap size duration"
            default y
            help
                enable printf heap size 
                
        config ENABLE_WATCH_DOG
            bool "enable hardware watchdog"
            default y
            help
                hardware watchdog

        config ENABLE_LOOP_TEST
            bool "running without deinit"
            default y
            help
                repeated testing

        config ENABLE_REPEAT_TEST
            bool "full phase repeated test"
            default n
            depends on !ENABLE_LOOP_TEST
            help
                repeated testing

    choice
        prompt "Select Case"
        default UMESH2_SERVICE
        help
            select case to build

        config UMESH2_SERVICE
            bool "local comm service"
            help
                default case, local communication framework example

        config UMESH2_ZERO_CONFIG
            bool "zero config"
            help
                wifi zero config example
    endchoice

    endmenu

config SYSINFO_APP_VERSION
    string "Firmware Version"
    default "app-1.0.0-20200316.000000"
    help
        application main firmware version

endif
```

## application/example/umesh2app/Config.in
```kconfig
config AOS_APP_UMESH2APP
    bool "umesh2app"
    select AOS_COMP_UMESH2 
    select AOS_COMP_NETMGR
    select AOS_COMP_CLI
    select AOS_COMP_ULOG 
    select AOS_COMP_LWIP
    help
        uMesh2 sample application
```

## application/example/uvoice_demo/Config.in
```kconfig
config AOS_APP_UVOICE_DEMO
    bool "uVoice Sample Application"
    select AOS_COMP_UVOICE
    select AOS_COMP_CLI
    select AOS_COMP_NETMGR
    select AOS_COMP_MBEDTLS    
    help
        uVoice Sample


if AOS_APP_UVOICE_DEMO
# Configurations for app uvoice_demo
config SYSINFO_APP_VERSION
    string "Firmware Version"
    default "app-1.0.0-20201117.105500"
    help
        application main firmware version
endif
```

## application/example/vfs_demo/Config.in
```kconfig
config AOS_APP_VFS_DEMO
    bool "VFS Demo"
    select AOS_COMP_OSAL_AOS if !AOS_CREATE_PROJECT
    select AOS_COMP_RAMFS if !AOS_CREATE_PROJECT
    help
    Hello World

if AOS_APP_VFS_DEMO
# Configurations for app helloworld
config SYSINFO_APP_VERSION
    string "Firmware Version"
    default "app-1.0.0-20200214.140831"
    help
        application main firmware version
endif
```

## application/example/websoc_app/Config.in
```kconfig
config AOS_APP_WEBSOC_APP
    bool "websoc app"
    select AOS_COMP_NETMGR
    select AOS_COMP_CLI
    select AOS_COMP_YLOOP
    select AOS_COMP_WEBSOC
    help
        websoc app

if AOS_APP_WEBSOC_APP
# Configurations for websoc app
endif
```

## application/example/wificamera_demo/Config.in
```kconfig
config AOS_APP_WIFICAMERA_DEMO
    bool "HTTP App "
    select AOS_COMP_NETMGR if !AOS_CREATE_PROJECT
    # the selection of dependencies are to be removed soon
    select AOS_COMP_HTTP if !AOS_CREATE_PROJECT
    select CONFIG_NEW_HTTP_API
    select AOS_COMP_CLI if !AOS_CREATE_PROJECT
    select AOS_COMP_CPLUSPLUS if !AOS_CREATE_PROJECT
    help
        wifi camera app

if AOS_APP_WIFICAMERA_DEMO
config SYSINFO_APP_VERSION
    string "Firmware Version"
    default "app-1.0.0-20200214.140831"
    help
        application main firmware version
endif
```

## application/example/yloop_app/Config.in
```kconfig
config AOS_APP_YLOOP_APP
    bool "yloop app"
    select AOS_COMP_NETMGR
    select AOS_COMP_CLI
    select AOS_COMP_YLOOP
    help

if AOS_APP_YLOOP_APP
# Configurations for yloop app
endif
```

## application/example/yloop_demo/Config.in
```kconfig
config AOS_APP_YLOOP_DEMO
    bool "Yloop Demo"
    select AOS_COMP_OSAL_AOS if !AOS_CREATE_PROJECT
    help
        Yloop Demo

if AOS_APP_YLOOP_DEMO
# Configurations for app yloop_demo
config SYSINFO_APP_VERSION
    string "Firmware Version"
    default "app-1.0.0-20200214.140831"
    help
        application main firmware version
endif
```

## application/example/yts_demo/publish/Config.in
```kconfig
config AOS_APP_YTS_DEMO
    bool "Test Suite Demo"
    select AOS_COMP_ULOG
    select CONFIG_AOS_TCPIP if AOS_BOARD_LINUXHOST || AOS_BOARD_ARMHFLINUX
    select AOS_COMP_CLI if !AOS_BOARD_LINUXHOST && !AOS_BOARD_ARMHFLINUX
    select AOS_COMP_NETMGR if AOS_BOARD_LINUXHOST || AOS_BOARD_ARMHFLINUX
    select AOS_COMP_TESTCASE
    select AOS_COMP_FATFS if AOS_BOARD_LINUXHOST || AOS_BOARD_ARMHFLINUX
    select AOS_COMP_YLOOP
    select AOS_COMP_DDA if AOS_BOARD_LINUXHOST || AOS_BOARD_ARMHFLINUX
    select AOS_COMP_VFS
    help
      AliOS Things test suite


if AOS_APP_YTS_DEMO
# Configurations for app yts_demo
endif
\
```

## application/profile/Config.in
```kconfig
config AOS_APP_PROFILE
    bool "Builtin Profiles"

if AOS_APP_PROFILE
choice
    prompt "Select profile"

source "application/profile/gatewayapp/Config.in"
if AOS_APP_GATEWAYAPP
    config AOS_BUILD_APP
        default "gatewayapp"
endif
endchoice
source "application/profile/tmall_model/Config.in"

if AOS_COMP_TMALL_MODEL
    config AOS_BUILD_APP
        default "tmall_model"
endif


endif
```

## application/profile/gatewayapp/Config.in
```kconfig
config AOS_APP_GATEWAYAPP
    bool "Gateway Profile"
    select AOS_COMP_SENSOR
    select AOS_COMP_CJSON
    select AOS_COMP_NETMGR
    select AOS_COMP_UDATA
    select AOS_COMP_MBMASTER
    select AOS_COMP_LINKKIT_SDK_C
    select AOS_COMP_LIBIOT_MQTT
    select DEVICE_MODEL_ENABLED
    select CONFIG_AOS_TCPIP if GATEWAYAPP_CONFIG_DTC
    select AOS_COMP_CLI if AOS_BOARD_ESP8266 && GATEWAYAPP_CONFIG_DTC
    help
      gateway profile

if AOS_APP_GATEWAYAPP
# Configurations for app gatewayapp

config GATEWAYAPP_CONFIG_PT_SCANNER
    bool "Device model: scanner"
    default y
    help

config GATEWAYAPP_CONFIG_PT_SENSOR
    bool "Device model: MODBUS/CAN sensors"
    default n
    help

config GATEWAYAPP_CONFIG_DTC_ENABLE
    bool "data to cloud"
    default n
    help
    
config SYSINFO_APP_VERSION
    string "Firmware Version"
    default "app-1.0.0-20200214.140831"
    help
        application main firmware version
endif
```

## application/profile/tmall_model/Config.in
```kconfig
if AOS_CREATE_PROJECT
config AOS_COMP_TMALL_MODEL
    bool
    default y
endif

if !AOS_CREATE_PROJECT
config AOS_COMP_TMALL_MODEL
    bool
    default n
endif
```

## board/AIoTKIT/Config.in
```kconfig
config AOS_BOARD_AIOTKIT
    bool "AIoTKIT"
    select AOS_MCU_STM32L4XX_CUBE
    select AOS_COMP_KERNEL_INIT
    select AOS_COMP_SAL if AOS_NETWORK_SAL
    select AOS_COMP_NETMGR if AOS_NETWORK_SAL
    help

if AOS_BOARD_AIOTKIT
# Configurations for board AIoTKIT

# "BSP SUPPORT FEATURE"
config BSP_SUPPORT_UART
    bool
    default y

config BSP_SUPPORT_FLASH
    bool
    default y

config BSP_SUPPORT_GPIO
    bool
    default y

config BSP_SUPPORT_I2C
    bool
    default y

config BSP_SUPPORT_SPI
    bool
    default y

config BSP_SUPPORT_RTC
    bool
    default y

config BSP_SUPPORT_TIMER
    bool
    default y

config BSP_SUPPORT_WIFI
    bool
    default y

config BSP_SUPPORT_EXTERNAL_MODULE
    bool
    default y

config BSP_EXTERNAL_WIFI_MODULE
    string
    depends on BSP_SUPPORT_EXTERNAL_MODULE
    default "wifi.mk3060"

endif
```
