## board/aaboard_demo/Config.in
```kconfig
menuconfig AOS_BOARD_AABOARD_DEMO
    bool "aaboard_demo"
    select AOS_MCU_AAMCU_DEMO
    select AOS_COMP_KERNEL_INIT
    help

if AOS_BOARD_AABOARD_DEMO
# Configurations for board aaboard_demo
endif
```

## board/amebaz_dev/Config.in
```kconfig
config AOS_BOARD_AMEBAZ_DEV
    bool "AMEBAZ_DEV"
    select AOS_MCU_RTL8710BN
    select AOS_COMP_KERNEL_INIT
    help
        **Amebaz-dev** is a highly integrated single-chip low power 802.11n Wireless LAN (WLAN) network controller.

if AOS_BOARD_AMEBAZ_DEV
# Configurations for board board_amebaz_dev

config DEBUG_CONFIG_PANIC
    bool "Enable debug panic feature"
    default y
    help
        set to y if you want to enable panic debug feature when system crash happened,
        default y

config DEBUG_CONFIG_BACKTRACE
    bool "Enable stack backtrace feature"
    default y
    help
        set to y if you want to enable stack backtrace feature when system crash happened,
        default y

# "BSP SUPPORT FEATURE"
config BSP_SUPPORT_UART
    bool
    default y

config BSP_SUPPORT_GPIO
    bool
    default y

config BSP_SUPPORT_FLASH
    bool
    default y

config BSP_SUPPORT_TIMER
    bool
    default y

config BSP_SUPPORT_WDG
    bool
    default y

config BSP_SUPPORT_WIFI
    bool
    default y

endif
```

## board/ap80/Config.in
```kconfig
menuconfig AOS_BOARD_AP80
    bool "ap80"
    select AOS_MCU_MVS_AP80XX
    help

if AOS_BOARD_AP80
# Configurations for board ap80
endif
```

## board/ap80a0/Config.in
```kconfig
config AOS_BOARD_AP80A0
    bool "ap80a0"
    select AOS_MCU_MVS_AP80XX
    select AOS_COMP_NEWLIB_STUB
    help

if AOS_BOARD_AP80A0
# Configurations for board ap80a0
endif
```

## board/asr5501/Config.in
```kconfig
config AOS_BOARD_ASR5501
    bool "ASR5501"
    select AOS_MCU_ASR5501
    select AOS_COMP_KERNEL_INIT
    select AOS_COMP_LWIP if AOS_NETWORK_SAL
    select AOS_COMP_NETMGR
    help

if AOS_BOARD_ASR5501
# Configurations for board asr5501

config DEBUG_CONFIG_PANIC
    bool "Enable debug panic feature"
    default y
    help
        set to y if you want to enable panic debug feature when system crash happened,
        default y

config DEBUG_CONFIG_BACKTRACE
    bool "Enable stack backtrace feature"
    default y
    help
        set to y if you want to enable stack backtrace feature when system crash happened,
        default y

# "BSP SUPPORT FEATURE"
config BSP_SUPPORT_UART
    bool
    default y

config BSP_SUPPORT_GPIO
    bool
    default y

config BSP_SUPPORT_FLASH
    bool
    default y

config BSP_SUPPORT_I2C
    bool
    default y

config BSP_SUPPORT_WIFI
    bool
    default y

config BSP_SUPPORT_WIFI_LOWPOWER
    bool
    default y

endif
```

## board/asr6501/Config.in
```kconfig
config AOS_BOARD_ASR6501
    bool "ASR6501"
    select AOS_MCU_CY8C4147
    select AOS_COMP_KERNEL_INIT
    select AOS_COMP_LORAWAN_4_4_2 if lorawanback = n
    select AOS_COMP_LORAWAN_4_4_0 if lorawanback = y
    help

if AOS_BOARD_ASR6501
# Configurations for board asr6501
config lorawanback
    bool "lorawanback"
    default n

# "BSP SUPPORT FEATURE"
config BSP_SUPPORT_I2C
    bool
    default y

config BSP_SUPPORT_FLASH
    bool
    default y

config BSP_SUPPORT_LORA
    bool
    default y

endif
```

## board/atsame54-xpro/Config.in
```kconfig
menuconfig AOS_BOARD_ATSAME54-XPRO
    bool "board_atsame54-xpro"
    select AOS_MCU_ATSAME54
    select AOS_COMP_SAL if AOS_NETWORK_SAL
    help
      configuration for board atsame54-xpro

if AOS_BOARD_ATSAME54-XPRO
# Configurations for board board_atsame54-xpro

# Set default value of AOS_NETWORK_SAL
config AOS_NETWORK_SAL
    default y
endif
```

## board/b_l475e/Config.in
```kconfig
config AOS_BOARD_B_L475E
    bool "board_b_l475e"
    default n
    help

if AOS_BOARD_B_L475E
# Configurations for board b_l475e
endif
```

## board/bk7231devkitc/Config.in
```kconfig
config AOS_BOARD_BK7231
    bool "board_bk7231"
    default n
    select AOS_MCU_BK7231
    help

if AOS_BOARD_BK7231
# Configurations for board bk7231
endif
```
