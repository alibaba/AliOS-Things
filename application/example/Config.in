## application/example/example_legacy/bluetooth/blemesh_tmall/Config.in
```kconfig
config AOS_APP_BLEMESH_TMALL
    bool "AliGenie BLE Mesh Network Sample"
    select AOS_COMP_BT_HOST
    select AOS_COMP_TMALL_MODEL
    select AOS_COMP_CLI
    select AOS_COMP_YLOOP
    select AOS_CONFIG_BT_SMP if AOS_COMP_BT_HOST
    help
        Sample code to demenstrate how to join AliGenie BLE Mesh network.

#if AOS_APP_BLEMESH_TMALL
# Configurations for app blemesh_tmall
#endif
```

## application/example/example_legacy/bluetooth/bleperipheral/Config.in
```kconfig
config AOS_APP_BLEPERIPHERAL
    bool "BLE Peripheral Role Sample"
    help
        ble peripheral sample

if AOS_APP_BLEPERIPHERAL
# Configurations for app bleperipheral
endif
```

## application/example/example_legacy/bluetooth/breezeapp/Config.in
```kconfig
config AOS_APP_BREEZEAPP
    bool "Breeze Application Sample"
    select AOS_COMP_BREEZE
    select AOS_COMP_OTA if CONFIG_COMP_BZ_OTA
    select OTA_CONFIG_BLE if CONFIG_COMP_BZ_OTA
    select AOS_COMP_CLI
    help
        Breeze application demo, prioviding secure BLE link to Alibaba IoT cloud and service.

if AOS_APP_BREEZEAPP
# Configurations for app breezeapp
config BLE
    bool "BLE Enable"
    default y
    help

config CONFIG_COMP_BZ_OTA
    bool "Enable OTA With Breeze Link."
    default n
    help

config SYSINFO_APP_VERSION
    string "Firmware Version"
    default "app-1.0.0-20200214.140831"
    help
        application main firmware version
        
endif
```

## application/example/example_legacy/coapapp/Config.in
```kconfig
config AOS_APP_COAPAPP
    bool "COAP Sample"
# the selection of dependencies are to be removed soon
    select AOS_COMP_LIBCOAP
    select AOS_COMP_NETMGR
    select AOS_COMP_CLI
    help
        coap client example

if AOS_APP_COAPAPP
config SYSINFO_APP_VERSION
    string "Firmware Version"
    default "app-1.0.0-20200214.140831"
    help
        application main firmware version
        
endif
```

## application/example/example_legacy/das_app/Config.in
```kconfig
config AOS_APP_DAS_APP
    bool "DAS Client Sample"
    select AOS_COMP_DAS if !AOS_CREATE_PROJECT
    select AOS_COMP_NETMGR if !AOS_CREATE_PROJECT
    select AOS_COMP_CLI if !AOS_CREATE_PROJECT
    select AOS_COMP_CJSON if !AOS_CREATE_PROJECT
    select AOS_COMP_SDK_MQTT if !AOS_CREATE_PROJECT

    help
        das(Device Attestation) example

if AOS_APP_DAS_APP

config DAS_CLIENT_CONFIG_TEST_LOOP
    bool "Test Loop"
    default y
    help

config SYSINFO_APP_VERSION
    string "Firmware Version"
    default "app-1.0.0-20200214.140831"
    help
        application main firmware version

endif
```

## application/example/example_legacy/debug_app/Config.in
```kconfig
config AOS_APP_DEBUG_APP
    bool "debug_app"
    select AOS_COMP_DEBUG
    select AOS_COMP_CLI
    select AOS_COMP_OSAL_AOS
    select AOS_COMP_KV
    help
        demo for debug api

if AOS_APP_DEBUG_APP
# Configurations for app debug
config SYSINFO_APP_VERSION
    string "Firmware Version"
    default "app-1.0.0-20200214.140831"
    help
        application main firmware version
endif
```

## application/example/example_legacy/dk/dk_audio/Config.in
```kconfig
config AOS_APP_DK_AUDIO
    bool "DeveloperKit Audio Sample"
    select AOS_COMP_CLI
    select AOS_COMP_YLOOP
    help
        Developer Kit audio example

if AOS_APP_DK_AUDIO
# Configurations for app dk_audio
config SYSINFO_APP_VERSION
    string "Firmware Version"
    default "app-1.0.0-20200214.140831"
    help
        application main firmware version
endif
```

## application/example/example_legacy/dk/dk_camera/Config.in
```kconfig
config AOS_APP_DK_CAMERA
    bool "DeveloperKit Camera Sample"
    select AOS_COMP_FATFS if !AOS_CREATE_PROJECT
    select AOS_COMP_CLI if !AOS_CREATE_PROJECT
    select AOS_COMP_YLOOP if !AOS_CREATE_PROJECT
    help
        developer kit camera sample

if AOS_APP_DK_CAMERA
# Configurations for app dk_camera
config SYSINFO_APP_VERSION
    string "Firmware Version"
    default "app-1.0.0-20200214.140831"
    help
        application main firmware version
endif
```
