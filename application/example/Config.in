## application/example/Config.in
```kconfig
config AOS_APP_EXAMPLE
    bool "Builtin Examples"

if AOS_APP_EXAMPLE
choice
    prompt "Select example"

source "application/example/athost_app/Config.in"
if AOS_APP_ATHOST_APP
    config AOS_BUILD_APP
        default "athost_app"
endif

source "application/example/blink/Config.in"
if AOS_APP_BLINK
    config AOS_BUILD_APP
        default "blink"
endif

source "application/example/bluetooth/bleadv/Config.in"
if AOS_APP_BLEADV
    config AOS_BUILD_APP
        default "bluetooth.bleadv"
endif

source "application/example/bluetooth/blemesh_tmall/Config.in"
if AOS_APP_BLEMESH_TMALL
    config AOS_BUILD_APP
        default "bluetooth.blemesh_tmall"
endif

source "application/example/bluetooth/bleperipheral/Config.in"
if AOS_APP_BLEPERIPHERAL
    config AOS_BUILD_APP
        default "bluetooth.bleperipheral"
endif

source "application/example/bluetooth/breezeapp/Config.in"
if AOS_APP_BREEZEAPP
    config AOS_BUILD_APP
        default "bluetooth.breezeapp"
endif

source "application/example/coapapp/Config.in"
if AOS_APP_COAPAPP
    config AOS_BUILD_APP
        default "coapapp"
endif

source "application/example/das_app/Config.in"
if AOS_APP_DAS_APP
    config AOS_BUILD_APP
        default "das_app"
endif

source "application/example/dk/dk_audio/Config.in"
if AOS_APP_DK_AUDIO
    config AOS_BUILD_APP
        default "dk.dk_audio"
endif

source "application/example/dk/dk_camera/Config.in"
if AOS_APP_DK_CAMERA
    config AOS_BUILD_APP
        default "dk.dk_camera"
endif

source "application/example/dk/dk_gui/Config.in"
if AOS_APP_DK_GUI
    config AOS_BUILD_APP
        default "dk.dk_gui"
endif

source "application/example/dk/dk_qr/Config.in"
if AOS_APP_DK_QR
    config AOS_BUILD_APP
        default "dk.dk_qr"
endif

source "application/example/helloworld/Config.in"
if AOS_APP_HELLOWORLD
    config AOS_BUILD_APP
        default "helloworld"
endif

source "application/example/halapp/Config.in"
if AOS_APP_HALAPP
    config AOS_BUILD_APP
        default "halapp"
endif

source "application/example/kernel_app/Config.in"
if AOS_APP_KERNEL_APP
    config AOS_BUILD_APP
        default "kernel_app"
endif

source "application/example/http2app/Config.in"
if AOS_APP_HTTP2APP
    config AOS_BUILD_APP
        default "http2app"
endif

source "application/example/id2_app/Config.in"
if AOS_APP_ID2_APP
    config AOS_BUILD_APP
        default "id2_app"
endif

source "application/example/itls_app/Config.in"
if AOS_APP_ITLS_APP
    config AOS_BUILD_APP
        default "itls_app"
endif

source "application/example/linkkit_gateway/Config.in"
if AOS_APP_LINKKIT_GATEWAY
    config AOS_BUILD_APP
        default "linkkit_gateway"
endif

source "application/example/linkkitapp/Config.in"
if AOS_APP_LINKKITAPP
    config AOS_BUILD_APP
        default "linkkitapp"
endif

source "application/example/lorawan/linkwan/Config.in"
if AOS_APP_LINKWAN
    config AOS_BUILD_APP
        default "lorawan.linkwan"
endif

source "application/example/meshapp/Config.in"
if AOS_APP_MESHAPP
    config AOS_BUILD_APP
        default "meshapp"
endif

source "application/example/modbus_app/Config.in"
if AOS_APP_MODBUS_APP
    config AOS_BUILD_APP
        default "modbus_app"
endif

source "application/example/mqttapp/Config.in"
if AOS_APP_MQTTAPP
    config AOS_BUILD_APP
        default "mqttapp"
endif

source "application/example/otaapp/Config.in"
if AOS_APP_OTAAPP
    config AOS_BUILD_APP
        default "otaapp"
endif

source "application/example/prov_app/Config.in"
if AOS_APP_PROV_APP
    config AOS_BUILD_APP
        default "prov_app"
endif

source "application/example/sk/sk_gui/Config.in"
if AOS_APP_SK_GUI
    config AOS_BUILD_APP
        default "sk.sk_gui"
endif

source "application/example/uart/Config.in"
if AOS_APP_UART
    config AOS_BUILD_APP
        default "uart"
endif

source "application/example/udataapp/Config.in"
if AOS_APP_UDATAAPP
    config AOS_BUILD_APP
        default "udataapp"
endif

source "application/example/ulocation/baseapp/Config.in"
if AOS_APP_BASEAPP
    config AOS_BUILD_APP
        default "ulocation.baseapp"
endif

source "application/example/ulocation/qianxunapp/Config.in"
if AOS_APP_QIANXUNAPP
    config AOS_BUILD_APP
        default "ulocation.qianxunapp"
endif

source "application/example/yts/Config.in"
if AOS_APP_YTS
    config AOS_BUILD_APP
        default "yts"
endif

source "application/example/httpapp/Config.in"
if AOS_APP_HTTPAPP
    config AOS_BUILD_APP
        default "httpapp"
endif

source "application/example/httpclient_app/Config.in"
if AOS_APP_HTTPCLIENT_APP
    config AOS_BUILD_APP
        default "httpclient_app"
endif

source "application/example/udata_demo/sensor_local_demo/Config.in"
if AOS_APP_SENSOR_LOCAL_DEMO
    config AOS_BUILD_APP
        default "udata_demo.sensor_local_demo"
endif

source "application/example/udata_demo/sensor_cloud_demo/Config.in"
if AOS_APP_SENSOR_CLOUD_DEMO
    config AOS_BUILD_APP
        default "udata_demo.sensor_cloud_demo"
endif

source "application/example/udata_demo/udata_local_demo/Config.in"
if AOS_APP_UDATA_LOCAL_DEMO
    config AOS_BUILD_APP
        default "udata_demo.udata_local_demo"
endif


source "application/example/udata_demo/udata_cloud_demo/Config.in"
if AOS_APP_UDATA_CLOUD_DEMO
    config AOS_BUILD_APP
        default "udata_demo.udata_cloud_demo"
endif

source "application/example/jsengine_app/Config.in"
if AOS_APP_JSENGINE_APP
    config AOS_BUILD_APP
        default "jsengine_app"
endif

source "application/example/uai_demo/uai_kws_demo/Config.in"
if AOS_APP_UAI_KWS_DEMO
    config AOS_BUILD_APP
        default "uai_demo.uai_kws_demo"
endif

source "application/example/uai_demo/uai_cifar10_demo/Config.in"
if AOS_APP_UAI_CIFAR10_DEMO
    config AOS_BUILD_APP
        default "uai_demo.uai_cifar10_demo"
endif

source "application/example/uapp1/Config.in"
if AOS_APP_UAPP1
    config AOS_BUILD_APP
        default "uapp1"
endif

source "application/example/uapp2/Config.in"
if AOS_APP_UAPP2
    config AOS_BUILD_APP
        default "uapp2"
endif

source "application/example/ulog_app/Config.in"
if AOS_APP_ULOG_APP
    config AOS_BUILD_APP
        default "ulog_app"
endif

source "application/example/sal_app/Config.in"
if AOS_APP_SAL_APP
    config AOS_BUILD_APP
        default "sal_app"
endif

source "application/example/yloop_app/Config.in"
if AOS_APP_YLOOP_APP
    config AOS_BUILD_APP
        default "yloop_app"
endif

source "application/example/websoc_app/Config.in"
if AOS_APP_WEBSOC_APP
    config AOS_BUILD_APP
        default "websoc_app"
endif

source "application/example/httpdns_app/Config.in"
if AOS_APP_HTTPDNS_APP
    config AOS_BUILD_APP
        default "httpdns_app"
endif

source "application/example/atparser_app/Config.in"
if AOS_APP_ATPARSER_APP
    config AOS_BUILD_APP
        default "atparser_app"
endif

source "application/example/lwm2m_app/Config.in"
if AOS_APP_LWM2M_APP
    config AOS_BUILD_APP
        default "lwm2m_app"
endif

source "application/example/mal_app/Config.in"
if AOS_APP_MAL_APP
    config AOS_BUILD_APP
        default "mal_app"
endif

source "application/example/debug_app/Config.in"
if AOS_APP_DEBUG_APP
    config AOS_BUILD_APP
        default "debug_app"
endif

endchoice
endif
```

## application/example/amp_app/Config.in
```kconfig
config AOS_APP_AMP
    bool "amp application"
    select AOS_COMP_OSAL_AOS
    select AOS_COMP_NETMGR
    select AOS_COMP_AMP
    select AOS_COMP_MBEDTLS
    select MBEDTLS_CONFIG_CRYPTO_MD5
    help
        AliOS Things mini program

if AOS_APP_AMP
# Configurations for app amp
config SYSINFO_APP_VERSION
    string "Firmware Version"
    default "app-1.0.0-20200716.140831"
    help
        application main firmware version
endif
```

## application/example/app_nomain/Config.in
```kconfig
config AOS_APP_APPNOMAIN
    bool "AppNomain"
    select AOS_COMP_OSAL_AOS
    help
        App Demo

if AOS_APP_APPNOMAIN
# Configurations for app app_nomain
endif
```

## application/example/appdemo/Config.in
```kconfig
config AOS_APP_APPDEMO
    bool "AppDemo"
    select AOS_COMP_OSAL_AOS
    help
        App Demo

if AOS_APP_APPDEMO
# Configurations for app appdemo
config SYSINFO_APP_VERSION
    string "Firmware Version"
    default "app-1.0.0-20200214.140831"
    help
        application main firmware version
endif
```

## application/example/athost_app/Config.in
```kconfig
config AOS_APP_ATHOST_APP
    bool "AT Command Process Sample"
    select AOS_COMP_NETMGR
    select AOS_COMP_ATPARSER if ATHOSTAPP_CONFIG_ATPARSER
    select AOS_COMP_ATHOST
    select AOS_COMP_CLI
    select AOS_COMP_YLOOP
    help
        An example for receiving and processing AT command sets.

if AOS_APP_ATHOST_APP
# Configurations for app athostapp

config ATHOSTAPP_CONFIG_ATPARSER
    bool "Support ATParser"
    default y

config ATHOSTAPP_CONFIG_MQTTREPORT
    bool "Support Mqtt Report"
    default y

source "components/network/nal/athost/Config.in"
endif
```

## application/example/atparser_app/Config.in
```kconfig
config AOS_APP_ATPARSER_APP
    bool "atparser_app"
    select AOS_COMP_ATPARSER
    help
        atparser application

if AOS_APP_ATPARSER_APP
# Configurations for app atparser_app
endif
```

## application/example/audio_demo/Config.in
```kconfig
config AOS_APP_AUDIO_DEMO
    bool "Audio Demo"
    select AOS_COMP_CLI if !AOS_BOARD_ESP8266 && !AOS_CREATE_PROJECT
    select AOS_COMP_NETMGR if !AOS_CREATE_PROJECT
    select AOS_COMP_CJSON if !AOS_CREATE_PROJECT
    select AOS_COMP_SDK_DEVMODEL if !AOS_CREATE_PROJECT
    select AOS_COMP_SDK_AWSS if !AOS_CREATE_PROJECT
    help
        audio demo

if AOS_APP_AUDIO_DEMO
# Configurations for app linkkit_demo

config ENABLE_AOS_OTA
    bool "Enable OTA"
    default y
    select AOS_COMP_OTA
    help
        enable feature OTA.

choice
    prompt "Select Case"
    default AUDIO_DEMO_CONFIG_CASE_SOLO
    help
        select case to build

    config AUDIO_DEMO_CONFIG_CASE_SOLO
        bool "SOLO"
        help
            default case, build linkkit_example_solo.c or deprecated/solo.c(when enable deprecated)
endchoice

config AUDIO_DEMO_CONFIG_PRINT_HEAP
    bool "Show Free Heap Duration"
    default n
    help
    displays heap space periodically for debug

config BLE
    bool "BLE Enable"
    depends on AWSS_SUPPORT_BLE_PROVISION
    default y
    help

config SYSINFO_APP_VERSION
    string "Firmware Version"
    default "app-1.0.0-20200214.140831"
    help
        application main firmware version

endif
```

## application/example/blink_demo/Config.in
```kconfig
config AOS_APP_BLINK_DEMO
    bool "Blink Demo"
    select AOS_COMP_OSAL_AOS
    help
        blink Demo

if AOS_APP_BLINK_DEMO
# Configurations for app blink_demo
config SYSINFO_APP_VERSION
    string "Firmware Version"
    default "app-1.0.0-20200214.140831"
    help
        application main firmware version
endif
```

## application/example/coap_demo/Config.in
```kconfig
config AOS_APP_COAP_DEMO
    bool "COAP Sample"
# the selection of dependencies are to be removed soon
    select AOS_COMP_LIBCOAP if !AOS_CREATE_PROJECT
    select AOS_COMP_NETMGR  if !AOS_CREATE_PROJECT
    select AOS_COMP_CLI     if !AOS_CREATE_PROJECT
    help
        coap client example

if AOS_APP_COAP_DEMO
config SYSINFO_APP_VERSION
    string "Firmware Version"
    default "app-1.0.0-20200214.140831"
    help
        application main firmware version
endif
```

## application/example/debug_demo/Config.in
```kconfig
config AOS_APP_DEBUG_DEMO
    bool "debug demo"
    select AOS_COMP_DEBUG if !AOS_CREATE_PROJECT
    select AOS_COMP_CLI if !AOS_CREATE_PROJECT
    select AOS_COMP_OSAL_AOS if !AOS_CREATE_PROJECT
    select AOS_COMP_KV if !AOS_CREATE_PROJECT
    help
        demo for debug api

if AOS_APP_DEBUG_DEMO
# Configurations for app debug
config SYSINFO_APP_VERSION
    string "Firmware Version"
    default "app-1.0.0-20200214.140831"
    help
        application main firmware version
endif
```

## application/example/dk/dk_gui/Config.in
```kconfig
config AOS_APP_DK_GUI
    bool "DeveloperKit GUI Sample"
    select AOS_COMP_LITTLEVGL
    select AOS_COMP_CLI
    select AOS_COMP_YLOOP
    help
        Developer Kit GUI example

if AOS_APP_DK_GUI
# Configurations for app dk_gui
endif
```

## application/example/edu_demo/Config.in
```kconfig
config AOS_APP_EDU_DEMO
    bool "EDU Demo"
    select AOS_COMP_CLI if !AOS_BOARD_ESP8266 && !AOS_CREATE_PROJECT
    select AOS_NET_WITH_WIFI if !AOS_CREATE_PROJECT
    select AOS_COMP_NETMGR if !AOS_CREATE_PROJECT
    select AOS_COMP_CJSON if !AOS_CREATE_PROJECT
    select AOS_COMP_OLED if !AOS_CREATE_PROJECT
    select AOS_COMP_SENSOR if !AOS_CREATE_PROJECT
    select AOS_SENSOR_ACC_INV_MPU6050 if !AOS_CREATE_PROJECT
    select AOS_SENSOR_MAG_HONEYWELL_QMC5883L if !AOS_CREATE_PROJECT
    select AOS_SENSOR_ALS_LITEON_AP3216C if !AOS_CREATE_PROJECT
    select AOS_SENSOR_BARO_GOERTEK_SPL06 if !AOS_CREATE_PROJECT
    select AOS_SENSOR_TEMP_SI7006 if !AOS_CREATE_PROJECT
    help
        edu demo

if AOS_APP_EDU_DEMO
# Configurations for app edu_demo

config EDU_DEMO_CONFIG_LINKKIT
    bool "Enable linkkit"
    default n
    select AOS_COMP_UND if !AOS_CREATE_PROJECT
    select AOS_COMP_SDK_DEVMODEL if !AOS_CREATE_PROJECT
    select AOS_COMP_SDK_AWSS if !AOS_CREATE_PROJECT
    help
        enable edu demo linkkit config.

config ENABLE_AOS_OTA
    bool "Enable OTA"
    default n
    select AOS_COMP_OTA if !AOS_CREATE_PROJECT
    help
        enable feature OTA.

config EDU_DEMO_CONFIG_PRINT_HEAP
    bool "Show Free Heap Duration"
    default n
    help
        displays heap space periodically for debug

config EDK_DEMO_FACTORY_TEST_ENABLIE
    bool "enable factory test function"
    default n
    help
        enable factory test in edk demo

config SYSINFO_APP_VERSION
    string "Firmware Version"
    default "app-1.0.0-20210203.140831"
    help
        application main firmware version

endif
```

## application/example/example_legacy/at_app/Config.in
```kconfig
config AOS_APP_AT_APP
    bool "at_app"
# the selection of dependencies are to be removed soon
    select AOS_COMP_AT
    help
        at application

if AOS_APP_AT_APP
# Configurations for app at_app
config SYSINFO_APP_VERSION
    string "Firmware Version"
    default "app-1.0.0-20200214.140831"
    help
        application main firmware version
endif
```

## application/example/example_legacy/basicfunction_app/aos_api_app/Config.in
```kconfig
config AOS_APP_AOS_API_APP
    bool "kernel_app"
    select AOS_COMP_CLI
    select AOS_COMP_DEBUG
    help
        An example to show how to use the aos kernel API

if AOS_APP_AOS_API_APP
# Configurations for app kernel
config SYSINFO_APP_VERSION
    string "Firmware Version"
    default "app-1.0.0-20200214.140831"
    help
        application main firmware version
endif
```

## application/example/example_legacy/basicfunction_app/krhino_api_app/Config.in
```kconfig
config AOS_APP_KRHINO_API_APP
    bool "krhino_api_app"
    select AOS_COMP_CLI
    select AOS_COMP_DEBUG
    help
        An example to show how to use the krhino kernel API

if AOS_APP_KRHINO_API_APP
# Configurations for the krhino api app
endif
```

## application/example/example_legacy/blink/Config.in
```kconfig
config AOS_APP_BLINK
    bool "Blink Sample"
    select AOS_COMP_OSAL_AOS
    help
        blink sample

if AOS_APP_BLINK
# Configurations for app blink
config SYSINFO_APP_VERSION
    string "Firmware Version"
    default "app-1.0.0-20200214.140831"
    help
        application main firmware version
endif
```

## application/example/example_legacy/bluetooth/bleadv/Config.in
```kconfig
config AOS_APP_BLEADV
    bool "BLE Broadcaster Role Sample"
    help
        Ble Broadcaster Role example.

if AOS_APP_BLEADV
# Configurations for app bleadv
endif
```
