## application/example/itls_app/Config.in
```kconfig
config AOS_APP_ITLS_CLIENT
    bool "ITLS Client Sample"
    select AOS_COMP_CLI
    select AOS_COMP_ALICRYPTO
    select AOS_COMP_NETMGR
    select AOS_COMP_ID2
    select AOS_COMP_ITLS
    help
        itls sample app

if AOS_APP_ITLS_CLIENT
# Configurations for app itls_client
endif
```

## application/example/kernel_app/Config.in
```kconfig
config AOS_APP_KERNEL_APP
    bool "kernel_app"
    select AOS_COMP_CLI
    select AOS_COMP_DEBUG
    help
        kernel app

if AOS_APP_KERNEL_APP
# Configurations for app kernel
endif
```

## application/example/kernel_demo/aos_api_demo/Config.in
```kconfig
config AOS_APP_AOS_API_DEMO
    bool "kernel demo(AOS API)"
    select AOS_COMP_CLI if !AOS_BOARD_ESP8266
    help
        An example to show how to use the aos kernel API

if AOS_APP_AOS_API_DEMO
# Configurations for app kernel
config SYSINFO_APP_VERSION
    string "Firmware Version"
    default "app-1.0.0-20200214.140831"
    help
        application main firmware version
endif
```

## application/example/kernel_demo/krhino_api_demo/Config.in
```kconfig
config AOS_APP_KRHINO_API_DEMO
    bool "Kernel Demo(krhino API)"
    select AOS_COMP_CLI if !AOS_BOARD_ESP8266
    help
        An example to show how to use the krhino kernel API

if AOS_APP_KRHINO_API_DEMO
# Configurations for the krhino api app
config SYSINFO_APP_VERSION
    string "Firmware Version"
    default "app-1.0.0-20200214.140831"
    help
        application main firmware version
endif
```

## application/example/knx_demo/Config.in
```kconfig
config AOS_APP_KNXCTL
    bool "KNX Demo"
    select AOS_COMP_OSAL_AOS
    select AOS_COMP_KNX
    help
        KNX Stack Demo

if AOS_APP_KNXCTL
# Configurations for app knxctl
endif
```

## application/example/linkkit_demo/Config.in
```kconfig
config AOS_APP_LINKKIT_DEMO
    bool "Linkkit Demo"
    select AOS_COMP_CLI if !AOS_BOARD_ESP8266 && !AOS_CREATE_PROJECT
    select AOS_COMP_NETMGR if !AOS_CREATE_PROJECT
    select AOS_COMP_CJSON if !AOS_CREATE_PROJECT
    select AOS_COMP_SDK_DEVMODEL if !AOS_CREATE_PROJECT
    select AOS_COMP_SDK_AWSS if !AOS_CREATE_PROJECT
    select AOS_COMP_UND if !AOS_CREATE_PROJECT
    help
        linkkit demo

if AOS_APP_LINKKIT_DEMO
# Configurations for app linkkit_demo

config ENABLE_AOS_OTA
    bool "Enable OTA"
    default y
    select AOS_COMP_OTA if !AOS_CREATE_PROJECT
    help
        enable feature OTA.

choice
    prompt "Select Case"
    default LINKKIT_DEMO_CONFIG_CASE_SOLO
    help
        select case to build

    config LINKKIT_DEMO_CONFIG_CASE_SOLO
        bool "SOLO"
        help
            default case, build linkkit_example_solo.c or deprecated/solo.c(when enable deprecated)

    config LINKKIT_DEMO_CONFIG_CASE_SCHED
        bool "Sched"
        help
            case sched, build linkkit_example_sched.c or deprecated/sched.c(when enable deprecated)

    config LINKKIT_DEMO_CONFIG_CASE_CNTDOWN
        bool "Cntdown"
        help
            case countdown, build linkkit_example_cntdown.c or deprecated/cntdown.c(when enable deprecated)
endchoice

config LINKKIT_DEMO_CONFIG_PRINT_HEAP
    bool "Show Free Heap Duration"
    default n
    help
    displays heap space periodically for debug

config BLE
    bool "BLE Enable"
    depends on AWSS_SUPPORT_BLE_PROVISION
    default y
    help

config SYSINFO_APP_VERSION
    string "Firmware Version"
    default "app-1.0.0-20200214.140831"
    help
        application main firmware version

endif
```

## application/example/linkkit_gateway_demo/Config.in
```kconfig
config AOS_APP_LINKKIT_GATEWAY_DEMO
    bool "Linkkit Gateway Demo"
    select AOS_COMP_CLI if !AOS_BOARD_ESP8266 && !AOS_CREATE_PROJECT
   # select AOS_COMP_OTA          if !AOS_CREATE_PROJECT
    select AOS_COMP_CJSON         if !AOS_CREATE_PROJECT
    select AOS_COMP_NETMGR        if !AOS_CREATE_PROJECT
    select AOS_COMP_SDK_DEVMODEL  if !AOS_CREATE_PROJECT
    select AOS_COMP_SDK_AWSS      if !AOS_CREATE_PROJECT
    select AOS_COMP_UND           if !AOS_CREATE_PROJECT
    select DEVICE_MODEL_GATEWAY
    help
        linkkit gateway examples

if AOS_APP_LINKKIT_GATEWAY_DEMO
# Configurations for app linkkit_gateway_demo

config LINKKIT_GATEWAY_CONFIG_PRINT_HEAP
    bool "Show Free Heap Duration"
    default n
    help
    displays heap space periodically for debug

config SYSINFO_APP_VERSION
    string "Firmware Version"
    default "app-1.0.0-20200214.140831"
    help
        application main firmware version

endif
```

## application/example/lora_demo/Config.in
```kconfig
config AOS_APP_LORA_DEMO
    bool "Lora Demo"
    select AOS_COMP_OSAL_AOS  if !AOS_CREATE_PROJECT
    help
        Lora Demo

if AOS_APP_LORA_DEMO
# Configurations for app lora_demo
config SYSINFO_APP_VERSION
    string "Firmware Version"
    default "app-1.0.0-20200214.140831"
    help
        application main firmware version
endif
```

## application/example/lorawan/linkwan/Config.in
```kconfig
config AOS_APP_LINKWAN
    bool "LinkWAN Sample"
    select AOS_COMP_LORAWAN_STACK
    help
        linkwan

if AOS_APP_LINKWAN
# Configurations for app linkwan
endif
```

## application/example/lwm2m_app/Config.in
```kconfig
config AOS_APP_LWM2M_APP
    bool "lwm2mapp"
    select AOS_COMP_OSAL_AOS   
    select AOS_COMP_LWM2M 
    help
        lwm2m app

if AOS_APP_LWM2M_APP
config LWM2M_WITH_DTLS
    bool "LwM2M WITH DTLS"
    select MBEDTLS_CONFIG_CRYPTO_AES
    select MBEDTLS_CONFIG_CRYPTO_MODE_CCM
    select MBEDTLS_CONFIG_TLS_DEBUG
    default y
    help

endif
```

## application/example/lwm2m_demo/Config.in
```kconfig
config AOS_APP_LWM2M_DEMO
    bool "lwm2m_demo"
    select AOS_COMP_LWM2M if !AOS_CREATE_PROJECT
    help
        lwm2m app

if AOS_APP_LWM2M_DEMO
config LWM2M_WITH_DTLS
    bool "LwM2M WITH DTLS"
    select MBEDTLS_CONFIG_CRYPTO_AES
    select MBEDTLS_CONFIG_CRYPTO_MODE_CCM
    select MBEDTLS_CONFIG_TLS_DEBUG
    default y
    help
        LwM2M WITH DTLS

if LWM2M_WITH_DTLS
config USE_EXTERNAL_MEBDTLS
    bool "USE EXTERNAL MEBDTLS"
    default y
    help
        USE EXTERNAL MEBDTLS

config WITH_MBEDTLS
    bool "WITH MBEDTLS"
    default y
    help
        WITH MBEDTLS

config LWM2M_WITH_MBEDTLS
    bool "LWM2M WITH MBEDTLS"
    default y
    help
        LWM2M WITH MBEDTLS

endif

config SYSINFO_APP_VERSION
    string "Firmware Version"
    default "app-1.0.0-20200214.140831"
    help
        application main firmware version
endif
```

## application/example/mal_app/Config.in
```kconfig
config AOS_APP_MAL_APP
    bool "mal app"
    select AOS_COMP_MAL
    select AOS_COMP_SDK_SIGN
    help
        MQTT Adapter layer app

if AOS_APP_MAL_APP
# Configurations for MAL app
endif
```

## application/example/meshapp/Config.in
```kconfig
config AOS_APP_MESHAPP
    bool "Alibaba uMesh Sample"
    select AOS_COMP_UMESH
    select AOS_COMP_NETMGR
    select AOS_COMP_CLI
    select AOS_COMP_ALICRYPTO if MESHAPP_CONFIG_MESHAUTH
    select AOS_COMP_ID2 if MESHAPP_CONFIG_MESHAUTH
    select AOS_COMP_LWIP if MESHAPP_CONFIG_USE_LWIP
    help
        uMesh sample application

if AOS_APP_MESHAPP
# Configurations for app meshapp

config MESHAPP_CONFIG_MESHAUTH
    bool "Mesh Auth"
    default n
    help

config MESHAPP_CONFIG_IPV6
    bool "Use IPV6"
    default n
    help

config MESHAPP_CONFIG_USE_LWIP
    bool "Use lwip"
    default y

endif
```

## application/example/micropython_led_demo/Config.in
```kconfig
config AOS_APP_LED_DEMO
    bool " led Demo"
    select AOS_COMP_OSAL_AOS if !AOS_CREATE_PROJECT
    help
        n repl demo

if AOS_APP_LED_DEMO
config SYSINFO_APP_VERSION
    string "Firmware Version"
    default "app-1.0.0-20200214.140831"
    help
        application main firmware version
endif
```

## application/example/modbus_demo/Config.in
```kconfig
config AOS_APP_MODBUS_DEMO
    bool "MODBUS Master Sample"
    select AOS_COMP_CLI
    select AOS_COMP_YLOOP
    select AOS_COMP_MBMASTER
    help
        This example is an demo of using modbus master stack

if AOS_APP_MODBUS_DEMO
# Configurations for app modbus_demo
endif
```

## application/example/mqtt_demo/Config.in
```kconfig
config AOS_APP_MQTT_DEMO
    bool "MQTT Demo"
    select AOS_COMP_NETMGR
    select AOS_COMP_CLI
    select AOS_COMP_CJSON
    select AOS_COMP_SDK_MQTT
    select AOS_COMP_UND
    help
        mqtt examples

if AOS_APP_MQTT_DEMO
# Configurations for app mqtt_demo

choice
    prompt "Select Case"
    default MQTTDEMO_CONFIG_CASE_DEFAULT
    help
        select case to build

    config MQTTDEMO_CONFIG_CASE_DEFAULT
        bool "Default"
        help
            default case, build mqtt_example.c

    config MQTTDEMO_CONFIG_CASE_RRPC
        bool "Rrpc"
        help
            "case rrpc, build mqtt_example_rrpc.c

    config MQTTDEMO_CONFIG_CASE_MULTITHREAD
        bool "Multithread"
        help
            case multithread, build mqtt_example_multithread.c

    config MQTTDEMO_CONFIG_CASE_PRESSTEST
        bool "Presstest"
        help
            case presstest, build mqtt_presstest.c
endchoice

config MQTTAPP_CONFIG_TEST_LOOP
    bool "Test Loop"
    default y
    help
    n: run the full life cycle; y:do publish endless

config SYSINFO_APP_VERSION
    string "Firmware Version"
    default "app-1.0.0-20200214.140831"
    help
        application main firmware version
endif
```

## application/example/ota_demo/Config.in
```kconfig
config AOS_APP_OTA_DEMO
    bool "OTA Sample"
    select AOS_COMP_NETMGR
    select AOS_COMP_CLI
    select AOS_COMP_OTA
    select AOS_COMP_CJSON
    select AOS_COMP_SDK_MQTT
    select CONFIG_AOS_TCPIP if OTA_DEMO_CONFIG_USE_LWIP
    help
        OTA demo for developers

if AOS_APP_OTA_DEMO
# Configurations for app ota_demo

config OTA_DEMO_CONFIG_USE_LWIP
    bool "Use lwip"
    default n
    help

config OTA_DEMO_CONFIG_TEST_LOOP
    bool "Test Loop"
    default n
    help

config SYSINFO_APP_VERSION
    string "Firmware Version"
    default "app-1.0.0-20200214.140831"
    help
        application main firmware version

endif
```

## application/example/otaappdemo/Config.in
```kconfig
config AOS_APP_OTAAPPDEMO
    bool "OTA Sample"
    select AOS_COMP_NETMGR
    select AOS_COMP_CLI
    select AOS_COMP_OTA
    select AOS_COMP_CJSON
    select AOS_COMP_LWIP if OTAAPP_CONFIG_USE_LWIP
    select AOS_COMP_SDK_MQTT
    help
        OTA demo app for developers

if AOS_APP_OTAAPPDEMO
# Configurations for app otaappdemo

config OTAAPP_CONFIG_USE_LWIP
    bool "Use lwip"
    default n
    help

config OTAAPP_CONFIG_TEST_LOOP
    bool "Test Loop"
    default n
    help

endif
```

## application/example/py_engine_demo/Config.in
```kconfig
config AOS_APP_PY_ENGINE_DEMO
    bool " PY_ENGINE_demo"
    select TFTP_ENABLED
    select AOS_COMP_UAI
    select AOS_COMP_OSS
    select AOS_COMP_NETMGR if !AOS_CREATE_PROJECT
    select AOS_COMP_HTTP if !AOS_CREATE_PROJECT
    select CONFIG_NEW_HTTP_API
    select AOS_COMP_CLI if !AOS_CREATE_PROJECT
    select AOS_COMP_SDK_DEVMODEL
    select AOS_COMP_OSAL_AOS if !AOS_CREATE_PROJECT
    select AOS_COMP_SDK_AWSS if !AOS_CREATE_PROJECT
    select AOS_COMP_UND if !AOS_CREATE_PROJECT && !AOS_BOARD_HAAS100
    select AOS_COMP_CPLUSPLUS if !AOS_CREATE_PROJECT
    help
        n repl demo

if AOS_APP_PY_ENGINE_DEMO
config SYSINFO_APP_VERSION
    string "Firmware Version"
    default "app-1.0.0-20200214.140831"
    help
        application main firmware version
endif
```

## application/example/rfid_demo/Config.in
```kconfig
config AOS_APP_RFID_DEMO
    bool "rfid Demo"
    select AOS_COMP_CLI if !AOS_BOARD_ESP8266 && !AOS_CREATE_PROJECT
    select AOS_COMP_NETMGR if !AOS_CREATE_PROJECT
    select AOS_COMP_CJSON if !AOS_CREATE_PROJECT
    select AOS_COMP_SDK_DEVMODEL if !AOS_CREATE_PROJECT
    select AOS_COMP_SDK_AWSS if !AOS_CREATE_PROJECT
    select AOS_COMP_UND if !AOS_CREATE_PROJECT
    help
        rfid demo

if AOS_APP_RFID_DEMO
# Configurations for app rfid_demo

config ENABLE_AOS_OTA
    bool "Enable OTA"
    default y
    select AOS_COMP_OTA if !AOS_CREATE_PROJECT
    help
        enable feature OTA.

choice
    prompt "Select Case"
    default LINKKIT_DEMO_CONFIG_CASE_SOLO
    help
        select case to build

    config LINKKIT_DEMO_CONFIG_CASE_SOLO
        bool "SOLO"
        help
            default case, build linkkit_event.c or deprecated/solo.c(when enable deprecated)

endchoice

config LINKKIT_DEMO_CONFIG_PRINT_HEAP
    bool "Show Free Heap Duration"
    default n
    help
    displays heap space periodically for debug


config SYSINFO_APP_VERSION
    string "Firmware Version"
    default "app-1.0.0-20200214.140831"
    help
        application main firmware version

endif
```

## application/example/tcp_demo/Config.in
```kconfig
config AOS_APP_TCP_DEMO
    bool "tcp Demo"
    select AOS_COMP_OSAL_AOS if !AOS_CREATE_PROJECT
    select AOS_COMP_CLI
    select AOS_COMP_NETMGR
    help
        tcp demo

if AOS_APP_TCP_DEMO
# Configurations for app helloworld_demo
config SYSINFO_APP_VERSION
    string "Firmware Version"
    default "app-1.0.0-20200214.140831"
    help
        application main firmware version
endif
```

## application/example/uart/Config.in
```kconfig
config AOS_APP_UART
    bool "Uart Sample"
    help
        this is a uart sample form hal uart.h

if AOS_APP_UART
# Configurations for app uart
endif
```

## application/example/ucloud_ai_demo/Config.in
```kconfig
config AOS_APP_UCLOUD_AI_DEMO
    bool "HTTP App "
    select AOS_COMP_NETMGR if !AOS_CREATE_PROJECT
    # the selection of dependencies are to be removed soon
    select AOS_COMP_HTTP if !AOS_CREATE_PROJECT
    select CONFIG_NEW_HTTP_API
    select AOS_COMP_CLI if !AOS_CREATE_PROJECT
    select AOS_COMP_OSS
    select AOS_COMP_SDK_DEVMODEL
    select AOS_COMP_CPLUSPLUS if !AOS_CREATE_PROJECT
    help
        wifi camera app

if AOS_APP_UCLOUD_AI_DEMO
config SYSINFO_APP_VERSION
    string "Firmware Version"
    default "app-1.0.0-20200214.140831"
    help
        application main firmware version
endif
```

## application/example/ulocation/base_demo/Config.in
```kconfig
config AOS_APP_BASE_DEMO
    bool "uLocation base sample app"
    select AOS_COMP_NETMGR if !AOS_CREATE_PROJECT
    select AOS_COMP_CJSON if !AOS_CREATE_PROJECT
    select AOS_COMP_ULOCATION if !AOS_CREATE_PROJECT
    select AOS_COMP_SDK_DEVMODEL if !AOS_CREATE_PROJECT
    help
        ulocation base sample app

if AOS_APP_BASE_DEMO
# Configurations for app base_demo
config SYSINFO_APP_VERSION
    string "Firmware Version"
    default "app-1.0.0-20200214.140831"
    help
        application main firmware version
endif
```

## application/example/ulocation/baseapp/Config.in
```kconfig
config AOS_APP_BASEAPP
    bool "uLocation base sample app"
    select AOS_COMP_CLI if AOS_BOARD_ESP8266
    select AOS_COMP_NETMGR
    select AOS_COMP_OTA
    select AOS_COMP_CJSON
    select AOS_COMP_ULOCATION
    select AOS_COMP_SDK_DEVMODEL
    select AOS_COMP_SDK_AWSS
    select AOS_COMP_BREEZE if LINKKITAPP_CONFIG_COMBOAPP
    select AOS_COMP_BT_BREEZE_HAL if LINKKITAPP_CONFIG_COMBOAPP
    select AOS_COMP_BT_PROFILE if LINKKITAPP_CONFIG_COMBOAPP
    help
        ulocation base sample app

if AOS_APP_BASEAPP
# Configurations for app baseapp

endif
```
