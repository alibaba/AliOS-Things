## middleware/linkkit/sdk-c/src/services/linkkit/dm/Config.in
```kconfig
source "$SRCPATH/src/infra/log/Config.in"
source "$SRCPATH/src/infra/system/Config.in"
source "$SRCPATH/src/infra/utils/Config.in"


config AOS_COMP_LIBIOT_DM
    bool
    default n
    select AOS_COMP_LIBIOT_UTILS
    select AOS_COMP_LIBIOT_LOG 
    select AOS_COMP_LIBIOT_SYSTEM 
    select UTILS_SHA1
    select AOS_COMP_LIBIOT_CM
    help
      Device Management

if AOS_COMP_LIBIOT_DM
# Configurations for comp libiot_dm
endif
```

## middleware/linkkit/sdk-c/src/services/mdal/mal/Config.in
```kconfig
config MAL_ENABLED
    bool "FEATURE_MAL_ENABLED"
    depends on !MQTT_COMM_ENABLED
    default n
    select UTILS_SHA1
    help
        Establish persistent connection with AliCloud via MAL(MQTT Adapter Layer).

        Switch to "y" leads to building MAL into SDK and MAL_ENABLED included into CFLAGS.
        Switch to "n" leads to not use MAL method to establish persistent connection with AliCloud.

menu "MAL Configurations"
    depends on MAL_ENABLED

    config MQTT_DIRECT
        bool "FEATURE_MQTT_DIRECT"
        default y
        help
            Directly connect MQTT server without perform HTTP authenticate to another HTTP server ahead

            Switching to "y" leads to connect MQTT server directly and MQTT_DIRECT included into CFLAGS
            Switching to "n" leads to legacy authenticate mode: connnect HTTP server first, then connect MQTT server afterwards

    config MAL_ICA_ENABLED
        bool "FEATURE_MAL_ICA_ENABLED"
        default y
        help
            USE ICA AT method

            Switching to "y" leads to use ICA at method.
            Switching to "n" leads to not use ICA at method.

endmenu
```

## middleware/linkkit/sdk-c/src/services/mdal/sal/Config.in
```kconfig
config AOS_COMP_SAL
    bool "AOS_COMP_SAL"
    default n
    select AOS_COMP_SAL_MODULE_gt202 if BSP_WIFI_MODULE = "wifi.gt202"
    select AOS_COMP_DEVICE_SAL_MK3060 if BSP_WIFI_MODULE = "wifi.mk3060"
    select AOS_COMP_DEVICE_SAL_ESP8266 if BSP_WIFI_MODULE = "wifi.esp8266"
    select AOS_COMP_DEVICE_SAL_BK7231 if BSP_WIFI_MODULE = "wifi.bk7231"
    select AOS_COMP_DEVICE_SAL_SIM800 if BSP_GPRS_MODULE = "gprs.sim800"
```

## middleware/linkkit/sdk-c/src/services/ota/Config.in
```kconfig
config OTA_ENABLED
    depends on MQTT_COMM_ENABLED
    bool "FEATURE_OTA_ENABLED"
    default y
    select UTILS_HTTPC
    select UTILS_BASE64

    help
        OTA (Over The Air) means upgrade device's firmware or configuration remotely via Internet

        Switching to "y" leads to providing such capability via IOT_OTA_XXX() APIs
```

## middleware/linkkit/sdk-c/src/services/subdev/Config.in
```kconfig
config SUBDEVICE_ENABLED
    bool "FEATURE_SUBDEVICE_ENABLED"
    depends on !DEVICE_MODEL_ENABLED
    default n
    help
        Deprecated APIs of "IOT_Subdevice_XXX()" and "IOT_Gateway_XXX()", try to avoid using them unless you have to
```

## middleware/linkkit/sdk-c/src/tools/Kconfig
```kconfig
mainmenu "Main Menu"
comment "Configure Link Kit SDK for IoT Embedded Devices"

config MQTT_COMM_ENABLED
    bool "MQTT_COMM_ENABLED"
    default y
    help
        Establish persistent connection with AliCloud via MQTT-based protocol

        Switching to "y" leads to building MQTT related implementation into SDK and MQTT_COMM_ENABLED included into CFLAGS
        Switching to "n" seldom happens unless you're connecting to AliCloud via CoAP/HTTP channel

menu "MQTT Configurations"
    depends on MQTT_COMM_ENABLED

    config MQTT_DIRECT
        bool "MQTT_DIRECT"
        default y
        help
            Directly connect MQTT server without perform HTTP authenticate to another HTTP server ahead

            Switching to "y" leads to connect MQTT server directly and MQTT_DIRECT included into CFLAGS
            Switching to "n" leads to legacy authenticate mode: connnect HTTP server first, then connect MQTT server afterwards

endmenu

config OTA_ENABLED
    bool "OTA_ENABLED"
    default y

    help
        OTA (Over The Air) means upgrade device's firmware or configuration remotely via Internet

        Switching to "y" leads to providing such capability via IOT_OTA_XXX() APIs

config DEVICE_MODEL_ENABLED
    bool "DEVICE_MODEL_ENABLED"
    default y
    help
        Enable providing Thing-Model-Management/Alink-Protocol encapulation in SDK

        Switching to "y" leads to SDK being able to interpret JSON payload in MQTT channel, which also called "Advanced Version Protocol"
        Those capabilities are provided via IOT_Linkkit_XXX() APIs or being_deprecated linkkit_xxx() + linkkit_gateway_xxx() APIs

menu "Device Model Configurations"
    depends on DEVICE_MODEL_ENABLED

    config ENHANCED_GATEWAY
    bool "DEVICE_MODEL_GATEWAY"
    default n
    help
        Switching Thing-Model related implementations provided in gateway oriented way

endmenu

config SUPPORT_TLS
    bool "SUPPORT_TLS"
    default y
    help
        This option is mutually exclusive with SUPPORT_ITLS, only less than one of them can be switched to "y"

config SUPPORT_ITLS
    bool "SUPPORT_ITLS"
    depends on !SUPPORT_TLS
    default n
    help
        This option is mutually exclusive with SUPPORT_TLS, only less than one of them can be switched to "y"
        
        iTLS is a TLS implementation based on ID2, and ID2 service is professional security solution based on special hardware

config WIFI_AWSS_ENABLED
    bool "WIFI_PROVISION"
    default y
    help
        AWSS(Alibaba Wireless Setup Service) enable customers passing Wi-Fi SSID + Password to embedded devices

        Switching to "y" leads to generation of libawss.a, which providing APIs declared in include/exports/iot_export_awss.h
```

## middleware/linkkit/src/dev_bind/Config.in
```kconfig
config AOS_COMP_SDK_BIND

    bool "FEATURE_DEV_BIND_ENABLED"
    select INFRA_COMPAT
    select COAP_SERVER
    select AOS_COMP_SDK_MQTT
    select AOS_COMP_SDK_WRAPPERS
    default n
    help
        Enable dev-bind in SDK

if AOS_COMP_SDK_BIND
    config DEV_BIND_ENABLED
        bool
        default y
endif
```

## middleware/linkkit/src/dev_sign/Config.in
```kconfig
config AOS_COMP_SDK_SIGN
    bool 
    default n
    select INFRA_SHA256
    select AOS_COMP_SDK_WRAPPERS
```

## middleware/linkkit/src/http/Config.in
```kconfig
config AOS_COMP_SDK_HTTP
    bool "FEATURE_HTTP_COMM_ENABLED"
    default n
    select INFRA_SHA1
    select INFRA_HTTPC
    select INFRA_REPORT
    select INFRA_JSON_PARSER
    select SUPPORT_TLS
    select AOS_COMP_SDK_WRAPPERS
    help
        Establish persistent connection with AliCloud via HTTP-based protocol

if AOS_COMP_SDK_HTTP
    config HTTP_COMM_ENABLED
    bool
    default y
endif
```

## middleware/linkkit/wifi_provision/Config.in
```kconfig
config AOS_COMP_SDK_AWSS 
    bool "FEATURE_WIFI_PROVISION_ENABLED"
    select AOS_COMP_SDK_WRAPPERS
    select INFRA_AES if !PLATFORM_HAS_MBEDTLS
    select AWSS_DISABLE_ENROLLEE if !AWSS_SUPPORT_ZEROCONFIG
    select AWSS_DISABLE_REGISTRAR if !AWSS_SUPPORT_ZEROCONFIG
    select AWSS_SUPPORT_APLIST
    select INFRA_CJSON 
    select INFRA_COMPAT 
    select AOS_COMP_SDK_BIND
    select COAP_SERVER
    default n 
    help
        Enable providing Wifi SSID/PASSWD configration in SDK

if AOS_COMP_SDK_AWSS
    config WIFI_PROVISION_ENABLED
    bool
    default y
endif

config AWSS_SUPPORT_APLIST
    bool 
    default n

config AWSS_DISABLE_ENROLLEE
    bool
    default n

config AWSS_DISABLE_REGISTRAR
    bool
    default n

config AWSS_SUPPORT_BEACON_ANNOUNCE
    bool
    default n


config AWSS_SUPPORT_SMARTCONFIG_WPS
    bool
    default n
    

menu "Wifi Provision Configurations"
    depends on AOS_COMP_SDK_AWSS

    config AWSS_SUPPORT_SMARTCONFIG_MCAST
        bool
        default n

    config AWSS_SUPPORT_SMARTCONFIG
        bool "FEATURE_AWSS_SUPPORT_SMARTCONFIG"
        select AWSS_SUPPORT_SMARTCONFIG_WPS
        select AWSS_SUPPORT_BEACON_ANNOUNCE
        default y
        help
            Switching on a wifi provision method based on length-encoding

    config AWSS_SUPPORT_ZEROCONFIG
        bool "FEATURE_AWSS_SUPPORT_ZEROCONFIG"
        select MQTT_COMM_ENABLED
        select AWSS_SUPPORT_BEACON_ANNOUNCE
        default y
        help
            Switching on a wifi provision method based on zero-config, which shares ssid/passwd between devices

    config AWSS_SUPPORT_AHA
        bool "FEATURE_AWSS_SUPPORT_AHA"
        select AWSS_SUPPORT_BEACON_ANNOUNCE
        default n
        help
            Switching on a wifi provision method based on phone-ap, which tells the ssid/passwd to the devices connected to it

    config AWSS_SUPPORT_DEV_AP
        bool "FEATURE_AWSS_SUPPORT_DEV_AP"
        default n
        help
            Switching on a wifi provision method based on device-ap, which receives the ssid/passwd from the phones connected to it

endmenu
```

## middleware/linkkit/wrappers/Config.in
```kconfig
config AOS_COMP_SDK_WRAPPERS
    bool "Linkkit HAL for AliOS Things"
    default n
    select AOS_COMP_ULOG
    select AOS_COMP_ACTIVATION
    select AOS_COMP_CHIP_CODE
    select AOS_COMP_NETMGR
    select AOS_COMP_KV
    help
      HAL for AliOS Things
    
menu "Linkkit HAL config"
depends on AOS_COMP_SDK_WRAPPERS

config SUPPORT_TLS
    bool "support TLS"
    default y 
    help
        This option is mutually exclusive with SUPPORT_ITLS, only less than one of them can be switched to "y"

config USE_MBEDTLS
    bool "use MBEDTLS"
    depends on SUPPORT_TLS
    select AOS_COMP_MBEDTLS
    select AOS_COMP_SDK_CERT
    default y
    help
        mbedtls is a TLS implementation


config USE_ITLS
    bool "use iTLS"
    depends on SUPPORT_TLS
    depends on !USE_MBEDTLS
    select AOS_COMP_ITLS
    select INFRA_AES
    default n
    help
        iTLS is a TLS implementation based on ID2, and ID2 service is professional security solution based on special hardware

config COAP_DTLS_SUPPORT
    bool "support DTLS"
    select AOS_COMP_MBEDTLS
    select AOS_COMP_SDK_CERT
    default n

config HAL_CRYPTO
    bool 
    default y if USE_MBEDTLS || COAP_DTLS_SUPPORT
    select MBEDTLS_CONFIG_CRYPTO_MODE_CFB
    help
      HAL CRYPTO for AliOS Things

config TLS_SAVE_TICKET
    bool "support save tls ticket"
    default n
    depends on  SUPPORT_TLS
    help
      save tls session and ticket in kv to reduce memory and accelerate connection

    config HAL_KV
    bool
    default y
endmenu
```

## middleware/uagent/Config.in
```kconfig
menu "uAgent Configuration"
source "middleware/uagent/uagent/Config.in"
source "middleware/uagent/ulog/Config.in"
source "middleware/uagent/ota/Config.in"
source "middleware/uagent/ota/2ndboot/Config.in"
endmenu
```

## middleware/uagent/ota/2nd_boot/Config.in
```kconfig
config AOS_COMP_OTA_2ND_BOOT
    bool "Differential Incremental Upgrade Support"
    default n
    help

if AOS_COMP_OTA_2ND_BOOT
# Configurations for comp ota_2nd_boot
endif
```

## middleware/uagent/ota/Config.in
```kconfig
menuconfig AOS_COMP_OTA
    bool "OTA Features"
    select AOS_COMP_MBEDTLS
    select MBEDTLS_CONFIG_CRYPTO_MD5 if AOS_COMP_MBEDTLS
    select AOS_COMP_CJSON
    select AOS_COMP_SDK_MQTT
    select AOS_COMP_HTTP
    default n
    help

if AOS_COMP_OTA
config OTA_CONFIG_SECURE_DL_MODE
    bool "OTA Secure Downloading Mode"
    select CONFIG_HTTP_SECURE
    default n
    help
    select Y to enter into OTA secure downloading mode, only run download task in secure downloading mode.

config OTA_CONFIG_RSA
    bool "RSA Verify Support"
    default n
    help
    select Y to support RSA Verify Support.

config OTA_DOWNLOAD_RETRY_CNT
    int "OTA Download Retry Count"
    default 5
    help
    setup ota download retry count when fail to download.

config OTA_DOWNLOAD_TIMEOUT
    int "OTA Download Timeout(ms)"
    default 20000
    help
    setup ota download timeout, default:20000.

config OTA_DOWNLOAD_BLOCK_SIZE
    int "OTA Download Block Size(bytes)"
    default 512
    help
    setup ota download block size.

config OTA_FLASH_WRITE_CACHE_SIZE
     int "OTA write flash cache size(bytes)"
     default 1024
     help
        This option sets the ota write flash cache size for 8-byte alignment.
        This option is limited by the board memory size.
        This value could be 512 1024 2048 4096 ...
        The default value is 1024
source "middleware/uagent/ota/ota_ble/Config.in"
endif
```

## middleware/uagent/ota/hal/Config.in
```kconfig
config AOS_COMP_OTA_HAL
    bool "ota hal"
    default y
    help

if AOS_COMP_OTA_HAL
# Configurations for comp ota_hal
endif
```

## middleware/uagent/ota/ota_ble/Config.in
```kconfig
config AOS_COMP_OTA_BLE
    bool  "BLE Support"
    default n

if AOS_COMP_OTA_BLE
# Configurations for comp ota_ble
endif
```

## middleware/uagent/ota/ota_core/Config.in
```kconfig
config AOS_COMP_OTA_CORE
    bool
    default n
    help

if AOS_COMP_OTA_CORE
endif
```

## middleware/uagent/udev/Config.in
```kconfig
config AOS_COMP_UDEV
    bool "uDevice Support"
    default n
    select AOS_COMP_CJSON
    select AOS_COMP_OTA
    select AOS_COMP_LINKKIT_SDK_C
    select FEATURE_APP_LINKKIT_MQTT
    help
        developerment over the air

if AOS_COMP_UDEV
# Configurations for component udev

endif
```

## middleware/uagent/ulog/Config.in
```kconfig
config AOS_COMP_ULOG
    bool "ulog"
    default y

if AOS_COMP_ULOG
# Configurations for component ulog

config ULOG_CONFIG_ASYNC
    bool "enable ulog async mode"
    default n
    help
        enable ulog async mode

if ULOG_CONFIG_ASYNC
# Configurations for ulog async mode

config ULOG_CONFIG_EXTREAM_LOG_TEXT
    int "record extream log text"
    range 0 1
    default 0
    help
        If this value is SET then extream log text will be recored, then the log text not support syslog format, only pure message will be loged, syslog format cost about 45 bytes for each log.

config ULOG_CONFIG_SYSLOG_SIZE
    int "max length of every log"
    default 128
    help
        The max length of every trace log to be recorded, log Content will be trimmed if it's too long.

config ULOG_CONFIG_DEFAULT_ASYNC_SYSLOG_DEPTH
    int "default depth of queue"
    default 64
    help
        Default depth of queue that used to record under aync mode.
        May the trace log miss if this depth was set too small.
        More RAM will be costed if it set too large
        So consider balance of this value and system resouce

config ULOG_CONFIG_STOP_FILTER_DEFAULT
    int "level Stop Filter of default direction(uart for rtos)"
    range 0 7
    default 5
    help
        Level Stop Filter of default direction(uart for rtos), any log level qual or lower than this (value higher than it)
        will be abondoned LOG_EMERG will make none log pop out.

config ULOG_CONFIG_STOP_FILTER_UDP
    int "level Stop Filter of udp"
    range 0 7
    default 0
    help
        Level Stop Filter of udp, any log level qual or lower than this (value higher than it)
        will be abondoned LOG_EMERG will make none log pop out.
        please keep this value on "LOG_EMERG" if you have no plan to use udp log

config ULOG_CONFIG_LOG_ROUTINE_TASK_STACK_DEPTH
    int "stack depth of Log Task"
    default 512
    help
        STACK DEPTH of Log Task, will cost 512 Byte room

endif

endif
```
