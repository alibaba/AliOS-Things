## middleware/uagent/uota/Config.in
```kconfig
menuconfig AOS_COMP_OTA
    bool "ota"
    default n
    select AOS_COMP_OTA_VERIFY
    select AOS_COMP_OTA_TRANSPORT
    select AOS_COMP_OTA_DOWNLOAD
    select AOS_COMP_OTA_HAL
    help

if AOS_COMP_OTA
# Configurations for comp ota
config AOS_OTA_HTTPS
    bool "AOS_OTA_HTTPS"
    default y
    help
        Enable HTTPs download.

config AOS_OTA_ITLS
    bool "AOS_OTA_ITLS"
    default y
    help
        Enable ITLS download.

menu "MQTT Control channel"
    depends on MQTT_COMM_ENABLED

    config AOS_OTA_MQTT
        bool "AOS_OTA_MQTT"
        default y
        help
            Enable MQTT control channel.
endmenu

menu "CoAP Control channel"
    depends on COAP_COMM_ENABLED

    config AOS_OTA_COAP
        bool "AOS_OTA_COAP"
        default n
        help
            Enable CoAP control channel.
endmenu

menu "HTTP download channel"
    config AOS_OTA_DL_HTTP
        bool "AOS_OTA_DL_HTTP"
        default y
        help
            Enable HTTP download channel.
endmenu

menu "CoAP download channel"
    config AOS_OTA_DL_COAP
        bool "AOS_OTA_DL_COAP"
        default n
        help
            Enable CoAP download channel.
endmenu
endif
```

## middleware/uagent/uota/hal/Config.in
```kconfig
menuconfig AOS_COMP_OTA_HAL
    bool "ota_hal"
    default n
    help

if AOS_COMP_OTA_HAL
# Configurations for comp ota_hal
endif
```

## middleware/uagent/uota/ota_ble/Config.in
```kconfig
menuconfig AOS_COMP_OTA_BLE
    bool "ota_ble"
    default n
    select AOS_COMP_OTA_HAL
    help

if AOS_COMP_OTA_BLE
# Configurations for comp ota_ble
endif
```

## middleware/uagent/uota/ota_core/Config.in
```kconfig
menuconfig AOS_COMP_OTA_CORE
    bool "OTA Core"
    default y
    help

if AOS_COMP_OTA_CORE
endif
```

## middleware/uagent/uota/src/2nd_boot/Config.in
```kconfig
menuconfig AOS_COMP_OTA_2ND_BOOT
    bool "ota_2nd_boot"
    default n
    select AOS_COMP_OTA_2NDBOOT_NBPATCH
    select AOS_COMP_OTA_2BOOT_XZ
    help

if AOS_COMP_OTA_2ND_BOOT
# Configurations for comp ota_2nd_boot
endif
```
