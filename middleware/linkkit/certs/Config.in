## middleware/linkkit/dev_model/Config.in
```kconfig
config AOS_COMP_SDK_DEVMODEL

    bool "FEATURE_DEVICE_MODEL_ENABLED"
    select INFRA_COMPAT
    select INFRA_CJSON
    select AOS_COMP_SDK_MQTT
    select AOS_COMP_SDK_WRAPPERS
    default n
    help
        Enable providing Thing-Model-Management/Alink-Protocol encapulation in SDK

        Switching to "y" leads to SDK being able to interpret JSON payload in MQTT channel, which also called "Advanced Version Protocol"
        Those capabilities are provided via IOT_Linkkit_XXX() APIs or being_deprecated linkkit_xxx() + linkkit_gateway_xxx() APIs

if AOS_COMP_SDK_DEVMODEL
    config DEVICE_MODEL_ENABLED
    bool 
    default y
endif

menu "Device Model Configurations"
    depends on DEVICE_MODEL_ENABLED

    config DEVICE_MODEL_GATEWAY
        bool "FEATURE_DEVICE_MODEL_GATEWAY"
        select INFRA_SHA256
        select DEVICE_MODEL_MULTI_THREAD
        default n
        help
            Switching Thing-Model related implementations provided in gateway oriented way

    config DEVICE_MODEL_MULTI_THREAD
        bool "FEATURE_MULTI_THREAD"
        default n
        help
            Using independent thread for protocols yielding

    config DEPRECATED_LINKKIT
        bool "FEATURE_DEPRECATED_LINKKIT"
        default n
        select INFRA_JSON_PARSER
        help
            Enable providing Thing-Model related functions via being_deprecated/old/obsoleted APIs
            They are named as linkkit_xxx() or linkkit_gateway_xxx(), declared in linkkit_export.h and linkkit_gateway_export.h

            Switching to "y" leads to SDK providing APIs in linkkit_export.h + linkkit_gateway_export.h
            Switching to "n" leads to SDK providing APIs in iot_export_linkkit.h

    config DEVICE_MODEL_RAWDATA_SOLO
        bool "FEATURE_DEVICE_MODEL_RAWDATA_SOLO"
        depends on DEVICE_MODEL_ENABLED && !DEVICE_MODEL_GATEWAY && !DEPRECATED_LINKKIT
        default n
        help
            Enable only raw data function via IOT_Linkkit_xxx new APIs

            Switching to "y" leads to SDK being compiled only raw data function
            Switching to "n" leads to SDK being compiled both raw data and thing model function

    config ALCS_ENABLED
        bool "FEATURE_ALCS_ENABLED"
        default n
        select COAP_SERVER
        select INFRA_AES
        help
            ALCS(alink local communication service) is a communication between phone and device

            Switching to "y" leads to SDK being compiled with alcs function
            Switching to "n" leads to SDK being compiled without alcs function

    config DEVICE_MODEL_SUBDEV_OTA
        depends on DEVICE_MODEL_GATEWAY
        depends on OTA_ENABLED
        bool "FEATURE_DEVICE_MODEL_SUBDEV_OTA"
        default n

    config DEVICE_MODEL_SHADOW
        bool "FEATURE_DEVICE_MODEL_SHADOW"
        default n
    config LOG_REPORT_TO_CLOUD
        bool "FEATURE_LOG_REPORT_TO_CLOUD"
    default n
endmenu
```

## middleware/linkkit/iot_coap/Config.in
```kconfig
config COAP_COMM_ENABLED
    bool "FEATURE_COAP_COMM_ENABLED"
    default n
    select INFRA_CJSON
    select INFRA_JSON_PARSER
    select INFRA_SHA256
    select INFRA_MD5
    select INFRA_REPORT
    select INFRA_STRING
    select HAL_CRYPTO
    select COAP_PACKET
    select INFRA_AES if !PLATFORM_HAS_MBEDTLS
    select AOS_COMP_SDK_WRAPPERS

    help
        Establish non-persistent connection with AliCloud via CoAP-based protocol

        Switching to "y" leads to building CoAP related implementation into SDK and COAP_COMM_ENABLED included into CFLAGS
        Switching to "n" leads to keeping CoAP-based cloud connection implementations out of SDK

config COAP_SERVER
    bool
    default n
    select INFRA_MD5
    select INFRA_STRING
    select INFRA_JSON_PARSER
    select INFRA_SHA1
    select HAL_KV
    select HAL_CRYPTO
    select COAP_PACKET
    select INFRA_AES if !PLATFORM_HAS_MBEDTLS
    select AOS_COMP_SDK_WRAPPERS
```

## middleware/linkkit/sdk-c/Config.in
```kconfig
mainmenu "Main Menu"
comment "Configure Link Kit SDK for IoT Embedded Devices"

config SRCPATH
    string
    default "."

source "Config.linkkit"
```

## middleware/linkkit/sdk-c/src/infra/log/Config.in
```kconfig
menuconfig AOS_COMP_LIBIOT_LOG
    default n
    help
      Log printing implementation

if AOS_COMP_LIBIOT_LOG
# Configurations for comp libiot_log
endif
```

## middleware/linkkit/sdk-c/src/infra/system/Config.in
```kconfig
menuconfig AOS_COMP_LIBIOT_SYSTEM
    default n
    help
      system tools

if AOS_COMP_LIBIOT_SYSTEM
# Configurations for comp libiot_system
endif

config SYSTEM_FACILITY
    bool
    default y
    select UTILS_LITE_CJSON
```

## middleware/linkkit/sdk-c/src/infra/utils/Config.in
```kconfig
menuconfig AOS_COMP_LIBIOT_UTILS
    default n
    help
      tool sets, such as json,md5,base64 and so on

if AOS_COMP_LIBIOT_UTILS
# Configurations for comp libiot_utils
endif

config UTILS_LITE_CJSON
    bool
    default n

config UTILS_JSON_PARSER
    bool
    default n

config UTILS_HTTPC
    bool
    default n

config UTILS_BASE64
    bool
    default n
```

## middleware/linkkit/sdk-c/src/protocol/alcs/Config.in
```kconfig
source "$SRCPATH/src/infra/log/Config.in"
source "$SRCPATH/src/infra/system/Config.in"
source "$SRCPATH/src/infra/utils/Config.in"
source "$SRCPATH/src/sdk-impl/Config.in"
source "$SRCPATH/src/protocol/coap/server/Config.in"

config ALCS_ENABLED
    bool "FEATURE_ALCS_ENABLED"
    depends on (DEVICE_MODEL_ENABLED)
    default n

    select HAL_CRYPTO
    select AOS_COMP_LIBIOT_LOG 
    select AOS_COMP_LIBIOT_SYSTEM 
    select AOS_COMP_LIBIOT_SDK_IMPL
    select AOS_COMP_LIBIOT_COAP_LOCAL
    select AOS_COMP_LIBIOT_UTILS
    select UTILS_JSON_PARSER
    select UTILS_BASE64
    select UTILS_SHA1
    select UTILS_MD5
    help
        ALCS(Alibaba Local Communication Service) enable customers communicate with IoT devices from cellphone without Internet
    # FEATURE_ALCS_CLIENT_ENABLED
            
menu "ALCS Configurations"
    depends on ALCS_ENABLED

    config ALCS_CLIENT_ENABLED
        bool "FEATURE_ALCS_CLIENT_ENABLED"
        default n
    
    config ALCS_SERVER_ENABLED
        bool "FEATURE_ALCS_SERVER_ENABLED"
        default y

endmenu
```

## middleware/linkkit/sdk-c/src/protocol/coap/CoAPPacket/Config.in
```kconfig
config AOS_COMP_LIBIOT_COAP_PACK 
    bool
    default n
    select AOS_COMP_LIBIOT_UTILS
    select AOS_COMP_IOTX-HAL
    select AOS_COMP_LIBIOT_LOG 
    select AOS_COMP_LIBIOT_SYSTEM 
    select AOS_COMP_LIBIOT_UTILS

    help
      coap common api
```

## middleware/linkkit/sdk-c/src/protocol/coap/Config.in
```kconfig
config COAP_COMM_ENABLED
    bool "FEATURE_COAP_COMM_ENABLED"
    default n
    help
        Establish non-persistent connection with AliCloud via CoAP-based protocol

        Switching to "y" leads to building CoAP related implementation into SDK and COAP_COMM_ENABLED included into CFLAGS
        Switching to "n" leads to keeping CoAP-based cloud connection implementations out of SDK
```

## middleware/linkkit/sdk-c/src/protocol/coap/client/Config.in
```kconfig
config COAP_COMM_ENABLED
    bool "FEATURE_COAP_COMM_ENABLED"
    default n
    select COAP_PACKET_ENABLED
    select UTILS_LITE_CJSON
    select UTILS_JSON_PARSER
    select UTILS_HTTPC
    select WITH_FAC_JSON_FLOW
    select UTILS_SHA256
    select UTILS_MD5

    select HAL_CRYPTO
    select HAL_UDP

    help
        Establish non-persistent connection with AliCloud via CoAP-based protocol

        Switching to "y" leads to building CoAP related implementation into SDK and COAP_COMM_ENABLED included into CFLAGS
        Switching to "n" leads to keeping CoAP-based cloud connection implementations out of SDK

if COAP_COMM_ENABLED
menu "COAP COMM SETTING"

depends on SUPPORT_TLS
config COAP_SUPPORT_DTLS
    bool "FEATURE_COAP_SUPPORT_DTLS"
    default n
    help
        support mbedtls DTLS 

endmenu

endif
```

## middleware/linkkit/sdk-c/src/protocol/coap/server/Config.in
```kconfig
config AOS_COMP_LIBIOT_COAP_LOCAL
    bool
    default n
    select AOS_COMP_LIBIOT_UTILS
    select AOS_COMP_IOTX-HAL
    select AOS_COMP_LIBIOT_LOG 
    select AOS_COMP_LIBIOT_SYSTEM 
    select AOS_COMP_LIBIOT_UTILS

    help
      coap server

if AOS_COMP_LIBIOT_COAP_LOCAL
# Configurations for comp libiot_coap_local
endif
```

## middleware/linkkit/sdk-c/src/protocol/http/Config.in
```kconfig
config HTTP_COMM_ENABLED
    bool "FEATURE_HTTP_COMM_ENABLED"
    default n
    select UTILS_SHA1
    help
        Establish persistent connection with AliCloud via HTTP-based protocol
```

## middleware/linkkit/sdk-c/src/protocol/http2/Config.in
```kconfig
config AOS_COMP_LIBIOT_HTTP2
    bool
    default n
    select AOS_COMP_LIBIOT_UTILS
    select UTILS_SHA1
    select AOS_COMP_IOTX-HAL
    select AOS_COMP_LIBIOT_LOG 
    select AOS_COMP_LIBIOT_SYSTEM 
    help
      Nghttp2 and its encapsulation

if AOS_COMP_LIBIOT_HTTP2
# Configurations for comp libiot_http2
endif
```

## middleware/linkkit/sdk-c/src/protocol/mqtt/Config.in
```kconfig
config MQTT_COMM_ENABLED
    bool "FEATURE_MQTT_COMM_ENABLED"
    default y
    help
        Establish persistent connection with AliCloud via MQTT-based protocol

        Switching to "y" leads to building MQTT related implementation into SDK and MQTT_COMM_ENABLED included into CFLAGS
        Switching to "n" seldom happens unless you're connecting to AliCloud via CoAP/HTTP channel

menu "MQTT Configurations"
    depends on MQTT_COMM_ENABLED

    config MQTT_DIRECT
        bool "FEATURE_MQTT_DIRECT"
        default y
        help
            Directly connect MQTT server without perform HTTP authenticate to another HTTP server ahead

            Switching to "y" leads to connect MQTT server directly and MQTT_DIRECT included into CFLAGS
            Switching to "n" leads to legacy authenticate mode: connnect HTTP server first, then connect MQTT server afterwards

    config MQTT_SHADOW
        bool "FEATURE_MQTT_SHADOW"
        default n
        help
            Enable providing cache data of IoT device at cloud via "IOT_Shadow_XXX" APIs declared in include/exports/iot_export_shadow.h

    config MQTT_LOGPOST
        bool "FEATURE_MQTT_LOGPOST"
        default n
        help
            Enable capability of publishing important device running log messages to IoT cloud

endmenu
```

## middleware/linkkit/sdk-c/src/ref-impl/hal/os/alios/Config.in
```kconfig
menuconfig AOS_COMP_IOTX-HAL
    default n
    select AOS_COMP_ITLS if SUPPORT_ITLS = y
    select AOS_COMP_MBEDTLS if SUPPORT_TLS = y
    help
      HAL for AliOS Things

if AOS_COMP_IOTX-HAL
# Configurations for comp iotx-hal
endif
```

## middleware/linkkit/sdk-c/src/sdk-impl/Config.in
```kconfig
config AOS_COMP_LIBIOT_SDK_IMPL
    bool
    default n
    select AOS_COMP_LIBIOT_UTILS
    help
      The upper API of linkkit

if AOS_COMP_LIBIOT_SDK_IMPL
# Configurations for comp libiot_sdk_impl
endif

config DYNAMIC_REGISTER
    bool "FEATURE_DYNAMIC_REGISTER"
    default n
    select UTILS_LITE_CJSON
    select UTILS_HTTPC
    select UTILS_SHA256
    select HTTP_COMM_ENABLED
    select UTILS_HTTPC
    select HAL_KV
```

## middleware/linkkit/sdk-c/src/security/Config.in
```kconfig
config SUPPORT_TLS
    select AOS_COMP_IMBEDTLS 
    bool "FEATURE_SUPPORT_TLS"
    default y
    help
        This option is mutually exclusive with SUPPORT_ITLS, only less than one of them can be switched to "y"

config SUPPORT_ITLS
    bool "FEATURE_SUPPORT_ITLS"
    depends on !SUPPORT_TLS
    select AOS_COMP_ITLS
    default n
    help
        This option is mutually exclusive with SUPPORT_TLS, only less than one of them can be switched to "y"

        iTLS is a TLS implementation based on ID2, and ID2 service is professional security solution based on special hardware
     
```

## middleware/linkkit/sdk-c/src/services/awss/Config.in
```kconfig
config WIFI_PROVISION_ENABLED
    bool "FEATURE_WIFI_PROVISION_ENABLED"
    depends on DEV_BIND_ENABLED
    default y
    help
        AWSS(Alibaba Wireless Setup Service) enable customers passing Wi-Fi SSID + Password to embedded devices

        Switching to "y" leads to generation of libawss.a, which providing APIs declared in include/exports/iot_export_awss.h
```

## middleware/linkkit/sdk-c/src/services/dev_bind/Config.in
```kconfig
config DEV_BIND_ENABLED
    bool "FEATURE_DEV_BIND_ENABLED"
    depends on MQTT_COMM_ENABLED

    select AOS_COMP_LIBIOT_COAP_LOCAL
    select UTILS_JSON_PARSER
    select UTILS_MD5
    select HAL_CRYPTO
    select HAL_UDP

    default n
    help
        Enable customers to bind device to current user
```

## middleware/linkkit/sdk-c/src/services/http2_stream/Config.in
```kconfig
source "$SRCPATH/src/infra/log/Config.in"
source "$SRCPATH/src/infra/system/Config.in"
source "$SRCPATH/src/infra/utils/Config.in"
source "$SRCPATH/src/protocol/http2/Config.in"

config HTTP2_COMM_ENABLED
    bool "FEATURE_HTTP2_COMM_ENABLED"
    default n
    select AOS_COMP_LIBIOT_HTTP2
    select AOS_COMP_LIBIOT_LOG 
    select AOS_COMP_LIBIOT_SYSTEM 
    select AOS_COMP_LIBIOT_UTILS

    help
        Establish persistent connection with AliCloud via HTTP2-based protocol

menu "HTTP2 Configurations"
    depends on HTTP2_COMM_ENABLED

    config FS_ENABLED
        bool "FEATURE_FS_ENABLED"
        default y
        help
            USE HAL fs api to enable file upload feature 

endmenu
```
