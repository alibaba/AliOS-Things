## middleware/linkkit/sdk-c/src/services/linkkit/Config.in
```kconfig
source "$SRCPATH/src/services/linkkit/cm/Config.in"
source "$SRCPATH/src/services/linkkit/dm/Config.in"
source "$SRCPATH/src/infra/utils/Config.in"

config DEVICE_MODEL_ENABLED
    bool "FEATURE_DEVICE_MODEL_ENABLED"
    default n
    select AOS_COMP_LIBIOT_CM
    select AOS_COMP_LIBIOT_DM
    select UTILS_LITE_CJSON
    select WITH_FAC_JSON_FLOW
    select UTILS_EVENT
    select UTILS_SHA1

    select HAL_KV

    help
        Enable providing Thing-Model-Management/Alink-Protocol encapulation in SDK

        Switching to "y" leads to SDK being able to interpret JSON payload in MQTT channel, which also called "Advanced Version Protocol"
        Those capabilities are provided via IOT_Linkkit_XXX() APIs or being_deprecated linkkit_xxx() + linkkit_gateway_xxx() APIs

menu "Device Model Configurations"
    depends on DEVICE_MODEL_ENABLED

    config DEVICE_MODEL_GATEWAY
        bool "FEATURE_DEVICE_MODEL_GATEWAY"
        default n
        help
            Switching Thing-Model related implementations provided in gateway oriented way

    source "$SRCPATH/src/protocol/alcs/Config.in"
    source "$SRCPATH/src/services/dev_bind/Config.in"
    source "$SRCPATH/src/services/linkkit/dev_reset/Config.in"

    config DEPRECATED_LINKKIT
        bool "FEATURE_DEPRECATED_LINKKIT"
        default n
        help
            Enable providing Thing-Model related functions via being_deprecated/old/obsoleted APIs
            They are named as linkkit_xxx() or linkkit_gateway_xxx(), declared in linkkit_export.h and linkkit_gateway_export.h

            Switching to "y" leads to SDK providing APIs in linkkit_export.h + linkkit_gateway_export.h
            Switching to "n" leads to SDK providing APIs in iot_export_linkkit.h

    config DEVICE_MODEL_RAWDATA_SOLO
        bool "FEATURE_DEVICE_MODEL_RAWDATA_SOLO"
        depends on DEVICE_MODEL_ENABLED && !DEVICE_MODEL_GATEWAY && !DEPRECATED_LINKKIT
        default n
        help
            Enable only raw data function via IOT_Linkkit_xxx new APIs

            Switching to "y" leads to SDK being compiled only raw data function
            Switching to "n" leads to SDK being compiled both raw data and thing model function


    config DEVICE_MODEL_SUBDEV_OTA
        bool "FEATURE_DEVICE_MODEL_SUBDEV_OTA"
        depends on (DEVICE_MODEL_ENABLED)
        depends on (DEVICE_MODEL_GATEWAY)
        depends on (OTA_ENABLED)
        default n
        help
            Enable sub devices which are connected to a gateway to do FOTA

    config DEVICE_MODEL_SHADOW
        bool "FEATURE_DEVICE_MODEL_SHADOW"
        depends on (DEVICE_MODEL_ENABLED)
        default n
        help
            Enable devices to aquire a property's expected value set by the user from the cloud 

endmenu
```

## middleware/linkkit/sdk-c/src/services/linkkit/cm/Config.in
```kconfig
source "$SRCPATH/src/infra/log/Config.in"
source "$SRCPATH/src/infra/utils/Config.in"

config AOS_COMP_LIBIOT_CM
    bool
    default n
    select AOS_COMP_LIBIOT_UTILS
    select AOS_COMP_LIBIOT_LOG
    help
      Connection management

if AOS_COMP_LIBIOT_CM
# Configurations for comp libiot_cm
endif
```

## middleware/linkkit/sdk-c/src/services/linkkit/dev_reset/Config.in
```kconfig
config AOS_COMP_LIBDEV_RESET
    bool
    default n
    help
      reset devices with user account

if AOS_COMP_LIBDEV_RESET
# Configurations for comp libdev_reset
endif
```
