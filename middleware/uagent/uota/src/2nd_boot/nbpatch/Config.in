## middleware/uagent/uota/src/2nd_boot/nbpatch/Config.in
```kconfig
menuconfig AOS_COMP_OTA_2NDBOOT_NBPATCH
    bool "ota_2ndboot_nbpatch"
    default y
    help

if AOS_COMP_OTA_2NDBOOT_NBPATCH
# Configurations for comp ota_2ndboot_nbpatch
endif
```

## middleware/uagent/uota/src/2nd_boot/xz/Config.in
```kconfig
menuconfig AOS_COMP_OTA_2BOOT_XZ
    bool "ota_2boot_xz"
    default n
    help

if AOS_COMP_OTA_2BOOT_XZ
# Configurations for comp ota_2boot_xz
endif
```

## middleware/uagent/uota/src/download/Config.in
```kconfig
menuconfig AOS_COMP_OTA_DOWNLOAD
    bool "ota_download"
    default n
    help

if AOS_COMP_OTA_DOWNLOAD
# Configurations for comp ota_download
endif
```

## middleware/uagent/uota/src/transport/Config.in
```kconfig
menuconfig AOS_COMP_OTA_TRANSPORT
    bool "ota_transport"
    default y
    help

if AOS_COMP_OTA_TRANSPORT
# Configurations for comp ota_transport
endif
```

## middleware/uagent/uota/src/verify/Config.in
```kconfig
menuconfig AOS_COMP_OTA_VERIFY
    bool "ota_verify"
    default y
    help

if AOS_COMP_OTA_VERIFY
# Configurations for comp ota_verify
endif
```

## middleware/udata/Config.in
```kconfig
config AOS_COMP_UDATA
    bool "udata"
    default n
    depends on AOS_COMP_SENSOR
    select AOS_COMP_OSAL_AOS
    select AOS_COMP_CJSON if UDATA_CONFIG_CJSON_FORMAT
    help

if AOS_COMP_UDATA
# Configurations for comp udata

config UDATA_CONFIG_CJSON_FORMAT
    bool "udata cjson config"
    default y
    help
        Enable udata cjson config

endif
```

## middleware/ulocation/Config.in
```kconfig
config AOS_COMP_ULOCATION
    bool "uLocation Support"
    default n
    help
    	location service

if AOS_COMP_ULOCATION
# Configurations for comp ulocation
config ULOCATION_CONFIG_SELFTASK
    bool "uLocation Private Task to Update location infor"
    default n
    help
        Enable uLocation Private Task

config QXWZ_ENABLED
    bool "qianxunweizhi"
    default n
    help
      support qianxunweizhi SDK library.

      Switching to "y" leads to support qianxunweizhi library.
      Switching to "n" leads to not support qianxunweizhi library.

endif
```

## network/Config.in
```kconfig
config AOS_NETWORK
    bool "Network Configuration"
    default y

if AOS_NETWORK

## --- Generated Automatically ---
source "network/bluetooth/breeze/Config.in"
source "network/bluetooth/breeze/hal/ble/Config.in"
source "network/bluetooth/bt_host/Config.in"
source "network/bluetooth/bt_host/bt_common/Config.in"
source "network/bluetooth/bt_host/profile/Config.in"
source "network/bluetooth/bt_mesh/Config.in"
source "network/bluetooth/bt_mesh/port/Config.in"
source "network/bluetooth/tmall_model/Config.in"
source "network/lorawan/Config.in"
source "network/lwip/Config.in"
source "network/netmgr/Config.in"
source "network/umesh/Config.in"
source "network/yloop/Config.in"
## --- End ---

endif
```

## network/bluetooth/breeze/Config.in
```kconfig
menuconfig AOS_COMP_BREEZE
    bool "Breeze SDK"
    default n
    select AOS_COMP_BREEZE_HAL if CONFIG_COMP_BZ_BUILTIN_HAL
    help
      AliOS things Breeze SDK

if AOS_COMP_BREEZE
# Configurations for comp breeze

    config CONFIG_COMP_BZ_SECURE_ADV
        bool "Enable secure and sequential advertising."
        default n

    config CONFIG_COMP_BZ_MODEL_SEC
        bool "Enable auth per product, otherwise auth for per device."
        default n

    config CONFIG_COMP_BZ_EN_AWSS
        bool "Enable AWSS, providing secured ble link for wifi provision."
        default n

    config CONFIG_COMP_BZ_EN_AUTH
        bool "Enable authentication."
        default y
    if CONFIG_COMP_BZ_EN_AUTH
        config CONFIG_COMP_BZ_EN_AUTH_OFFLINE
        bool "Authentication offline, otherwise online"
        default n
    endif

    config CONFIG_COMP_BZ_EN_LONG_MTU
        bool "Extend MTU from default 20 bytes to long MTU."
        default n

    config CONFIG_COMP_BZ_BUILTIN_HAL
        bool "Enable default built-in HALs:blestack, AliOS Things and crypto."
        default y

endif
```

## network/bluetooth/breeze/hal/ble/Config.in
```kconfig
menuconfig AOS_COMP_BT_BREEZE_HAL
    bool "bt_breeze_hal"
    default n
    help

if AOS_COMP_BT_BREEZE_HAL
# Configurations for comp bt_breeze_hal
endif
```

## network/bluetooth/breeze/ref-impl/Config.in
```kconfig
config AOS_COMP_BREEZE_HAL
    bool 
    default n
    select AOS_COMP_BT_HOST if BREEZEHAL_CONFIG_BLESTACK
    select AOS_COMP_MBEDTLS if BREEZEHAL_CONFIG_CRYTPO
    select AOS_COMP_ULOG
    help

if AOS_COMP_BREEZE_HAL
# Configurations for comp bt_breeze_hal

     config BREEZEHAL_CONFIG_BLESTACK
 	#bool "Enable built-in BLE stack"
 	default 1

     config BREEZEHAL_CONFIG_CRYTPO
        #bool "Enable built-in crypto"
        default 0

endif
```

## network/bluetooth/bt/Config.in
```kconfig
menuconfig AOS_COMP_BT
    bool "bt"
    default n
    select AOS_COMP_CONTROLLER if @CONDITION@
    select AOS_COMP_YLOOP
    help

if AOS_COMP_BT
# Configurations for comp bt
endif
```

## network/bluetooth/bt_host/Config.in
```kconfig
menuconfig AOS_COMP_BT
    bool "Bluetooth Stack"
    default n
    select AOS_COMP_CONTROLLER if @CONDITION@
    select AOS_COMP_YLOOP
    select AOS_COMP_BT_COMMON
    help

if AOS_COMP_BT
# Configurations for comp bt
endif
```

## network/bluetooth/bt_host/bt_common/Config.in
```kconfig
menuconfig AOS_COMP_BT_COMMON
    bool "Bluetooth common utilities (queue, timer, fifo, etc.)"
    default n
    help
      AliOS Things NETWORK - Bluetooth common utilities (queue, timer, fifo, etc.)

if AOS_COMP_BT_MESH
# Configurations for comp bt_mesh
endif
```

## network/bluetooth/bt_host/profile/Config.in
```kconfig
config AOS_COMP_BT_PROFILE
    bool
    default n
    help

if AOS_COMP_BT_PROFILE
# Configurations for comp bt_profile
endif
```

## network/bluetooth/bt_mesh/Config.in
```kconfig
menuconfig AOS_COMP_BT_MESH
	bool "Bluetooth Mesh Stack"
	default n
	#select AOS_COMP_BT_COMMON
	#select AOS_COMP_BT_PORT
	help
	  AliOS Things NETWORK - Bluetooth Mesh component

if AOS_COMP_BT_MESH
# Configurations for comp bt_mesh

# Virtual option enabled whenever Generic Provisioning layer is needed
config CONFIG_BT_MESH_PROV
	bool "Generic Provisioning layer (PROV)"
	default y
	help
	  Virtual option enabled whenever Generic Provisioning layer is needed

config CONFIG_BT_MESH_PB_ADV
	bool "Provisioning support using the advertising bearer (PB_ADV)"
	select CONFIG_BT_MESH_PROV
	default y
	help
	  Enable this option to allow the device to be provisioned over
	  the advertising bearer.

# Virtual option enabled whenever any Proxy protocol is needed
config CONFIG_BT_MESH_PROXY
	bool "Proxy protocol (PROXY protocol)"
	default n
	help
	  Virtual option enabled whenever any Proxy protocol is needed

config CONFIG_BT_MESH_PB_GATT
	bool "Provisioning support using GATT (PB_GATT)"
	select CONFIG_BT_MESH_PROXY
	select CONFIG_BT_MESH_PROV
	default n
	help
	  Enable this option to allow the device to be provisioned over
	  GATT.

config CONFIG_BT_MESH_GATT_PROXY
	bool "GATT Proxy Service (GATT_PROXY)"
	select CONFIG_BT_MESH_PROXY
	default n
	help
	  This option enables support for the Mesh GATT Proxy Service,
	  i.e. the ability to act as a proxy between a Mesh GATT Client
	  and a Mesh network.

config CONFIG_BT_MESH_RELAY
	bool "Relay support (RELAY)"
	default y
	help
	  Support for acting as a Mesh Relay Node.

config CONFIG_BT_MESH_LOW_POWER
	bool "Support for Low Power features (LOW_POWER)"
	default n
	help
	  Enable this option to be able to act as a Low Power Node.

config CONFIG_BT_MESH_FRIEND
	bool "Support for acting as a Friend Node (FRIEND)"
	default n
	help
	  Enable this option to be able to act as a Friend Node.

config CONFIG_BT_MESH_CFG_CLI
	bool "Support for Configuration Client Model (CFG_CLI)"
	default n
	help
	  Enable support for the configuration client model.

config CONFIG_BT_MESH_HEALTH_CLI
	bool "Support for Health Client Model (HEALTH_CLI)"
	default n
	help
	  Enable support for the health client model.

config CONFIG_BT_MESH_SHELL
	bool "Enable Bluetooth Mesh shell (SHELL)"
	select CONFIG_BT_MESH_CFG_CLI
	select CONFIG_BT_MESH_HEALTH_CLI
	default n
	help
	  Activate shell module that provides Bluetooth Mesh commands to
	  the console.

endif
```

## network/bluetooth/bt_mesh/port/Config.in
```kconfig
menuconfig AOS_COMP_BT_PORT
    bool
    default n
    select AOS_COMP_BT_HOST
    help
      AliOS Things NETWORK - Bluetooth Mesh HAL AliOS Things based porting

if AOS_COMP_BT_PORT
# Configurations for comp bt_port
endif
```

## network/bluetooth/bt_mesh_profile/Config.in
```kconfig
menuconfig AOS_COMP_BT_MESH_PROFILE
    bool "bt_mesh_profile"
    default n
    help

if AOS_COMP_BT_MESH_PROFILE
# Configurations for comp bt_mesh_profile
endif
```

## network/bluetooth/profile/Config.in
```kconfig
menuconfig AOS_COMP_BT_PROFILE
    bool "bt_profile"
    default n
    help

if AOS_COMP_BT_PROFILE
# Configurations for comp bt_profile
endif
```

## network/bluetooth/tmall_model/Config.in
```kconfig
config AOS_COMP_TMALL_MODEL
    bool
    default n
    select AOS_COMP_BT_MESH
    help

if AOS_COMP_TMALL_MODEL
# Configurations for comp ble mesh tmall model
endif
```

## network/coap/Config.in
```kconfig
config AOS_COMP_COAP
    bool "Coap"
    default n
    help
        AliOS Things coap client

if AOS_COMP_COAP
# Configurations for comp coap component

config COAP_WITH_DTLS
    bool "COAP WITH DTLS"
    select AOS_COMP_MBEDTLS
    default y
    help

config COAP_WITH_ALI_AUTH
    bool "COAP WITH ALI AUTHENTICATION"
    default y
    help

endif
```

## network/coap/wrappers/Config.in
```kconfig
config AOS_COMP_COAP_WRAPPERS
    bool "Coap HAL for AliOS Things"
    default n
    select AOS_COMP_ULOG
    select AOS_COMP_ACTIVATION
    select AOS_COMP_CHIP_CODE
    select AOS_COMP_NETMGR
    help
      HAL for AliOS Things

config PLATFORM_HAS_MBEDTLS
    bool 
    default n 
    
menu "Linkkit HAL config"
depends on AOS_COMP_COAP_WRAPPERS

config SUPPORT_TLS
    bool "support TLS"
    select AOS_COMP_MBEDTLS
    select AOS_COMP_SDK_CERT
    select PLATFORM_HAS_MBEDTLS
    default y 
    help
        This option is mutually exclusive with SUPPORT_ITLS, only less than one of them can be switched to "y"

config SUPPORT_ITLS
    bool "support ITLS"
    depends on !SUPPORT_TLS
    select AOS_COMP_ITLS
    select PLATFORM_HAS_MBEDTLS
    default n
    help
        iTLS is a TLS implementation based on ID2, and ID2 service is professional security solution based on special hardware

config COAP_DTLS_SUPPORT
    bool "support DTLS"
    select AOS_COMP_MBEDTLS
    select AOS_COMP_SDK_CERT
    default n

config HAL_CRYPTO
    bool 
    default y if SUPPORT_TLS || COAP_DTLS_SUPPORT
    select MBEDTLS_CONFIG_CRYPTO_MODE_CFB
    help
      HAL CRYPTO for AliOS Things

config TLS_SAVE_TICKET
    bool "support save tls ticket"
    default n
    depends on  SUPPORT_TLS
    help
      save tls session and ticket in kv to reduce memory and accelerate connection

    config HAL_KV
    bool
    default y
endmenu
```

## network/halwifi/Config.in
```kconfig
menuconfig AOS_COMP_HALWIFI
    bool "halwifi"
    default n
    help

if AOS_COMP_HALWIFI
# Configurations for comp halwifi
endif
```

## network/httpc/Config.in
```kconfig
config AOS_COMP_HTTPC
    bool "httpc"
    default n
    help
        AliOS THings http client
```

## network/lorawan/Config.in
```kconfig
menuconfig AOS_COMP_LORAWAN_STACK
    bool "LoRaWAN Stack"
    default n
    help

if AOS_COMP_LORAWAN_STACK
choice
    prompt "Enable LoRaWAN Version"

source "network/lorawan/lorawan_4_4_0/Config.in"
source "network/lorawan/lorawan_4_4_2/Config.in"
endchoice
endif
```
