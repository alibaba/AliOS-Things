## core/cplusplus/Config.in
```kconfig
if AOS_CREATE_PROJECT
config AOS_COMP_CPLUSPLUS
    bool
    default y
endif

if !AOS_CREATE_PROJECT
config AOS_COMP_CPLUSPLUS
    bool "C++ Support"
    default n
    help

endif
```

## core/debug/Config.in
```kconfig
if AOS_CREATE_PROJECT
config AOS_COMP_DEBUG
    bool
    depends on AOS_COMP_RHINO
    default y
endif

if !AOS_CREATE_PROJECT
config AOS_COMP_DEBUG
    bool "Coredump debug Support"
    depends on AOS_COMP_RHINO
    default n
    help
        coredump and fatal err debug
endif

menu "Coredump debug Configuration"
depends on AOS_COMP_DEBUG

config DEBUG_CONFIG_CPU_USAGE_PERIOD
    int "The interval(ms) for CPU usage"
        default 0
        help
            set the interval(ms) for counting cpu usage,
            default 0 indicates that the feature is diabled by default
            unless call api or open in cli
endmenu
```

## core/fs/ramfs/Config.in
```kconfig
config AOS_COMP_RAMFS
    bool "RAM File System"
    default n
    help
        a RAM file system

if AOS_COMP_RAMFS
# Configurations for component ramfs
endif
```

## core/init/Config.in
```kconfig
if AOS_CREATE_PROJECT
config AOS_COMP_KERNEL_INIT
    bool
    default y
endif

if !AOS_CREATE_PROJECT
config AOS_COMP_KERNEL_INIT
    bool "Initialize Function"
    default n
    select AOS_COMP_ULOG
    help
       AliOS Things initialize function
endif
```

## core/kv/Config.in
```kconfig
###################################################################
# Component enable/disable selection
# in the updated build system, default is y and can not be disabled
if AOS_CREATE_PROJECT
config AOS_COMP_KV
    bool
    default y
    select MBEDTLS_CONFIG_CRYPTO if KV_CONFIG_SECURE_CRYPT_IMPL
    select MBEDTLS_CONFIG_CRYPTO_AES if KV_CONFIG_SECURE_CRYPT_IMPL
    select MBEDTLS_CONFIG_CRYPTO_MODE_OFB if KV_CONFIG_SECURE_CRYPT_IMPL
# do NOT select depend component in this file
# use $(NAME)_COMPONENTS in aos.mk
endif

# Backward compatibility
if !AOS_CREATE_PROJECT
config AOS_COMP_KV
    bool "Key-value Storage"
    select AOS_COMP_MBEDTLS if KV_CONFIG_SECURE_CRYPT_IMPL
    select MBEDTLS_CONFIG_CRYPTO if KV_CONFIG_SECURE_CRYPT_IMPL
    select MBEDTLS_CONFIG_CRYPTO_AES if KV_CONFIG_SECURE_CRYPT_IMPL
    select MBEDTLS_CONFIG_CRYPTO_MODE_OFB if KV_CONFIG_SECURE_CRYPT_IMPL
    default n
    help
        lightweight key-value storage module
endif



# Configurations for component kv
menu "Key-value Storage Configuration"
    depends on AOS_COMP_KV

config KV_CONFIG_TASK_PRIORITY
    int "The garbage collection task priority"
    range 0 256
    default 32
    help
        This option sets the garbage collection task priority.
        the higher of the value, the lower of the priority.
        the default is 32, the range is from 0 to 256.

config KV_CONFIG_TASK_STACK_SIZE
    int "The garbage collection task stack size (bytes)"
    default 1024
    help
        This option sets the garbage collection task stack size.
        this option is limited by the board memory size.
        the value could be 1024, 2048, 4096 ...
        the default is 1024.

config KV_CONFIG_MAX_KEY_LEN
    int "The maximum length of key buffer (bytes)"
    default 128
    help
        This option sets the maximum length of key buffer.
        the value could be 32, 64, 128, 256 ...
        the default is 128.

config KV_CONFIG_MAX_VAL_LEN
    int "The maximum length of value buffer (bytes)"
    default 512
    help
        This options sets the maximum length of value buffer.
        the value could be 32, 64, 128, 256, 512, 1024 ...
        the default is 512.

config KV_CONFIG_SECURE_SUPPORT
    bool "Key-value Storage Security Support"
    default n
    help
        This option enables security support for key-vaue storage.
        saying "y" here enables the feature.
        saying "n" here is disabled.
        the default is "n".

if KV_CONFIG_SECURE_SUPPORT = y

config KV_CONFIG_SECURE_LEVEL
    int "Key-value Storage Security Level"
    range 1 2
    default 1
    help
        This option sets the key-value storage security level.
        saying "1" here is for function level (encrypt store only via security API).
        saying "2" here is for all-block level (encrypt store for all public APIs).
        the default is "1".

config KV_CONFIG_SECURE_CRYPT_IMPL
    bool "Key-value Storage security Implementation"
    default y
    help
        This option chooses the security implementaton.
        saying "y" here chooses the encryption implementation of mbedtls.
        saying "n" here chooses the encryption implementation of user-defined.
        the default is "n"

endif

endmenu
```

## core/libc/Config.in
```kconfig
if AOS_CREATE_PROJECT
config AOS_COMP_NEWLIB_STUB
    bool
    default y
endif

if !AOS_CREATE_PROJECT
config AOS_COMP_NEWLIB_STUB
    bool "Newlib (C-library) adaptation layer"
    default n
    select AOS_COMP_VFS
    help
        AliOS Things libc adaptation layer.
endif
```

## core/mbins/Config.in
```kconfig
config AOS_COMP_MBINS
    bool "mbins"
    depends on MBINS_SUPPORT
    default n
    help

if AOS_COMP_MBINS
# Configurations for component mbins
endif
```

## core/mk/kspace/Config.in
```kconfig
menuconfig RHINO_CONFIG_USER_SPACE
    bool "config micro kernel"
    default n
    help
        "enable micro kernel feature for kernel"

if RHINO_CONFIG_USER_SPACE

config RHINO_CONFIG_URES
    bool "URES"
    default y
    help
        "support kernel uses user space memory"

config RHINO_CONFIG_UCLI
    bool "UCLI"
    select RHINO_CONFIG_UCLI_SYSCALL
    default y
    help
        "enable user space application uses CLI"

config RHINO_CONFIG_UIPC
    bool "UIPC"
    default n
    help
        "support user space IPC"

config RHINO_CONFIG_UCALLBACK
    bool "UCALLBACK"
    default n
    help
        "support user space callback"

config RHINO_CONFIG_UFS
    bool "UFS"
    select RHINO_CONFIG_VFS_SYSCALL
    default n
    help
        "support user space VFS"

config RHINO_CONFIG_UTCPIP
    bool "UTCPIP"
    select AOS_COMP_LWIP
    select RHINO_CONFIG_LWIP_SYSCALL
    help
        "support user space TCPIP"

config RHINO_CONFIG_HAL_ADC_SYSCALL
    bool "HAL ADC syscall"
    depends on BSP_SUPPORT_ADC
    default n
    help
        "support user space HAL ADC syscall"

config RHINO_CONFIG_HAL_DAC_SYSCALL
    bool "HAL DAC syscall"
    depends on BSP_SUPPORT_DAC
    default n
    help
        "support user space HAL DAC syscall"

config RHINO_CONFIG_HAL_FLASH_SYSCALL
    bool "HAL FLASH syscall"
    depends on BSP_SUPPORT_FLASH
    default n
    help
        "support user space HAL FLASH syscall"

config RHINO_CONFIG_HAL_GPIO_SYSCALL
    bool "HAL GPIO syscall"
    depends on BSP_SUPPORT_GPIO
    default n
    help
        "support user space HAL GPIO syscall"

config RHINO_CONFIG_HAL_I2C_SYSCALL
    bool "HAL I2C syscall"
    depends on BSP_SUPPORT_I2C
    default n
    help
        "support user space HAL I2C syscall"

config RHINO_CONFIG_HAL_NAND_SYSCALL
    bool "HAL NAND syscall"
    depends on BSP_SUPPORT_NAND
    default n
    help
        "support user space HAL NAND syscall"

config RHINO_CONFIG_HAL_NOR_SYSCALL
    bool "HAL NOR syscall"
    depends on BSP_SUPPORT_NOR
    default n
    help
        "support user space HAL NOR syscall"

config RHINO_CONFIG_HAL_RTC_SYSCALL
    bool "HAL RTC syscall"
    depends on BSP_SUPPORT_RTC
    default n
    help
        "support user space HAL RTC syscall"

config RHINO_CONFIG_HAL_SD_SYSCALL
    bool "HAL SD syscall"
    depends on BSP_SUPPORT_SD
    default n
    help
        "support user space HAL SD syscall"

config RHINO_CONFIG_HAL_SPI_SYSCALL
    bool "HAL SPI syscall"
    depends on BSP_SUPPORT_SPI
    default n
    help
        "support user space HAL SPI syscall"

config RHINO_CONFIG_HAL_UART_SYSCALL
    bool "HAL UART syscall"
    depends on BSP_SUPPORT_UART
    default y
    help
        "support user space HAL UART syscall"

config RHINO_CONFIG_LWIP_SYSCALL
    bool "LWIP syscall"
    depends on RHINO_CONFIG_UTCPIP
    help
        "support user space socket syscall"

config RHINO_CONFIG_VFS_SYSCALL
    bool "VFS syscall"
    depends on RHINO_CONFIG_UFS
    help
        "support user space vfs syscall"

config RHINO_CONFIG_LINKKIT_SYSCALL
    bool "LINKKIT syscall"
    select AOS_COMP_SDK_DEVMODEL
    depends on RHINO_CONFIG_ULINKKIT
    default n
    help
        "support user space linkkit syscall"

config RHINO_CONFIG_ULINKKIT
    bool "ULINKKIT"
    select RHINO_CONFIG_LINKKIT_SYSCALL
    help
        "support user space linkkitapp"

config RHINO_CONFIG_UCLI_SYSCALL
    bool "UCLI syscall"
    depends on RHINO_CONFIG_UCLI
    help
        "support user space cli syscall"

config RHINO_CONFIG_DYN_SYSCALL_TBL
    bool "DYN syscall tbl"
    default n
    help
        "to support dynamically register and unregister syscall,
         if set to no, the syscall table will be placed at constant,
         data section to save RAM"

endif
```

## core/mk/uspace/Config.in
```kconfig
config RHINO_CONFIG_URES_TASK
    bool "ures task support"
    depends on  RHINO_CONFIG_URES
    default y
    help
        "create ures task for the app"

if RHINO_CONFIG_URES_TASK
config RHINO_CONFIG_URES_TASK_PRIO
    int "ures task priority"
    default 15
    help
        "set ures task priority"

config RHINO_CONFIG_URES_TASK_KSTACK_SIZE
    int "ures task kstack size"
    default 256
    help
        "set ures taks kstack size, the unit is cpu_stack_t"

config RHINO_CONFIG_URES_TASK_USTACK_SIZE
    int "ures task ustack size"
    default 256
    help
        "set ures task ustack size, the unit is cpu_stack_t"
endif

config RHINO_CONFIG_UCLI_TASK
    bool "ucli task support"
    depends on RHINO_CONFIG_UCLI
    default y
    help
        "create ucli task to support user space CLI function"

if RHINO_CONFIG_UCLI_TASK
config RHINO_CONFIG_UCLI_TASK_PRIO
    int "ucli task priority"
    default 25
    help
        "set ucli task priority"

config RHINO_CONFIG_UCLI_TASK_KSTACK_SIZE
    int "ucli task kstack size"
    default 256
    help
        "set ucli taks kstack size, the unit is cpu_stack_t"

config RHINO_CONFIG_UCLI_TASK_USTACK_SIZE
    int "ucli task ustack size"
    default 256
    help
        "set ucli task ustack size, the unit is cpu_stack_t"
endif

config RHINO_CONFIG_UCALLBACK_TASK
    bool "ucallback task support"
    depends on RHINO_CONFIG_UCALLBACK
    default y
    help
        "create ucallback task to support user space callback function"

if RHINO_CONFIG_UCALLBACK_TASK
config RHINO_CONFIG_UCALLBACK_TASK_PRIO
    int "ucli task priority"
    default 10
    help
        "set ucallback task priority"

config RHINO_CONFIG_UCALLBACK_TASK_KSTACK_SIZE
    int "ucallback task kstack size"
    default 256
    help
        "set ucallback taks kstack size, the unit is cpu_stack_t"

config RHINO_CONFIG_UCLI_TASK_USTACK_SIZE
    int "ucallback task ustack size"
    default 256
    help
        "set ucallback task ustack size, the unit is cpu_stack_t"

endif

config RHINO_CONFIG_UTIMER_TASK
    bool "utimer task support"
    default n
    help
        "create utimer task to support user space software timer"

if RHINO_CONFIG_UTIMER_TASK
config RHINO_CONFIG_UTIMER_TASK_PRIO
    int "utimer task priority"
    default 6
    help
        "set utimer task priority"

config RHINO_CONFIG_UTIMER_TASK_KSTACK_SIZE
    int "utimer task kstack size"
    default 256
    help
        "set utimer taks kstack size, the unit is cpu_stack_t"

config RHINO_CONFIG_UTIMER_TASK_USTACK_SIZE
    int "utimer task ustack size"
    default 256
    help
        "set utimer task ustack size, the unit is cpu_stack_t"

config RHINO_CONFIG_UTIMER_MSG_NUM
    int "utimer task max message number"
    default 6
    help
        "set the max message nubmer of utimer"

source "kernel/mk/syscall/usyscall/Config.in"

endif
```

## core/nftl/Config.in
```kconfig
menuconfig AOS_COMP_NFTL
    bool "NAND Flash Translation Layer"
    default n
    help
      NAND Flash Translation Layer module

if AOS_COMP_NFTL
# Configurations for component nftl
endif
```

## core/osal/aos/Config.in
```kconfig
if AOS_CREATE_PROJECT
config AOS_COMP_OSAL_AOS
    bool
    default y
endif

if !AOS_CREATE_PROJECT
config AOS_COMP_OSAL_AOS
    bool "AOS API Support"
    default y
    help
        AliOS Things API supported by OS.
endif

menu "AOS API Configuration"
depends on AOS_COMP_OSAL_AOS

choice
    prompt "OSAL Selection"
    default OSAL_RHINO

    config OSAL_RHINO
        bool "RHINO"
        select AOS_COMP_RHINO if !AOS_CREATE_PROJECT

    config OSAL_FREERTOS
        bool "FREERTOS"
        depends on kernel_core = freertos

endchoice

config OSAL_CONFIG
    string
    default "rhino"    if OSAL_RHINO
    default "freertos" if OSAL_FREERTOS
    help

endmenu
```

## core/osal/cmsis/Config.in
```kconfig
if AOS_CREATE_PROJECT
config AOS_COMP_OSAL_CMSIS
    bool
    default y
endif

if !AOS_CREATE_PROJECT
config AOS_COMP_OSAL_CMSIS
    bool "CMSIS API Support"
    default n
    help

endif
```

## core/pwrmgmt/Config.in
```kconfig
if AOS_CREATE_PROJECT
config AOS_COMP_PWRMGMT
    bool
    default y
endif

if !AOS_CREATE_PROJECT
config AOS_COMP_PWRMGMT
    bool "Power Management"
    default n
    help
        power management. This module is used to reduce the system power consumption.
endif

menu "Power Management Configuration"
    depends on AOS_COMP_PWRMGMT

# Configurations for component pwrmgmt
config PWRMGMT_CONFIG_SHOW
    bool "Exclude the functions of state show"
        default n
        help
            set to y if you want to call state show function:enable cpu_pwr_c_support_print,
            cpu_pwr_info_show,cpu_pwr_state_show.
            default n

config PWRMGMT_CONFIG_DEBUG
    bool "Enable to show debug infomation"
        default n
        help
            set to y if you want to show debug infomation.
            default n

config PWRMGMT_CONFIG_CPU_ACTIVE
    bool "Enable the function to set cpu active time"
        default n
        help
            set to y if you want to use the function which do not enter low power in specified time.
            default n

config PWRMGMT_CONFIG_MINISLEEP
    bool "Enable the function to set minimum sleep time"
        default n
        help
            set to y if you want to specify the minimum time for the CPU to enter low power.
            default n

config WIFI_CONFIG_SUPPORT_LOWPOWER
    bool "Enable wifi low power"
        depends on BSP_SUPPORT_WIFI_LOWPOWER
        default y
        help
            set y to enable wifi low power. If the board support wifi low power it is enabled by default.

endmenu
```

## core/rbtree/Config.in
```kconfig
if AOS_CREATE_PROJECT
config AOS_COMP_LIB_RBTREE
    bool
    default y
endif

if !AOS_CREATE_PROJECT
config AOS_COMP_LIB_RBTREE
    bool "rbtree code"
    default n
    help
        red-black tree
endif

if AOS_COMP_LIB_RBTREE

endif
```
