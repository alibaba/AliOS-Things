## core/rhino/Config.in
```kconfig
config AOS_COMP_RHINO
    bool "Kernel Core (rhino)"
    default y
    help
        AliOS Things kernel core(rhino)

#if AOS_COMP_RHINO
if 0
# Configurations for component rhino

config RHINO_CONFIG_SEM
    bool "RHINO_CONFIG_SEM"
    default y
    help
       set to y if you want to enable sem, set to n to disable sem,
       default y

config RHINO_CONFIG_QUEUE
    bool "RHINO_CONFIG_QUEUE"
    default y
    help
       set to y if you want to enable queue, set to n to disable queue,
       default y

config RHINO_CONFIG_BUF_QUEUE
    bool "RHINO_CONFIG_BUF_QUEUE"
    default y
    help
       set to y if you want to enable buf_queue, set to n to disable buf_queue,
       default y

config RHINO_CONFIG_WORKQUEUE
    bool "RHINO_CONFIG_WORKQUEUE"
    default n
    help
       set to y if you want to enable workqueue, set to n to disable workqueue,
       default n

if RHINO_CONFIG_WORKQUEUE = y

config RHINO_CONFIG_WORKQUEUE_STACK_SIZE
    int "RHINO_CONFIG_WORKQUEUE_STACK_SIZE"
    default 512
    help
       setting the task stack size of the workqueue task, default 512 * 4 bytes

config RHINO_CONFIG_WORKQUEUE_TASK_PRIO
    int "RHINO_CONFIG_WORKQUEUE_TASK_PRIO"
    range 0 256
    default 20
    help
       setting the task pri of the workqueue task, default 20

endif

config RHINO_CONFIG_TIMER
    bool "RHINO_CONFIG_TIMER"
    default y
    help
       set to y if you want to enable timer, set to n to disable timer, default y

if RHINO_CONFIG_TIMER = y

config RHINO_CONFIG_TIMER_TASK_STACK_SIZE
    int "RHINO_CONFIG_TIMER_TASK_STACK_SIZE"
    default 200
    help
       setting the task stack size of the timer task, default 200 * 4 bytes
       (depend on the stack size of the timer hook function)

config RHINO_CONFIG_TIMER_TASK_PRI
    int "RHINO_CONFIG_TIMER_TASK_PRI"
    range 0 256
    default 5
    help
       setting the task pri of the timer task, default 5

endif

config RHINO_CONFIG_MM_TLF
    bool "RHINO_CONFIG_MM_TLF"
    default y
    help
       set to y if you want to enable mm tlf, set to n to disable mm tlf,
       default y

if RHINO_CONFIG_MM_TLF = y

config RHINO_CONFIG_MM_DEBUG
    bool "RHINO_CONFIG_MM_DEBUG"
    default n
    help
       set to y if you want to enable mm debug, set to n to disable debug,
       default n

endif

config RHINO_CONFIG_SCHED_RR
    bool "RHINO_CONFIG_SCHED_RR"
    default y
    help
       set to y if you want to enable round robin, set to n to disable round robin,
       default y

if RHINO_CONFIG_SCHED_RR = y

config RHINO_CONFIG_TIME_SLICE_DEFAULT
    int "RHINO_CONFIG_TIME_SLICE_DEFAULT"
    default 50
    help
       setting the value of time slice, default 50ms

endif

config RHINO_CONFIG_TICKS_PER_SECOND
    int "RHINO_CONFIG_TICKS_PER_SECOND"
    default 100
    help
       setting the value of ticks/s, default 100

config RHINO_CONFIG_PRI_MAX
    int "RHINO_CONFIG_PRI_MAX"
    range 0 256
    default 62
    help
       setting the max value of task pri, default 62, max=256,
       the higher of the value, the lower of the priority

config RHINO_CONFIG_TASK_STACK_OVF_CHECK
    bool "RHINO_CONFIG_TASK_STACK_OVF_CHECK"
    default y
    help
       set to y if you want to enable stack overflow check,
       set to n to disable stack overflow check, default y

config RHINO_CONFIG_IDLE_TASK_STACK_SIZE
    int "RHINO_CONFIG_IDLE_TASK_STACK_SIZE"
    default 100
    help
       setting the task stack size of the idle task, default 100 * 4 bytes
       (depend on the stack size of the idle hook function)

endif
```

## core/trace/Config.in
```kconfig
if AOS_CREATE_PROJECT
config AOS_COMP_TRACE
    bool
    default n
endif

if !AOS_CREATE_PROJECT
config AOS_COMP_TRACE
    bool "trace tool"
    default n
    help
        interface for systemview trace tool.

endif

menu "trace tool Configuration"
    depends on AOS_COMP_TRACE
# Configurations for component trace

endmenu
```

## core/vfs/Config.in
```kconfig
if AOS_CREATE_PROJECT
config AOS_COMP_VFS
    bool
    default y
endif

if !AOS_CREATE_PROJECT
config AOS_COMP_VFS
    bool "Virtual File System"
    default n
    help
        a unified user interface for various files. It is an abstraction layer on top of a more concrete file system.

endif

menu "Virtual File System Configuration"
    depends on AOS_COMP_VFS
# Configurations for component vfs

config VFS_CONFIG_DEVICE_NODES
    int "The maximum number of VFS device nodes"
    default 25
    help
        This option sets the maximum number of VFS device nodes.
        the value could be 5, 10, 15, 20, 25, 50 ...
        the default is 25.

config VFS_CONFIG_FD_OFFSET
    int "The default offset of VFS file descriptor"
    default 512
    help
        This option sets the default offset of vfs file descriptor.
        the value could be 512, 578, 610, 768 ...
        the default is 512 (1 ~ 512 is used for LWIP fds).

config VFS_CONFIG_PATH_MAX
    int "The maximum length of device path (bytes)"
    default 256
    help
        This option sets the maximum length of device path.
        the value could be 32, 64, 128, 256, 512 ...
        the default is 256.

config VFS_CONFIG_MAX_FILE_NUM
    int "The maximum number of VFS files"
    default 50
    help
        This option sets the maximum number of VFS files.
        normally, this option should be equal to twice the device nodes.
        the default is 50.

config VFS_CONFIG_CURRENT_DIRECTORY_ENABLE
    bool "Current Directory Recording Support"
    default n
    help
        This option enables the current working directory recording support.
        saying "y" here enables the feature, saying "n" here is disabled.
        the default is "n"

endmenu
```

## drivers/Config.in
```kconfig
menu "Drivers Configuration"

## --- Generated Automatically ---
source "drivers/sensor/Config.in"
## --- End ---

endmenu
```

## drivers/sal/Config.in
```kconfig
source "drivers/sal/gprs/sim800/Config.in"
source "drivers/sal/wifi/bk7231/Config.in"
source "drivers/sal/wifi/mk3060/Config.in"
source "drivers/sal/wifi/gt202/Config.in"
source "drivers/sal/wifi/athost/Config.in"
source "drivers/sal/wifi/esp8266/Config.in"
```

## drivers/sal/wifi/Config.in
```kconfig
config AOS_SAL_WIFI
    bool "WIFI"

if AOS_SAL_WIFI

choice
    prompt "Device"
    default AOS_COMP_DEVICE_SAL_BK7231 if BSP_EXTERNAL_WIFI_MODULE = "wifi.bk7231"
    default AOS_COMP_DEVICE_SAL_ESP8266 if BSP_EXTERNAL_WIFI_MODULE = "wifi.esp8266"
    default AOS_COMP_DEVICE_SAL_GT202 if BSP_EXTERNAL_WIFI_MODULE = "wifi.gt202"
    default AOS_COMP_DEVICE_SAL_MK3060 if BSP_EXTERNAL_WIFI_MODULE = "wifi.mk3060"

config AOS_WIFI_NULL
    bool "Null"

source "drivers/sal/wifi/bk7231/Config.in"
source "drivers/sal/wifi/esp8266/Config.in"
source "drivers/sal/wifi/gt202/Config.in"
source "drivers/sal/wifi/mk3060/Config.in"

endchoice

endif
```

## drivers/sal/wifi/bk7231/Config.in
```kconfig
menuconfig AOS_COMP_DEVICE_SAL_BK7231
    bool "device_sal_bk7231"
    default n
    select AOS_COMP_ATPARSER if @CONDITION@
    select AOS_COMP_YLOOP
    help

if AOS_COMP_DEVICE_SAL_BK7231
# Configurations for comp device_sal_bk7231
endif
```

## drivers/sal/wifi/esp8266/Config.in
```kconfig
menuconfig AOS_COMP_DEVICE_SAL_ESP8266
    bool "device_sal_esp8266"
    default n
    select AOS_COMP_YLOOP
    help

if AOS_COMP_DEVICE_SAL_ESP8266
# Configurations for comp device_sal_esp8266
endif
```
